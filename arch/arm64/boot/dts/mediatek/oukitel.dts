/dts-v1/;

/ {
	model = "MT6757";
	compatible = "mediatek,MT6757";
	interrupt-parent = <0x01>;
	#address-cells = <0x02>;
	#size-cells = <0x02>;

	chosen {
		bootargs = "console=tty0 console=ttyMT3,921600n1 vmalloc=496M slub_max_order=0 slub_debug=OFZPU androidboot.hardware=mt6757 firmware_class.path=/vendor/firmware loop.max_part=7 androidboot.selinux=permissive";
		linux,phandle = <0x5d>;
		phandle = <0x5d>;
	};

	msdc0@11230000 {
		compatible = "mediatek,mt6757-mmc";
		reg = <0x00 0x11230000 0x00 0x10000>;
		interrupts = <0x00 0x4f 0x08>;
		clocks = <0x02 0x1f>;
		clock-names = "MSDC0-CLOCK";
		clk_src = [01];
		bus-width = <0x08>;
		max-frequency = <0xbebc200>;
		cap-mmc-highspeed;
		msdc-sys-suspend;
		mmc-ddr-1_8v;
		mmc-hs200-1_8v;
		mmc-hs400-1_8v;
		non-removable;
		pinctl = <0x03>;
		register_setting = <0x04>;
		host_function = [00];
		bootable;
		status = "okay";
		vmmc-supply = <0x05>;
		linux,phandle = <0x5e>;
		phandle = <0x5e>;
	};

	msdc1@11240000 {
		compatible = "mediatek,mt6757-mmc";
		reg = <0x00 0x11240000 0x00 0x10000>;
		interrupts = <0x00 0x50 0x08>;
		clocks = <0x02 0x21>;
		clock-names = "MSDC1-CLOCK";
		clk_src = [07];
		bus-width = <0x04>;
		max-frequency = <0xbebc200>;
		msdc-sys-suspend;
		cap-sd-highspeed;
		sd-uhs-sdr12;
		sd-uhs-sdr25;
		sd-uhs-sdr50;
		sd-uhs-sdr104;
		sd-uhs-ddr50;
		pinctl = <0x06>;
		pinctl_sdr104 = <0x07>;
		pinctl_sdr50 = <0x08>;
		pinctl_ddr50 = <0x09>;
		register_setting = <0x0a>;
		host_function = [01];
		cd_level = [00];
		cd-gpios = <0x0b 0x03 0x00>;
		status = "okay";
		vmmc-supply = <0x0c>;
		vqmmc-supply = <0x0d>;
		linux,phandle = <0x5f>;
		phandle = <0x5f>;
	};

	msdc2@11250000 {
		compatible = "mediatek,mt6757-mmc";
		reg = <0x00 0x11250000 0x00 0x10000>;
		interrupts = <0x00 0x51 0x08>;
		clocks = <0x02 0x22>;
		clock-names = "MSDC2-CLOCK";
		clk_src = [07];
		bus-width = <0x04>;
		max-frequency = <0xbebc200>;
		cap-sd-highspeed;
		sd-uhs-sdr12;
		sd-uhs-sdr25;
		sd-uhs-sdr50;
		sd-uhs-sdr104;
		sd-uhs-ddr50;
		keep-power-in-suspend;
		non-removable;
		pinctl = <0x0e>;
		register_setting = <0x0f>;
		host_function = [02];
		status = "disable";
		linux,phandle = <0x60>;
		phandle = <0x60>;
	};

	msdc1_ins@0 {
		compatible = "mediatek,mt6757-sdcard-ins";
		linux,phandle = <0x61>;
		phandle = <0x61>;
	};

	atf_logger {
		compatible = "mediatek,atf_logger";
		interrupts = <0x00 0x11e 0x01>;
	};

	mobicore {
		compatible = "trustonic,mobicore";
		interrupts = <0x00 0x124 0x01>;
	};

	tkcore {
		compatible = "trustkernel,tkcore";
		interrupts = <0x00 0x128 0x00>;
	};

	psci {
		compatible = "arm,psci-0.2";
		method = "smc";
	};

	utos {
		compatible = "microtrust,utos";
		interrupts = <0x00 0x125 0x01 0x00 0x126 0x01>;
	};

	utos_tester {
		compatible = "microtrust,tester-v1";
	};

	cpus {
		#address-cells = <0x01>;
		#size-cells = <0x00>;

		cpu@000 {
			device_type = "cpu";
			compatible = "arm,cortex-a53";
			reg = <0x00>;
			enable-method = "psci";
			cpu-idle-states = <0x10 0x11 0x12 0x13 0x14 0x15 0x16 0x17 0x18 0x19 0x1a>;
			cpu-release-addr = <0x00 0x40000200>;
			clock-frequency = <0x61a1e580>;
			linux,phandle = <0x1b>;
			phandle = <0x1b>;
		};

		cpu@001 {
			device_type = "cpu";
			compatible = "arm,cortex-a53";
			reg = <0x01>;
			enable-method = "psci";
			cpu-idle-states = <0x10 0x11 0x12 0x13 0x14 0x15 0x16 0x17 0x18 0x19 0x1a>;
			cpu-release-addr = <0x00 0x40000200>;
			clock-frequency = <0x61a1e580>;
			linux,phandle = <0x1c>;
			phandle = <0x1c>;
		};

		cpu@002 {
			device_type = "cpu";
			compatible = "arm,cortex-a53";
			reg = <0x02>;
			enable-method = "psci";
			cpu-idle-states = <0x10 0x11 0x12 0x13 0x14 0x15 0x16 0x17 0x18 0x19 0x1a>;
			cpu-release-addr = <0x00 0x40000200>;
			clock-frequency = <0x61a1e580>;
			linux,phandle = <0x1d>;
			phandle = <0x1d>;
		};

		cpu@003 {
			device_type = "cpu";
			compatible = "arm,cortex-a53";
			reg = <0x03>;
			enable-method = "psci";
			cpu-idle-states = <0x10 0x11 0x12 0x13 0x14 0x15 0x16 0x17 0x18 0x19 0x1a>;
			cpu-release-addr = <0x00 0x40000200>;
			clock-frequency = <0x61a1e580>;
			linux,phandle = <0x1e>;
			phandle = <0x1e>;
		};

		cpu@100 {
			device_type = "cpu";
			compatible = "arm,cortex-a53";
			reg = <0x100>;
			enable-method = "psci";
			cpu-idle-states = <0x10 0x11 0x12 0x13 0x14 0x15 0x16 0x17 0x18 0x19 0x1a>;
			cpu-release-addr = <0x00 0x40000200>;
			clock-frequency = <0x8b799100>;
			linux,phandle = <0x1f>;
			phandle = <0x1f>;
		};

		cpu@101 {
			device_type = "cpu";
			compatible = "arm,cortex-a53";
			reg = <0x101>;
			enable-method = "psci";
			cpu-idle-states = <0x10 0x11 0x12 0x13 0x14 0x15 0x16 0x17 0x18 0x19 0x1a>;
			cpu-release-addr = <0x00 0x40000200>;
			clock-frequency = <0x8b799100>;
			linux,phandle = <0x20>;
			phandle = <0x20>;
		};

		cpu@102 {
			device_type = "cpu";
			compatible = "arm,cortex-a53";
			reg = <0x102>;
			enable-method = "psci";
			cpu-idle-states = <0x10 0x11 0x12 0x13 0x14 0x15 0x16 0x17 0x18 0x19 0x1a>;
			cpu-release-addr = <0x00 0x40000200>;
			clock-frequency = <0x8b799100>;
			linux,phandle = <0x21>;
			phandle = <0x21>;
		};

		cpu@103 {
			device_type = "cpu";
			compatible = "arm,cortex-a53";
			reg = <0x103>;
			enable-method = "psci";
			cpu-idle-states = <0x10 0x11 0x12 0x13 0x14 0x15 0x16 0x17 0x18 0x19 0x1a>;
			cpu-release-addr = <0x00 0x40000200>;
			clock-frequency = <0x8b799100>;
			linux,phandle = <0x22>;
			phandle = <0x22>;
		};

		cpu-map {

			cluster0 {

				core0 {
					cpu = <0x1b>;
				};

				core1 {
					cpu = <0x1c>;
				};

				core2 {
					cpu = <0x1d>;
				};

				core3 {
					cpu = <0x1e>;
				};
			};

			cluster1 {

				core0 {
					cpu = <0x1f>;
				};

				core1 {
					cpu = <0x20>;
				};

				core2 {
					cpu = <0x21>;
				};

				core3 {
					cpu = <0x22>;
				};
			};
		};

		idle-states {
			entry-method = "arm,psci";

			legacy-mcdi {
				compatible = "arm,idle-state";
				arm,psci-suspend-param = <0x01>;
				entry-latency-us = <0x258>;
				exit-latency-us = <0x258>;
				min-residency-us = <0x4b0>;
				linux,phandle = <0x10>;
				phandle = <0x10>;
			};

			legacy-sodi {
				compatible = "arm,idle-state";
				arm,psci-suspend-param = <0x02>;
				entry-latency-us = <0x258>;
				exit-latency-us = <0x258>;
				min-residency-us = <0x4b0>;
				linux,phandle = <0x11>;
				phandle = <0x11>;
			};

			legacy-sodi3 {
				compatible = "arm,idle-state";
				arm,psci-suspend-param = <0x03>;
				entry-latency-us = <0x258>;
				exit-latency-us = <0x258>;
				min-residency-us = <0x4b0>;
				linux,phandle = <0x12>;
				phandle = <0x12>;
			};

			legacy-dpidle {
				compatible = "arm,idle-state";
				arm,psci-suspend-param = <0x04>;
				entry-latency-us = <0x258>;
				exit-latency-us = <0x258>;
				min-residency-us = <0x4b0>;
				linux,phandle = <0x13>;
				phandle = <0x13>;
			};

			legacy-suspend {
				compatible = "arm,idle-state";
				arm,psci-suspend-param = <0x05>;
				entry-latency-us = <0x258>;
				exit-latency-us = <0x258>;
				min-residency-us = <0x4b0>;
				linux,phandle = <0x14>;
				phandle = <0x14>;
			};

			mcdi-cpu {
				compatible = "arm,idle-state";
				arm,psci-suspend-param = <0x10001>;
				entry-latency-us = <0x258>;
				exit-latency-us = <0x258>;
				min-residency-us = <0x4b0>;
				linux,phandle = <0x15>;
				phandle = <0x15>;
			};

			mcdi-cluster {
				compatible = "arm,idle-state";
				arm,psci-suspend-param = <0x1010001>;
				entry-latency-us = <0x258>;
				exit-latency-us = <0x258>;
				min-residency-us = <0x4b0>;
				linux,phandle = <0x16>;
				phandle = <0x16>;
			};

			sodi {
				compatible = "arm,idle-state";
				arm,psci-suspend-param = <0x1010002>;
				entry-latency-us = <0x320>;
				exit-latency-us = <0x3e8>;
				min-residency-us = <0x7d0>;
				linux,phandle = <0x17>;
				phandle = <0x17>;
			};

			sodi3 {
				compatible = "arm,idle-state";
				arm,psci-suspend-param = <0x1010003>;
				entry-latency-us = <0x320>;
				exit-latency-us = <0x3e8>;
				min-residency-us = <0x7d0>;
				linux,phandle = <0x18>;
				phandle = <0x18>;
			};

			dpidle {
				compatible = "arm,idle-state";
				arm,psci-suspend-param = <0x1010004>;
				entry-latency-us = <0x320>;
				exit-latency-us = <0x3e8>;
				min-residency-us = <0x7d0>;
				linux,phandle = <0x19>;
				phandle = <0x19>;
			};

			suspend {
				compatible = "arm,idle-state";
				arm,psci-suspend-param = <0x1010005>;
				entry-latency-us = <0x320>;
				exit-latency-us = <0x3e8>;
				min-residency-us = <0x7d0>;
				linux,phandle = <0x1a>;
				phandle = <0x1a>;
			};
		};
	};

	memory {
		device_type = "memory";
		reg = <0x00 0x40000000 0x00 0x20000000>;
		linux,phandle = <0x62>;
		phandle = <0x62>;
	};

	reserved-memory {
		#address-cells = <0x02>;
		#size-cells = <0x02>;
		ranges;
		linux,phandle = <0x63>;
		phandle = <0x63>;

		atf-reserved-memory@50e00000 {
			compatible = "mediatek,mt6757-atf-reserved-memory";
			no-map;
			reg = <0x00 0x50e00000 0x00 0x14000>;
		};

		atf-ramdump-memory@50e14000 {
			compatible = "mediatek,mt6757-atf-ramdump-memory";
			no-map;
			reg = <0x00 0x50e14000 0x00 0x2c000>;
		};

		consys-reserve-memory {
			compatible = "mediatek,consys-reserve-memory";
			#address-cells = <0x02>;
			#size-cells = <0x02>;
			no-map;
			size = <0x00 0x200000>;
			alignment = <0x00 0x200000>;
			alloc-ranges = <0x00 0x40000000 0x00 0x80000000>;
		};

		spm-reserve-memory {
			compatible = "mediatek,spm-reserve-memory";
			no-map;
			size = <0x00 0x38000>;
			alignment = <0x00 0x10000>;
			alloc-ranges = <0x00 0x40000000 0x00 0x80000000>;
		};
	};

	plat_sram_flag@0011dbf0 {
		compatible = "mediatek,plat_sram_flag";
		reg = <0x00 0x11dbf0 0x00 0x10>;
	};

	interrupt-controller@0c000000 {
		compatible = "arm,gic-v3";
		#interrupt-cells = <0x03>;
		#address-cells = <0x02>;
		#size-cells = <0x02>;
		#redistributor-regions = <0x01>;
		interrupt-controller;
		reg = <0x00 0xc000000 0x00 0x40000 0x00 0xc200000 0x00 0x200000 0x00 0x10200620 0x00 0x1000 0x00 0x10200690 0x00 0x1000>;
		interrupts = <0x01 0x09 0x04>;
		mediatek,reg_len_pol0 = <0x08>;
		linux,phandle = <0x01>;
		phandle = <0x01>;
	};

	clocks {

		clk_null {
			compatible = "fixed-clock";
			#clock-cells = <0x00>;
			clock-frequency = <0x00>;
			linux,phandle = <0x64>;
			phandle = <0x64>;
		};

		clk26m {
			compatible = "fixed-clock";
			#clock-cells = <0x00>;
			clock-frequency = <0x18cba80>;
			linux,phandle = <0x37>;
			phandle = <0x37>;
		};

		clk32k {
			compatible = "fixed-clock";
			#clock-cells = <0x00>;
			clock-frequency = <0x7d00>;
			linux,phandle = <0x2c>;
			phandle = <0x2c>;
		};
	};

	cpuxgpt@10200000 {
		compatible = "mediatek,cpuxgpt";
		reg = <0x00 0x10200000 0x00 0x1000>;
		interrupts = <0x00 0x40 0x04 0x00 0x41 0x04 0x00 0x42 0x04 0x00 0x43 0x04 0x00 0x44 0x04 0x00 0x45 0x04 0x00 0x46 0x04 0x00 0x47 0x04>;
	};

	pmu {
		compatible = "arm,armv8-pmuv3";
		interrupt-parent = <0x01>;
		interrupts = <0x01 0x07 0x08>;
	};

	timer {
		compatible = "arm,armv8-timer";
		interrupts = <0x01 0x0d 0x08 0x01 0x0e 0x08 0x01 0x0b 0x08 0x01 0x0a 0x08>;
		clock-frequency = <0xc65d40>;
		linux,phandle = <0x65>;
		phandle = <0x65>;
	};

	mtkfb@0 {
		compatible = "mediatek,mtkfb";
		linux,phandle = <0x66>;
		phandle = <0x66>;
	};

	touch {
		compatible = "mediatek,touch";
		linux,phandle = <0x67>;
		phandle = <0x67>;
	};

	accdet@ {
		compatible = "mediatek,mt6757-accdet";
		linux,phandle = <0x68>;
		phandle = <0x68>;
	};

	bat_notify {
		compatible = "mediatek,bat_notify";
	};

	bat_metter {
		compatible = "mediatek,bat_meter";
		stop_charging_in_takling = <0x01>;
		talking_recharge_voltage = <0xed8>;
		talking_sync_time = <0x3c>;
		mtk_temperature_recharge_support = <0x01>;
		max_charge_temperature = <0x32>;
		max_charge_temperature_minus_x_degree = <0x2f>;
		min_charge_temperature = <0x00>;
		min_charge_temperature_plus_x_degree = <0x06>;
		err_charge_temperature = <0xff>;
		v_pre2cc_thres = <0xd48>;
		v_cc2topoff_thres = <0xfd2>;
		recharging_voltage = <0x100e>;
		charging_full_current = <0x64>;
		config_usb_if = <0x00>;
		usb_charger_current_suspend = <0x00>;
		usb_charger_current_unconfigured = <0x1b58>;
		usb_charger_current_configured = <0xc350>;
		usb_charger_current = <0xc350>;
		ac_charger_current = <0x13880>;
		non_std_ac_charger_current = <0xc350>;
		charging_host_charger_current = <0xfde8>;
		apple_0_5a_charger_current = <0xc350>;
		apple_1_0a_charger_current = <0xfde8>;
		apple_2_1a_charger_current = <0x13880>;
		bat_low_temp_protect_enable = <0x00>;
		v_charger_enable = <0x00>;
		v_charger_max = <0x1964>;
		v_charger_min = <0x1130>;
		onehundred_percent_tracking_time = <0x0a>;
		npercent_tracking_time = <0x14>;
		sync_to_real_tracking_time = <0x3c>;
		v_0percent_tracking = <0xd7a>;
		high_battery_voltage_support = <0x00>;
		r_bat_sense = <0x04>;
		r_i_sense = <0x04>;
		r_charger_1 = <0x14a>;
		r_charger_2 = <0x27>;
		temperature_t0 = <0x6e>;
		temperature_t1 = <0x00>;
		temperature_t2 = <0x19>;
		temperature_t3 = <0x32>;
		temperature_t = <0xff>;
		fg_meter_resistance = <0x00>;
		q_max_pos_50 = <0xab7>;
		q_max_pos_25 = <0xa93>;
		q_max_pos_0 = <0x348>;
		q_max_neg_10 = <0x327>;
		q_max_pos_50_h_current = <0xa80>;
		q_max_pos_25_h_current = <0xa5d>;
		q_max_pos_0_h_current = <0x337>;
		q_max_neg_10_h_current = <0x317>;
		oam_d5 = <0x01>;
		change_tracking_point = <0x01>;
		cust_tracking_point = <0x00>;
		cust_r_sense = <0x38>;
		cust_hw_cc = <0x00>;
		aging_tuning_value = <0x67>;
		cust_r_fg_offset = <0x00>;
		ocv_board_compesate = <0x00>;
		r_fg_board_base = <0x3e8>;
		r_fg_board_slope = <0x3e8>;
		car_tune_value = <0x76>;
		current_detect_r_fg = <0x0a>;
		minerroroffset = <0x3e8>;
		fg_vbat_average_size = <0x12>;
		r_fg_value = <0x0a>;
		difference_hwocv_rtc = <0x1e>;
		difference_hwocv_swocv = <0x0a>;
		difference_swocv_rtc = <0x0a>;
		max_swocv = <0x03>;
		difference_voltage_update = <0x14>;
		aging1_load_soc = <0x46>;
		aging1_update_soc = <0x1e>;
		batterypseudo100 = <0x5f>;
		batterypseudo1 = <0x0b>;
		q_max_by_sys = <0x01>;
		q_max_sys_voltage = <0xd16>;
		shutdown_gauge0 = <0x01>;
		shutdown_gauge1_xmins = <0x01>;
		shutdown_gauge1_mins = <0x3c>;
		shutdown_system_voltage = <0xd48>;
		charge_tracking_time = <0x3c>;
		discharge_tracking_time = <0x0a>;
		recharge_tolerance = <0x0a>;
		sync_ui_soc_imm = <0x00>;
		mtk_enable_aging_algorithm = <0x01>;
		md_sleep_current_check = <0x01>;
		q_max_by_current = <0x00>;
		cust_poweron_delta_capacity_tolrance = <0x28>;
		cust_poweron_low_capacity_tolrance = <0x05>;
		cust_poweron_max_vbat_tolrance = <0x5a>;
		cust_poweron_delta_vbat_tolrance = <0x1e>;
		cust_poweron_delta_hw_sw_ocv_capacity_tolrance = <0x0a>;
		fixed_tbat_25 = <0x00>;
		vbat_normal_wakeup = <0xe10>;
		vbat_low_power_wakeup = <0xdac>;
		normal_wakeup_period = <0x1518>;
		low_power_wakeup_period = <0x12c>;
		close_poweroff_wakeup_period = <0x1e>;
		rbat_pull_up_r = <0x5dc0>;
		rbat_pull_up_volt = <0x708>;
		batt_temperature_table_num = <0x11>;
		batt_temperature_table = <0xffffffec 0x10a8d 0xfffffff1 0xd192 0xfffffff6 0xa60a 0xfffffffb 0x8464 0x00 0x6a53 0x05 0x5605 0x0a 0x4606 0x0f 0x3952 0x14 0x2f31 0x19 0x2710 0x1e 0x207b 0x23 0x1b24 0x28 0x16ca 0x2d 0x1335 0x32 0x1041 0x37 0xdcf 0x3c 0xbc6>;
		battery_profile_t0_num = <0x52>;
		battery_profile_t0 = <0x00 0x10cf 0x06 0x10b9 0x0d 0x10a5 0x12 0x1090 0x19 0x1079 0x1f 0x1062 0x26 0x1049 0x2c 0x1031 0x33 0x1015 0x38 0xff8 0x3e 0xfe4 0x45 0xfcf 0x4b 0xfb3 0x52 0xf9d 0x57 0xf8d 0x5e 0xf7f 0x64 0xf74 0x6b 0xf66 0x71 0xf59 0x76 0xf49 0x7d 0xf37 0x80 0xf28 0x87 0xf1d 0x8d 0xf11 0x93 0xf08 0x9a 0xeff 0x9f 0xef6 0xa6 0xeef 0xac 0xeea 0xb3 0xee3 0xb9 0xede 0xc0 0xed8 0xc5 0xed4 0xcb 0xecf 0xd2 0xecb 0xd8 0xec5 0xdf 0xebf 0xe4 0xeba 0xeb 0xeb0 0xf1 0xea8 0xf8 0xe9e 0xfe 0xe93 0x103 0xe89 0x10a 0xe81 0x110 0xe78 0x117 0xe72 0x11d 0xe68 0x124 0xe51 0x129 0xe1d 0x130 0xdc6 0x133 0xd8a 0x136 0xd74 0x139 0xd60 0x139 0xd4c>;
		battery_profile_t1_num = <0x52>;
		battery_profile_t1 = <0x00 0x10dc 0x07 0x10bb 0x0c 0x1094 0x14 0x1072 0x16 0x1059 0x1d 0x1044 0x22 0x1030 0x29 0x1020 0x31 0x100d 0x36 0xffd 0x3d 0xff0 0x3f 0xfe5 0x47 0xfcf 0x4e 0xfb7 0x53 0xfa3 0x5a 0xf95 0x5f 0xf89 0x64 0xf7f 0x69 0xf73 0x70 0xf64 0x78 0xf53 0x7c 0xf43 0x84 0xf33 0x8b 0xf25 0x8d 0xf18 0x95 0xf0f 0x9a 0xf06 0xa1 0xefd 0xa6 0xef7 0xad 0xeef 0xb5 0xee7 0xb7 0xee3 0xbe 0xedc 0xc3 0xed7 0xca 0xed2 0xd2 0xece 0xd7 0xec9 0xde 0xec6 0xe0 0xec2 0xe8 0xebd 0xed 0xeb8 0xf4 0xeb1 0xfb 0xea9 0x100 0xe9e 0x105 0xe8f 0x10a 0xe80 0x111 0xe78 0x116 0xe75 0x11d 0xe72 0x125 0xe6c 0x12a 0xe60 0x12e 0xe29 0x133 0xdc8 0x13b 0xd90 0x142 0xd4b 0x144 0xcfb 0x144 0xcc3 0x144 0xc9e 0x147 0xc83 0x147 0xc6c 0x147 0xc55 0x147 0xc45 0x147 0xc34 0x147 0xc25 0x147 0xc18 0x147 0xc0c 0x147 0xc07 0x147 0xbfb 0x147 0xbf2 0x147 0xbe7 0x147 0xbe1 0x147 0xbd8 0x147 0xbd5 0x147 0xbca 0x147 0xbc0 0x147 0xbba 0x147 0xbbb 0x147 0xbb3 0x147 0xba9 0x147 0xba7 0x147 0xba3 0x147 0xb97>;
		battery_profile_t2_num = <0x52>;
		battery_profile_t2 = <0x00 0x10e8 0x02 0x10cf 0x04 0x10bb 0x05 0x10a7 0x07 0x1095 0x09 0x1083 0x0b 0x1071 0x0d 0x105d 0x0e 0x104d 0x10 0x103b 0x13 0x102a 0x15 0x1019 0x16 0x1008 0x18 0xff7 0x1a 0xfe8 0x1c 0xfda 0x1e 0xfc9 0x1f 0xfb9 0x21 0xfab 0x23 0xf9c 0x25 0xf8f 0x27 0xf84 0x28 0xf76 0x2a 0xf69 0x2c 0xf56 0x2e 0xf43 0x30 0xf31 0x31 0xf24 0x34 0xf19 0x36 0xf0e 0x38 0xf06 0x39 0xf00 0x3b 0xef8 0x3d 0xef0 0x3f 0xeea 0x41 0xee5 0x42 0xedd 0x44 0xed9 0x46 0xed2 0x48 0xecd 0x4a 0xec8 0x4b 0xec2 0x4d 0xebc 0x4f 0xeb5 0x51 0xea9 0x54 0xea1 0x55 0xe95 0x57 0xe85 0x59 0xe73 0x5b 0xe6c 0x5c 0xe6b 0x5e 0xe69 0x60 0xe67 0x62 0xe54 0x64 0xe0d 0x65 0xda9 0x67 0xd3f 0x68 0xc55 0x69 0xc01 0x69 0xbce 0x69 0xbb0 0x69 0xb99 0x69 0xb8e 0x69 0xb82 0x69 0xb76 0x69 0xb6d 0x69 0xb61 0x69 0xb5e 0x69 0xb54 0x69 0xb4b 0x69 0xb4b 0x69 0xb4b 0x69 0xb4b 0x69 0xb4b 0x69 0xb4b 0x69 0xb4b 0x69 0xb4b 0x69 0xb4b 0x69 0xb4b 0x69 0xb4b 0x69 0xb4b 0x69 0xb4b>;
		battery_profile_t3_num = <0x52>;
		battery_profile_t3 = <0x00 0x10eb 0x02 0x10d1 0x03 0x10bc 0x05 0x10a9 0x07 0x1094 0x0a 0x1081 0x0b 0x106e 0x0d 0x105c 0x0f 0x104a 0x10 0x1039 0x12 0x1027 0x14 0x1017 0x16 0x1006 0x17 0xff5 0x1a 0xfe5 0x1c 0xfd6 0x1d 0xfc6 0x1f 0xfb7 0x21 0xfaa 0x23 0xf9c 0x24 0xf90 0x26 0xf82 0x28 0xf76 0x29 0xf6b 0x2c 0xf5e 0x2e 0xf51 0x2f 0xf40 0x31 0xf2c 0x33 0xf1c 0x35 0xf11 0x36 0xf08 0x38 0xefe 0x3b 0xef8 0x3c 0xef0 0x3e 0xee9 0x40 0xee3 0x42 0xede 0x43 0xed8 0x45 0xed2 0x47 0xece 0x48 0xec8 0x4a 0xec1 0x4d 0xeb3 0x4f 0xeae 0x50 0xea6 0x52 0xe9e 0x54 0xe95 0x55 0xe8b 0x57 0xe7d 0x59 0xe6e 0x5b 0xe5e 0x5d 0xe5c 0x5f 0xe5b 0x61 0xe5a 0x62 0xe55 0x64 0xe29 0x66 0xddb 0x68 0xda7 0x69 0xd82 0x6b 0xd03 0x6d 0xc44 0x6d 0xc06 0x6d 0xbd9 0x6d 0xbb9 0x6d 0xba4 0x6e 0xb90 0x6e 0xb80 0x6e 0xb74 0x6e 0xb69 0x6e 0xb61 0x6e 0xb57 0x6e 0xb53 0x6e 0xb49 0x6e 0xb49 0x6e 0xb49 0x6e 0xb49 0x6e 0xb49 0x6e 0xb49 0x6e 0xb49 0x6e 0xb49 0x6e 0xb49 0x6e 0xb49>;
		r_profile_t0_num = <0x52>;
		r_profile_t0 = <0x198 0x10cf 0x198 0x10b9 0x19f 0x10a5 0x1a9 0x1090 0x1ae 0x1079 0x1b8 0x1062 0x1cf 0x1049 0x1ea 0x1031 0x20d 0x1015 0x23d 0xff8 0x267 0xfe4 0x28a 0xfcf 0x2a3 0xfb3 0x2ad 0xf9d 0x2c1 0xf8d 0x2c9 0xf7f 0x2d0 0xf74 0x2dd 0xf66 0x2d8 0xf59 0x2e2 0xf49 0x2d5 0xf37 0x2df 0xf28 0x2e9 0xf1d 0x2ec 0xf11 0x2f8 0xf08 0x305 0xeff 0x30f 0xef6 0x323 0xeef 0x334 0xeea 0x343 0xee3 0x35f 0xede 0x378 0xed8 0x387 0xed4 0x39d 0xecf 0x3bb 0xecb 0x3cf 0xec5 0x3e8 0xebf 0x40b 0xeba 0x422 0xeb0 0x442 0xea8 0x451 0xe9e 0x46f 0xe93 0x490 0xe89 0x4ba 0xe81 0x4e7 0xe78 0x541 0xe72 0x596 0xe68 0x5ee 0xe51 0x622 0xe1d 0x652 0xdc6 0x684 0xd8a 0x64d 0xd74 0x61b 0xd60 0x5e6 0xd4c 0x5b4 0xd35 0x578 0xd1d 0x535 0xd04 0x503 0xcee 0x4d1 0xcdb 0x4ae 0xcca 0x483 0xcbb 0x468 0xcad 0x445 0xca2 0x433 0xc95 0x41d 0xc8c 0x3ff 0xc84 0x3fa 0xc79 0x3ed 0xc72 0x3d2 0xc6b 0x3c0 0xc60 0x3ac 0xc5a 0x37f 0xc55 0x37a 0xc4f 0x35f 0xc47 0x39d 0xc3d 0x37d 0xc35 0x37d 0xc35 0x37d 0xc35 0x37d 0xc35 0x37d 0xc35 0x37d 0xc35 0x37d 0xc35>;
		r_profile_t1_num = <0x52>;
		r_profile_t1 = <0x102 0x10dc 0x102 0x10bb 0x116 0x1094 0x12f 0x1072 0x14d 0x1059 0x157 0x1044 0x15e 0x1030 0x16d 0x1020 0x172 0x100d 0x172 0xffd 0x17c 0xff0 0x193 0xfe5 0x18b 0xfcf 0x193 0xfb7 0x193 0xfa3 0x19d 0xf95 0x1a2 0xf89 0x1a4 0xf7f 0x1a7 0xf73 0x19f 0xf64 0x19a 0xf53 0x190 0xf43 0x189 0xf33 0x189 0xf25 0x184 0xf18 0x18b 0xf0f 0x193 0xf06 0x195 0xefd 0x19f 0xef7 0x1a9 0xeef 0x1ae 0xee7 0x1bb 0xee3 0x1c2 0xedc 0x1d1 0xed7 0x1db 0xed2 0x1e3 0xece 0x1ea 0xec9 0x1f7 0xec6 0x208 0xec2 0x215 0xebd 0x221 0xeb8 0x233 0xeb1 0x24c 0xea9 0x258 0xe9e 0x260 0xe8f 0x267 0xe80 0x27b 0xe78 0x29e 0xe75 0x2c6 0xe72 0x2fd 0xe6c 0x348 0xe60 0x370 0xe29 0x393 0xdc8 0x438 0xd90 0x52b 0xd4b 0x523 0xcfb 0x49c 0xcc3 0x438 0xc9e 0x3f2 0xc83 0x3be 0xc6c 0x39d 0xc55 0x378 0xc45 0x35c 0xc34 0x32a 0xc25 0x314 0xc18 0x2fd 0xc0c 0x2bc 0xc07 0x2e9 0xbfb 0x2a8 0xbf2 0x2ad 0xbe7 0x28a 0xbe1 0x2ab 0xbd8 0x267 0xbd5 0x283 0xbca 0x294 0xbc0 0x27b 0xbba 0x212 0xbbb 0x280 0xbb3 0x253 0xba9 0x217 0xba7 0x1cf 0xba3 0x258 0xb97>;
		r_profile_t2_num = <0x52>;
		r_profile_t2 = <0x9b 0x10e8 0x9b 0x10cf 0x9b 0x10bb 0x9e 0x10a7 0x9e 0x1095 0xa3 0x1083 0xa5 0x1071 0xa5 0x105d 0xaa 0x104d 0xaa 0x103b 0xad 0x102a 0xad 0x1019 0xad 0x1008 0xb2 0xff7 0xb4 0xfe8 0xb9 0xfda 0xbc 0xfc9 0xbe 0xfb9 0xc8 0xfab 0xc8 0xf9c 0xcd 0xf8f 0xda 0xf84 0xd7 0xf76 0xd7 0xf69 0xc8 0xf56 0xbc 0xf43 0xad 0xf31 0xa8 0xf24 0xa3 0xf19 0xa0 0xf0e 0xa3 0xf06 0xa8 0xf00 0xaa 0xef8 0xaa 0xef0 0xaa 0xeea 0xb2 0xee5 0xaf 0xedd 0xb7 0xed9 0xb4 0xed2 0xb7 0xecd 0xb9 0xec8 0xb7 0xec2 0xb9 0xebc 0xb7 0xeb5 0xad 0xea9 0xad 0xea1 0xad 0xe95 0xad 0xe85 0xad 0xe73 0xaa 0xe6c 0xaf 0xe6b 0xb9 0xe69 0xc6 0xe67 0xcd 0xe54 0xd0 0xe0d 0xf0 0xda9 0x111 0xd3f 0x38c 0xc55 0x2c1 0xc01 0x253 0xbce 0x201 0xbb0 0x1d1 0xb99 0x19d 0xb8e 0x17c 0xb82 0x170 0xb76 0x168 0xb6d 0x14f 0xb61 0x113 0xb5e 0x13b 0xb54 0x11b 0xb4b 0x11b 0xb4b 0x11b 0xb4b 0x11b 0xb4b 0x11b 0xb4b 0x11b 0xb4b 0x11b 0xb4b 0x11b 0xb4b 0x11b 0xb4b 0x11b 0xb4b 0x11b 0xb4b 0x11b 0xb4b 0x11b 0xb4b>;
		r_profile_t3_num = <0x52>;
		r_profile_t3 = <0x7b 0x10eb 0x7b 0x10d1 0x80 0x10bc 0x82 0x10a9 0x82 0x1094 0x82 0x1081 0x80 0x106e 0x7d 0x105c 0x82 0x104a 0x85 0x1039 0x85 0x1027 0x8a 0x1017 0x8a 0x1006 0x8c 0xff5 0x8c 0xfe5 0x8f 0xfd6 0x8c 0xfc6 0x8f 0xfb7 0x94 0xfaa 0x99 0xf9c 0x9b 0xf90 0x9b 0xf82 0xa5 0xf76 0xaf 0xf6b 0xaf 0xf5e 0xb2 0xf51 0xaa 0xf40 0x94 0xf2c 0x87 0xf1c 0x87 0xf11 0x85 0xf08 0x85 0xefe 0x87 0xef8 0x87 0xef0 0x87 0xee9 0x8f 0xee3 0x91 0xede 0x94 0xed8 0x91 0xed2 0x99 0xece 0x96 0xec8 0x96 0xec1 0x85 0xeb3 0x8f 0xeae 0x8c 0xea6 0x8a 0xe9e 0x87 0xe95 0x87 0xe8b 0x85 0xe7d 0x85 0xe6e 0x82 0xe5e 0x82 0xe5c 0x8a 0xe5b 0x94 0xe5a 0xa0 0xe55 0x9e 0xe29 0xaa 0xddb 0xd0 0xda7 0xdc 0xd82 0x109 0xd03 0x357 0xc44 0x2d5 0xc06 0x258 0xbd9 0x210 0xbb9 0x1cc 0xba4 0x190 0xb90 0x17c 0xb80 0x163 0xb74 0x13b 0xb69 0x12f 0xb61 0x134 0xb57 0xff 0xb53 0x111 0xb49 0x111 0xb49 0x111 0xb49 0x111 0xb49 0x111 0xb49 0x111 0xb49 0x111 0xb49 0x111 0xb49 0x111 0xb49 0x111 0xb49>;
	};

	mt6355_gauge {
		compatible = "mediatek,mt6355_gauge";
		gauge_name = "gauge";
		alias_name = "MT6355";
	};

	gauge_timer {
		compatible = "mediatek,gauge_timer_service";
	};

	battery {
		compatible = "mediatek,bat_gm30";
		DIFFERENCE_FULLOCV_ITH = <0xc8>;
		MTK_CHR_EXIST = <0x01>;
		SHUTDOWN_1_TIME = <0x1e>;
		KEEP_100_PERCENT = <0x01>;
		R_FG_VALUE = <0x0a>;
		EMBEDDED_SEL = <0x01>;
		PMIC_SHUTDOWN_CURRENT = <0x14>;
		FG_METER_RESISTANCE = <0x4b>;
		CAR_TUNE_VALUE = <0x5c>;
		TEMPERATURE_T0 = <0x32>;
		TEMPERATURE_T1 = <0x19>;
		TEMPERATURE_T2 = <0x0a>;
		TEMPERATURE_T3 = <0x00>;
		TEMPERATURE_T4 = <0xfffffff6>;
		g_FG_PSEUDO100_T0 = <0x64>;
		g_FG_PSEUDO100_T1 = <0x64>;
		g_FG_PSEUDO100_T2 = <0x64>;
		g_FG_PSEUDO100_T3 = <0x64>;
		g_FG_PSEUDO100_T4 = <0x64>;
		Q_MAX_SYS_VOLTAGE_BAT0 = <0xd48>;
		Q_MAX_SYS_VOLTAGE_BAT1 = <0xd48>;
		Q_MAX_SYS_VOLTAGE_BAT2 = <0xd48>;
		Q_MAX_SYS_VOLTAGE_BAT3 = <0xd48>;
		PSEUDO1_IQ_OFFSET_BAT0 = <0x00>;
		PSEUDO1_IQ_OFFSET_BAT1 = <0x00>;
		PSEUDO1_IQ_OFFSET_BAT2 = <0x00>;
		PSEUDO1_IQ_OFFSET_BAT3 = <0x00>;
		battery0_profile_t0_num = <0x64>;
		battery0_profile_t0_col = <0x03>;
		battery0_profile_t0 = <0x00 0xab8d 0x354 0x198 0xab08 0x354 0x32f 0xaa86 0x358 0x4c7 0xaa08 0x35c 0x65e 0xa990 0x35c 0x7f6 0xa91c 0x362 0x98d 0xa8a6 0x364 0xb25 0xa830 0x364 0xcbd 0xa7ba 0x363 0xe54 0xa743 0x364 0xfec 0xa6cd 0x364 0x1183 0xa658 0x367 0x131b 0xa5e3 0x36d 0x14b2 0xa56f 0x36b 0x164a 0xa4fb 0x36b 0x17e2 0xa488 0x36e 0x1979 0xa417 0x373 0x1b11 0xa3a5 0x373 0x1ca8 0xa336 0x374 0x1e40 0xa2c7 0x379 0x1fd8 0xa258 0x37c 0x216f 0xa1e9 0x37a 0x2307 0xa17c 0x382 0x249e 0xa111 0x383 0x2636 0xa0a8 0x385 0x27cd 0xa040 0x38c 0x2965 0x9fd8 0x392 0x2afd 0x9f71 0x397 0x2c94 0x9f0d 0x39d 0x2e2c 0x9eab 0x3a3 0x2fc3 0x9e4f 0x3a9 0x315b 0x9df1 0x3ba 0x32f2 0x9d8b 0x3be 0x348a 0x9d23 0x3be 0x3622 0x9cc2 0x3d5 0x37b9 0x9c73 0x3de 0x3951 0x9c23 0x3e7 0x3ae8 0x9bd2 0x3f1 0x3c80 0x9b7c 0x3f7 0x3e17 0x9b2c 0x40f 0x3faf 0x9add 0x42b 0x4147 0x9a8d 0x448 0x42de 0x9a3a 0x466 0x4476 0x99de 0x471 0x460d 0x9962 0x43e 0x47a5 0x98d7 0x3ea 0x493c 0x984c 0x390 0x4ad4 0x97e9 0x373 0x4c6c 0x979b 0x36e 0x4e03 0x9756 0x36d 0x4f9b 0x9717 0x36b 0x5132 0x96dc 0x36b 0x52ca 0x96a5 0x36b 0x5462 0x9670 0x36b 0x55f9 0x963c 0x36a 0x5791 0x9608 0x364 0x5928 0x95d9 0x363 0x5ac0 0x95ad 0x36f 0x5c57 0x9582 0x37e 0x5def 0x9557 0x381 0x5f87 0x952d 0x382 0x611e 0x9507 0x38b 0x62b6 0x94e3 0x395 0x644d 0x94bd 0x39b 0x65e5 0x949a 0x3a7 0x677c 0x947a 0x3b2 0x6914 0x945a 0x3bb 0x6aac 0x943a 0x3c2 0x6c43 0x941d 0x3cf 0x6ddb 0x93fd 0x3d5 0x6f72 0x93d8 0x3d5 0x710a 0x93ac 0x3c8 0x72a1 0x9369 0x392 0x7439 0x9327 0x376 0x75d1 0x92f2 0x371 0x7768 0x92c8 0x37c 0x7900 0x929e 0x384 0x7a97 0x926c 0x37d 0x7c2f 0x923d 0x376 0x7dc6 0x9212 0x373 0x7f5e 0x91ed 0x375 0x80f6 0x91c9 0x384 0x828d 0x919a 0x38a 0x8425 0x915f 0x386 0x85bc 0x9119 0x37b 0x8754 0x90de 0x388 0x88ec 0x9096 0x386 0x8a83 0x9049 0x372 0x8c1b 0x9004 0x357 0x8db2 0x8ff6 0x36a 0x8f4a 0x8fee 0x385 0x90e1 0x8fe4 0x3a6 0x9279 0x8fd7 0x3cd 0x9411 0x8fc4 0x400 0x95a8 0x8f76 0x41a 0x9740 0x8e8b 0x3f9 0x98d7 0x8d07 0x3cc 0x9a6f 0x8b0b 0x3ee 0x9c06 0x8849 0x43a 0x9d9e 0x8444 0x4e2>;
		battery0_profile_t1_num = <0x64>;
		battery0_profile_t1_col = <0x03>;
		battery0_profile_t1 = <0x00 0xab5b 0x546 0x198 0xaad7 0x546 0x32f 0xaa57 0x550 0x4c7 0xa9db 0x55b 0x65e 0xa960 0x55c 0x7f6 0xa8e5 0x556 0x98d 0xa86c 0x559 0xb25 0xa7f4 0x562 0xcbd 0xa77c 0x56c 0xe54 0xa708 0x56c 0xfec 0xa694 0x56c 0x1183 0xa620 0x56c 0x131b 0xa5ac 0x56d 0x14b2 0xa536 0x572 0x164a 0xa4c4 0x56e 0x17e2 0xa454 0x57c 0x1979 0xa3e5 0x58d 0x1b11 0xa376 0x57b 0x1ca8 0xa309 0x585 0x1e40 0xa29c 0x599 0x1fd8 0xa231 0x5b0 0x216f 0xa1c6 0x5c0 0x2307 0xa159 0x5c0 0x249e 0xa0ec 0x5c1 0x2636 0xa081 0x5c5 0x27cd 0xa017 0x5d1 0x2965 0x9fb8 0x5e2 0x2afd 0x9f72 0x603 0x2c94 0x9f37 0x641 0x2e2c 0x9ef9 0x68e 0x2fc3 0x9e7e 0x67c 0x315b 0x9dd0 0x649 0x32f2 0x9d21 0x629 0x348a 0x9c86 0x628 0x3622 0x9c10 0x639 0x37b9 0x9bb9 0x656 0x3951 0x9b78 0x678 0x3ae8 0x9b46 0x69e 0x3c80 0x9b20 0x6c8 0x3e17 0x9ae5 0x6d8 0x3faf 0x9a9c 0x6df 0x4147 0x9a47 0x6d4 0x42de 0x99e5 0x6af 0x4476 0x9972 0x674 0x460d 0x98f4 0x61d 0x47a5 0x987a 0x5c0 0x493c 0x980d 0x572 0x4ad4 0x97b7 0x560 0x4c6c 0x976b 0x552 0x4e03 0x9727 0x546 0x4f9b 0x96ea 0x53c 0x5132 0x96b2 0x53c 0x52ca 0x967c 0x542 0x5462 0x9649 0x54c 0x55f9 0x961a 0x559 0x5791 0x95eb 0x56a 0x5928 0x95bd 0x566 0x5ac0 0x9590 0x55d 0x5c57 0x9565 0x55b 0x5def 0x953f 0x572 0x5f87 0x951a 0x586 0x611e 0x94f4 0x583 0x62b6 0x94d0 0x583 0x644d 0x94af 0x59b 0x65e5 0x948b 0x599 0x677c 0x946c 0x5a6 0x6914 0x944f 0x5b2 0x6aac 0x9431 0x5b1 0x6c43 0x9415 0x5b1 0x6ddb 0x93f6 0x5bb 0x6f72 0x93d9 0x5c3 0x710a 0x93bf 0x5c5 0x72a1 0x93a0 0x5b4 0x7439 0x9384 0x5a3 0x75d1 0x9364 0x590 0x7768 0x9342 0x582 0x7900 0x931d 0x584 0x7a97 0x92f2 0x578 0x7c2f 0x92ca 0x56f 0x7dc6 0x92a4 0x56d 0x7f5e 0x927f 0x573 0x80f6 0x9252 0x579 0x828d 0x9216 0x57e 0x8425 0x91d4 0x588 0x85bc 0x9192 0x59b 0x8754 0x9158 0x5c7 0x88ec 0x9107 0x5df 0x8a83 0x90bc 0x5e8 0x8c1b 0x9086 0x5ec 0x8db2 0x9076 0x618 0x8f4a 0x9067 0x64e 0x90e1 0x905a 0x695 0x9279 0x904a 0x6ea 0x9411 0x9026 0x741 0x95a8 0x8fa6 0x7af 0x9740 0x8e8c 0x7cb 0x98d7 0x8cd6 0x7c4 0x9a6f 0x8a95 0x809 0x9c06 0x8759 0x8b7 0x9d9e 0x8214 0xabe>;
		battery0_profile_t2_num = <0x64>;
		battery0_profile_t2_col = <0x03>;
		battery0_profile_t2 = <0x00 0xab5b 0x546 0x198 0xaad7 0x546 0x32f 0xaa57 0x550 0x4c7 0xa9db 0x55b 0x65e 0xa960 0x55c 0x7f6 0xa8e5 0x556 0x98d 0xa86c 0x559 0xb25 0xa7f4 0x562 0xcbd 0xa77c 0x56c 0xe54 0xa708 0x56c 0xfec 0xa694 0x56c 0x1183 0xa620 0x56c 0x131b 0xa5ac 0x56d 0x14b2 0xa536 0x572 0x164a 0xa4c4 0x56e 0x17e2 0xa454 0x57c 0x1979 0xa3e5 0x58d 0x1b11 0xa376 0x57b 0x1ca8 0xa309 0x585 0x1e40 0xa29c 0x599 0x1fd8 0xa231 0x5b0 0x216f 0xa1c6 0x5c0 0x2307 0xa159 0x5c0 0x249e 0xa0ec 0x5c1 0x2636 0xa081 0x5c5 0x27cd 0xa017 0x5d1 0x2965 0x9fb8 0x5e2 0x2afd 0x9f72 0x603 0x2c94 0x9f37 0x641 0x2e2c 0x9ef9 0x68e 0x2fc3 0x9e7e 0x67c 0x315b 0x9dd0 0x649 0x32f2 0x9d21 0x629 0x348a 0x9c86 0x628 0x3622 0x9c10 0x639 0x37b9 0x9bb9 0x656 0x3951 0x9b78 0x678 0x3ae8 0x9b46 0x69e 0x3c80 0x9b20 0x6c8 0x3e17 0x9ae5 0x6d8 0x3faf 0x9a9c 0x6df 0x4147 0x9a47 0x6d4 0x42de 0x99e5 0x6af 0x4476 0x9972 0x674 0x460d 0x98f4 0x61d 0x47a5 0x987a 0x5c0 0x493c 0x980d 0x572 0x4ad4 0x97b7 0x560 0x4c6c 0x976b 0x552 0x4e03 0x9727 0x546 0x4f9b 0x96ea 0x53c 0x5132 0x96b2 0x53c 0x52ca 0x967c 0x542 0x5462 0x9649 0x54c 0x55f9 0x961a 0x559 0x5791 0x95eb 0x56a 0x5928 0x95bd 0x566 0x5ac0 0x9590 0x55d 0x5c57 0x9565 0x55b 0x5def 0x953f 0x572 0x5f87 0x951a 0x586 0x611e 0x94f4 0x583 0x62b6 0x94d0 0x583 0x644d 0x94af 0x59b 0x65e5 0x948b 0x599 0x677c 0x946c 0x5a6 0x6914 0x944f 0x5b2 0x6aac 0x9431 0x5b1 0x6c43 0x9415 0x5b1 0x6ddb 0x93f6 0x5bb 0x6f72 0x93d9 0x5c3 0x710a 0x93bf 0x5c5 0x72a1 0x93a0 0x5b4 0x7439 0x9384 0x5a3 0x75d1 0x9364 0x590 0x7768 0x9342 0x582 0x7900 0x931d 0x584 0x7a97 0x92f2 0x578 0x7c2f 0x92ca 0x56f 0x7dc6 0x92a4 0x56d 0x7f5e 0x927f 0x573 0x80f6 0x9252 0x579 0x828d 0x9216 0x57e 0x8425 0x91d4 0x588 0x85bc 0x9192 0x59b 0x8754 0x9158 0x5c7 0x88ec 0x9107 0x5df 0x8a83 0x90bc 0x5e8 0x8c1b 0x9086 0x5ec 0x8db2 0x9076 0x618 0x8f4a 0x9067 0x64e 0x90e1 0x905a 0x695 0x9279 0x904a 0x6ea 0x9411 0x9026 0x741 0x95a8 0x8fa6 0x7af 0x9740 0x8e8c 0x7cb 0x98d7 0x8cd6 0x7c4 0x9a6f 0x8a95 0x809 0x9c06 0x8759 0x8b7 0x9d9e 0x8214 0xabe>;
		battery0_profile_t3_num = <0x64>;
		battery0_profile_t3_col = <0x03>;
		battery0_profile_t3 = <0x00 0xaa16 0x13dd 0x198 0xa8fd 0x13dd 0x32f 0xa825 0x13f1 0x4c7 0xa77a 0x1474 0x65e 0xa6ea 0x15a1 0x7f6 0xa663 0x16b0 0x98d 0xa5df 0x168d 0xb25 0xa55e 0x15de 0xcbd 0xa4e1 0x1515 0xe54 0xa46b 0x14eb 0xfec 0xa3f8 0x15fc 0x1183 0xa388 0x16f1 0x131b 0xa319 0x1743 0x14b2 0xa2a8 0x167e 0x164a 0xa236 0x15ff 0x17e2 0xa1c6 0x15b1 0x1979 0xa158 0x15cf 0x1b11 0xa0ee 0x16cf 0x1ca8 0xa093 0x178f 0x1e40 0xa042 0x17bd 0x1fd8 0x9ff2 0x1780 0x216f 0x9f98 0x1711 0x2307 0x9f2b 0x170b 0x249e 0x9ea4 0x1781 0x2636 0x9e06 0x1824 0x27cd 0x9d56 0x189f 0x2965 0x9cb3 0x17d5 0x2afd 0x9c29 0x16fd 0x2c94 0x9bb1 0x1663 0x2e2c 0x9b4a 0x163a 0x2fc3 0x9af7 0x16eb 0x315b 0x9aa9 0x17f5 0x32f2 0x9a5c 0x186c 0x348a 0x9a0e 0x1818 0x3622 0x99b6 0x1702 0x37b9 0x9959 0x1660 0x3951 0x98f9 0x1688 0x3ae8 0x989a 0x1748 0x3c80 0x9840 0x1835 0x3e17 0x97e8 0x1774 0x3faf 0x9797 0x168c 0x4147 0x974b 0x15ed 0x42de 0x9702 0x15fa 0x4476 0x96c0 0x1743 0x460d 0x9681 0x17ec 0x47a5 0x9646 0x17c7 0x493c 0x9610 0x16d7 0x4ad4 0x95dc 0x164f 0x4c6c 0x95ad 0x1686 0x4e03 0x9581 0x175e 0x4f9b 0x9557 0x1894 0x5132 0x952d 0x192f 0x52ca 0x9506 0x1897 0x5462 0x94e1 0x17e0 0x55f9 0x94be 0x1760 0x5791 0x949d 0x1743 0x5928 0x9485 0x17f4 0x5ac0 0x9471 0x190d 0x5c57 0x9460 0x1a14 0x5def 0x944e 0x1a56 0x5f87 0x943b 0x1986 0x611e 0x9429 0x18e0 0x62b6 0x9418 0x1899 0x644d 0x9405 0x18dd 0x65e5 0x93f7 0x1a5e 0x677c 0x93e7 0x1b67 0x6914 0x93d3 0x1ba5 0x6aac 0x93b9 0x1afe 0x6c43 0x939f 0x1a6f 0x6ddb 0x9385 0x1b1e 0x6f72 0x9366 0x1c80 0x710a 0x9341 0x1de8 0x72a1 0x9314 0x1d48 0x7439 0x92e2 0x1ce0 0x75d1 0x92ae 0x1da3 0x7768 0x9279 0x1f68 0x7900 0x9240 0x2128 0x7a97 0x91fc 0x20ca 0x7c2f 0x91b8 0x20a4 0x7dc6 0x9177 0x2170 0x7f5e 0x913b 0x23e7 0x80f6 0x910c 0x2675 0x828d 0x90e2 0x280f 0x8425 0x90ba 0x28d6 0x85bc 0x908d 0x290a 0x8754 0x9052 0x2997 0x88ec 0x8fff 0x2b1d 0x8a83 0x8f7d 0x2d81 0x8c1b 0x8eb5 0x308d 0x8db2 0x8d68 0x331d 0x8f4a 0x8bc3 0x3530 0x90e1 0x89df 0x33b5 0x9279 0x87ea 0x2ed0 0x9411 0x84e3 0x2740 0x95a8 0x8475 0x262c 0x9740 0x8475 0x262c 0x98d7 0x8475 0x262c 0x9a6f 0x8475 0x262c 0x9c06 0x8475 0x262c 0x9d9e 0x8475 0x262c>;
		battery0_profile_t4_num = <0x64>;
		battery0_profile_t4_col = <0x03>;
		battery0_profile_t4 = <0x00 0xaa16 0x13dd 0x198 0xa8fd 0x13dd 0x32f 0xa825 0x13f1 0x4c7 0xa77a 0x1474 0x65e 0xa6ea 0x15a1 0x7f6 0xa663 0x16b0 0x98d 0xa5df 0x168d 0xb25 0xa55e 0x15de 0xcbd 0xa4e1 0x1515 0xe54 0xa46b 0x14eb 0xfec 0xa3f8 0x15fc 0x1183 0xa388 0x16f1 0x131b 0xa319 0x1743 0x14b2 0xa2a8 0x167e 0x164a 0xa236 0x15ff 0x17e2 0xa1c6 0x15b1 0x1979 0xa158 0x15cf 0x1b11 0xa0ee 0x16cf 0x1ca8 0xa093 0x178f 0x1e40 0xa042 0x17bd 0x1fd8 0x9ff2 0x1780 0x216f 0x9f98 0x1711 0x2307 0x9f2b 0x170b 0x249e 0x9ea4 0x1781 0x2636 0x9e06 0x1824 0x27cd 0x9d56 0x189f 0x2965 0x9cb3 0x17d5 0x2afd 0x9c29 0x16fd 0x2c94 0x9bb1 0x1663 0x2e2c 0x9b4a 0x163a 0x2fc3 0x9af7 0x16eb 0x315b 0x9aa9 0x17f5 0x32f2 0x9a5c 0x186c 0x348a 0x9a0e 0x1818 0x3622 0x99b6 0x1702 0x37b9 0x9959 0x1660 0x3951 0x98f9 0x1688 0x3ae8 0x989a 0x1748 0x3c80 0x9840 0x1835 0x3e17 0x97e8 0x1774 0x3faf 0x9797 0x168c 0x4147 0x974b 0x15ed 0x42de 0x9702 0x15fa 0x4476 0x96c0 0x1743 0x460d 0x9681 0x17ec 0x47a5 0x9646 0x17c7 0x493c 0x9610 0x16d7 0x4ad4 0x95dc 0x164f 0x4c6c 0x95ad 0x1686 0x4e03 0x9581 0x175e 0x4f9b 0x9557 0x1894 0x5132 0x952d 0x192f 0x52ca 0x9506 0x1897 0x5462 0x94e1 0x17e0 0x55f9 0x94be 0x1760 0x5791 0x949d 0x1743 0x5928 0x9485 0x17f4 0x5ac0 0x9471 0x190d 0x5c57 0x9460 0x1a14 0x5def 0x944e 0x1a56 0x5f87 0x943b 0x1986 0x611e 0x9429 0x18e0 0x62b6 0x9418 0x1899 0x644d 0x9405 0x18dd 0x65e5 0x93f7 0x1a5e 0x677c 0x93e7 0x1b67 0x6914 0x93d3 0x1ba5 0x6aac 0x93b9 0x1afe 0x6c43 0x939f 0x1a6f 0x6ddb 0x9385 0x1b1e 0x6f72 0x9366 0x1c80 0x710a 0x9341 0x1de8 0x72a1 0x9314 0x1d48 0x7439 0x92e2 0x1ce0 0x75d1 0x92ae 0x1da3 0x7768 0x9279 0x1f68 0x7900 0x9240 0x2128 0x7a97 0x91fc 0x20ca 0x7c2f 0x91b8 0x20a4 0x7dc6 0x9177 0x2170 0x7f5e 0x913b 0x23e7 0x80f6 0x910c 0x2675 0x828d 0x90e2 0x280f 0x8425 0x90ba 0x28d6 0x85bc 0x908d 0x290a 0x8754 0x9052 0x2997 0x88ec 0x8fff 0x2b1d 0x8a83 0x8f7d 0x2d81 0x8c1b 0x8eb5 0x308d 0x8db2 0x8d68 0x331d 0x8f4a 0x8bc3 0x3530 0x90e1 0x89df 0x33b5 0x9279 0x87ea 0x2ed0 0x9411 0x84e3 0x2740 0x95a8 0x8475 0x262c 0x9740 0x8475 0x262c 0x98d7 0x8475 0x262c 0x9a6f 0x8475 0x262c 0x9c06 0x8475 0x262c 0x9d9e 0x8475 0x262c>;
		linux,phandle = <0x69>;
		phandle = <0x69>;
	};

	mt_charger {
		compatible = "mediatek,mt-charger";
		linux,phandle = <0x6a>;
		phandle = <0x6a>;
	};

	swtp {
		compatible = "mediatek, swtp-eint";
		linux,phandle = <0x6b>;
		phandle = <0x6b>;
	};

	pmic_clock_buffer {
		compatible = "mediatek,pmic_clock_buffer";
		mediatek,clkbuf-quantity = <0x04>;
		mediatek,clkbuf-config = <0x02 0x01 0x01 0x02>;
		mediatek,clkbuf-driving-current = <0x02 0x02 0x02 0x02>;
		linux,phandle = <0x6c>;
		phandle = <0x6c>;
	};

	usbphy@0 {
		compatible = "usb-nop-xceiv";
		linux,phandle = <0x6d>;
		phandle = <0x6d>;
	};

	chipid@08000000 {
		compatible = "mediatek,chipid";
		reg = <0x00 0x8000000 0x00 0x04 0x00 0x8000004 0x00 0x04 0x00 0x8000008 0x00 0x04 0x00 0x800000c 0x00 0x04>;
	};

	gic500@0c000000 {
		compatible = "mediatek,gic500";
		reg = <0x00 0xc000000 0x00 0x400000>;
	};

	gic_cpu@0c400000 {
		compatible = "mediatek,gic_cpu";
		reg = <0x00 0xc400000 0x00 0x40000>;
	};

	dfd@0c600000 {
		compatible = "mediatek,dfd";
		reg = <0x00 0xc600000 0x00 0x100000>;
		mediatek,enabled = <0x00>;
		mediatek,chain_length = <0xc350>;
		mediatek,rg_dfd_timeout = <0x02>;
	};

	dbg_etb@0d010000 {
		compatible = "mediatek,dbg_etb";
		reg = <0x00 0xd010000 0x00 0x10000>;
	};

	dbg_cti@0d020000 {
		compatible = "mediatek,dbg_cti";
		reg = <0x00 0xd020000 0x00 0x10000>;
	};

	dbg_etr@0d030000 {
		compatible = "mediatek,dbg_etr";
		reg = <0x00 0xd030000 0x00 0x10000>;
	};

	dbg_funnel@0d040000 {
		compatible = "mediatek,dbg_funnel";
		reg = <0x00 0xd040000 0x00 0x10000>;
	};

	dbg_dem@0d0a0000 {
		compatible = "mediatek,dbg_dem";
		reg = <0x00 0xd0a0000 0x00 0x10000>;
	};

	dbg_mdsys1@0d0c0000 {
		compatible = "mediatek,dbg_mdsys1";
		reg = <0x00 0xd0c0000 0x00 0x40000>;
	};

	dbg_apmcu_mp0@0d400000 {
		compatible = "mediatek,dbg_apmcu_mp0";
		reg = <0x00 0xd400000 0x00 0x400000>;
	};

	dbg_apmcu_mp1@0d800000 {
		compatible = "mediatek,dbg_apmcu_mp1";
		reg = <0x00 0xd800000 0x00 0x400000>;
	};

	cpu_dbgapb {
		compatible = "mediatek,hw_dbg";
		num = <0x08>;
		reg = <0x00 0xd410000 0x00 0x1000 0x00 0xd510000 0x00 0x1000 0x00 0xd610000 0x00 0x1000 0x00 0xd710000 0x00 0x1000 0x00 0xd810000 0x00 0x1000 0x00 0xd910000 0x00 0x1000 0x00 0xda10000 0x00 0x1000 0x00 0xdb10000 0x00 0x1000>;
		linux,phandle = <0x6e>;
		phandle = <0x6e>;
	};

	topckgen@10000000 {
		compatible = "mediatek,topckgen";
		reg = <0x00 0x10000000 0x00 0x1000>;
		#clock-cells = <0x01>;
		linux,phandle = <0x2b>;
		phandle = <0x2b>;
	};

	usb2jtag@10001000 {
		compatible = "mediatek,usb2jtag_v1";
		reg = <0x00 0x10001000 0x00 0x1000 0x00 0x11290000 0x00 0x1000 0x00 0x11210000 0x00 0x1000>;
		linux,phandle = <0x6f>;
		phandle = <0x6f>;
	};

	infracfg_ao@10001000 {
		compatible = "mediatek,infracfg_ao\0syscon";
		reg = <0x00 0x10001000 0x00 0x1000>;
		interrupts = <0x00 0x88 0x01>;
		#clock-cells = <0x01>;
		linux,phandle = <0x02>;
		phandle = <0x02>;
	};

	scpsys@10001000 {
		compatible = "mediatek,mt6757-scpsys";
		reg = <0x00 0x10001000 0x00 0x1000 0x00 0x10006000 0x00 0x1000 0x00 0x1020e000 0x00 0x1000 0x00 0x10000000 0x00 0x1000>;
		#clock-cells = <0x01>;
		linux,phandle = <0x2d>;
		phandle = <0x2d>;
	};

	iocfg_0@10002000 {
		compatible = "mediatek,iocfg_0";
		reg = <0x00 0x10002000 0x00 0x200>;
		linux,phandle = <0x24>;
		phandle = <0x24>;
	};

	iocfg_1@10002200 {
		compatible = "mediatek,iocfg_1";
		reg = <0x00 0x10002200 0x00 0x200>;
		linux,phandle = <0x25>;
		phandle = <0x25>;
	};

	iocfg_2@10002400 {
		compatible = "mediatek,iocfg_2";
		reg = <0x00 0x10002400 0x00 0x200>;
		linux,phandle = <0x26>;
		phandle = <0x26>;
	};

	iocfg_3@10002600 {
		compatible = "mediatek,iocfg_3";
		reg = <0x00 0x10002600 0x00 0x200>;
		linux,phandle = <0x27>;
		phandle = <0x27>;
	};

	iocfg_4@10002800 {
		compatible = "mediatek,iocfg_4";
		reg = <0x00 0x10002800 0x00 0x200>;
		linux,phandle = <0x28>;
		phandle = <0x28>;
	};

	iocfg_5@10002a00 {
		compatible = "mediatek,iocfg_5";
		reg = <0x00 0x10002a00 0x00 0x200>;
		linux,phandle = <0x29>;
		phandle = <0x29>;
	};

	pericfg@10003000 {
		compatible = "mediatek,pericfg";
		reg = <0x00 0x10003000 0x00 0x1000>;
	};

	gpio@10005000 {
		compatible = "mediatek,gpio";
		reg = <0x00 0x10005000 0x00 0x1000>;
		linux,phandle = <0x23>;
		phandle = <0x23>;
	};

	pinctrl@1000b000 {
		compatible = "mediatek,mt6757-pinctrl";
		reg_bases = <0x23 0x24 0x25 0x26 0x27 0x28 0x29>;
		reg_base_eint = <0x2a>;
		pins-are-numbered;
		gpio-controller;
		#gpio-cells = <0x02>;
		gpio-ranges = <0x0b 0x00 0x00 0xd5>;
		interrupt-controller;
		#interrupt-cells = <0x04>;
		interrupts = <0x00 0x9b 0x04>;
		linux,phandle = <0x0b>;
		phandle = <0x0b>;

		mmc0@default {
			linux,phandle = <0x03>;
			phandle = <0x03>;

			pins_cmd {
				drive-strength = [03];
			};

			pins_dat {
				drive-strength = [03];
			};

			pins_clk {
				drive-strength = [03];
			};

			pins_rst {
				drive-strength = [03];
			};

			pins_ds {
				drive-strength = [01];
			};
		};

		mmc0@register_default {
			datrddly = <0x00 0x00>;
			datwrddly = [00];
			cmdrrddly = [00];
			cmdrddly = [00];
			cmd_edge = [01];
			rdata_edge = [01];
			wdata_edge = [01];
			linux,phandle = <0x04>;
			phandle = <0x04>;
		};

		mmc1@default {
			linux,phandle = <0x06>;
			phandle = <0x06>;

			pins_cmd {
				drive-strength = [03];
			};

			pins_dat {
				drive-strength = [03];
			};

			pins_clk {
				drive-strength = [04];
			};
		};

		mmc1@sdr104 {
			linux,phandle = <0x07>;
			phandle = <0x07>;

			pins_cmd {
				drive-strength = [03];
			};

			pins_dat {
				drive-strength = [03];
			};

			pins_clk {
				drive-strength = [03];
			};
		};

		mmc1@sdr50 {
			linux,phandle = <0x08>;
			phandle = <0x08>;

			pins_cmd {
				drive-strength = [03];
			};

			pins_dat {
				drive-strength = [03];
			};

			pins_clk {
				drive-strength = [03];
			};
		};

		mmc1@ddr50 {
			linux,phandle = <0x09>;
			phandle = <0x09>;

			pins_cmd {
				drive-strength = [03];
			};

			pins_dat {
				drive-strength = [03];
			};

			pins_clk {
				drive-strength = [03];
			};
		};

		mmc1@register_default {
			datrddly = <0x00 0x00>;
			datwrddly = [00];
			cmdrrddly = [00];
			cmdrddly = [00];
			cmd_edge = [00];
			rdata_edge = [00];
			wdata_edge = [00];
			linux,phandle = <0x0a>;
			phandle = <0x0a>;
		};

		mmc2@default {
			linux,phandle = <0x0e>;
			phandle = <0x0e>;

			pins_cmd {
				drive-strength = [03];
			};

			pins_dat {
				drive-strength = [03];
			};

			pins_clk {
				drive-strength = [03];
			};
		};

		mmc2@register_default {
			datrddly = <0x00 0x00>;
			datwrddly = [00];
			cmdrrddly = [00];
			cmdrddly = [00];
			cmd_edge = [01];
			rdata_edge = [01];
			wdata_edge = [01];
			linux,phandle = <0x0f>;
			phandle = <0x0f>;
		};

		sgm3785_pin_default {
			linux,phandle = <0x42>;
			phandle = <0x42>;
		};

		sgm3785_en@1 {
			linux,phandle = <0x43>;
			phandle = <0x43>;

			pins_cmd_dat {
				pinmux = <0x800>;
				slew-rate = <0x01>;
				output-high;
			};
		};

		sgm3785_en@0 {
			linux,phandle = <0x44>;
			phandle = <0x44>;

			pins_cmd_dat {
				pinmux = <0x800>;
				slew-rate = <0x01>;
				output-low;
			};
		};

		sgm3785_mode@1 {
			linux,phandle = <0x45>;
			phandle = <0x45>;

			pins_cmd_dat {
				pinmux = <0x900>;
				slew-rate = <0x01>;
				output-high;
			};
		};

		sgm3785_mode@0 {
			linux,phandle = <0x46>;
			phandle = <0x46>;

			pins_cmd_dat {
				pinmux = <0x900>;
				slew-rate = <0x01>;
				output-low;
			};
		};

		flashlight_sgm3785_as_pwm {
			linux,phandle = <0x47>;
			phandle = <0x47>;

			pins_cmd_dat {
				pinmux = <0x901>;
				slew-rate = <0x01>;
			};
		};

		typec_default {
			linux,phandle = <0x3f>;
			phandle = <0x3f>;
		};

		typec_pin_eint_as_int_def {
			linux,phandle = <0x40>;
			phandle = <0x40>;

			pins_cmd_dat {
				pinmux = <0x6400>;
				slew-rate = <0x00>;
				bias-pull-up = <0x00>;
			};
		};

		typec_pin_usb_id_def {
			linux,phandle = <0x41>;
			phandle = <0x41>;

			pins_cmd_dat {
				pinmux = <0x2a01>;
				slew-rate = <0x00>;
				bias-pull-up = <0x00>;
			};
		};

		kpd_slide_default {
			linux,phandle = <0x5b>;
			phandle = <0x5b>;
		};

		kpd_slide_pin_def {
			linux,phandle = <0x5c>;
			phandle = <0x5c>;

			pins_cmd_dat {
				pinmux = <0x500>;
				slew-rate = <0x00>;
				bias-disable;
			};
		};

		finger_pins_default {
			linux,phandle = <0x48>;
			phandle = <0x48>;
		};

		finger_power_en@0 {
			linux,phandle = <0x49>;
			phandle = <0x49>;

			pins_cmd_dat {
				pinmux = <0xbf00>;
				slew-rate = <0x01>;
				output-low;
			};
		};

		finger_power_en@1 {
			linux,phandle = <0x4a>;
			phandle = <0x4a>;

			pins_cmd_dat {
				pinmux = <0xbf00>;
				slew-rate = <0x01>;
				output-high;
			};
		};

		finger_reset_en@0 {
			linux,phandle = <0x4b>;
			phandle = <0x4b>;

			pins_cmd_dat {
				pinmux = <0x1b00>;
				slew-rate = <0x01>;
				output-low;
			};
		};

		finger_reset_en@1 {
			linux,phandle = <0x4c>;
			phandle = <0x4c>;

			pins_cmd_dat {
				pinmux = <0x1b00>;
				slew-rate = <0x01>;
				output-high;
			};
		};

		finger_spi0_mi_as_spi0_mi@0 {
			linux,phandle = <0x4d>;
			phandle = <0x4d>;

			pins_cmd_dat {
				pinmux = <0x5f01>;
				slew-rate = <0x00>;
				bias-disable;
				output-low;
				input-schmitt-enable = <0x00>;
			};
		};

		finger_spi0_mi_as_gpio@0 {
			linux,phandle = <0x4e>;
			phandle = <0x4e>;

			pins_cmd_dat {
				pinmux = <0x5f00>;
				slew-rate = <0x00>;
				output-low;
				input-schmitt-enable = <0x00>;
			};
		};

		finger_spi0_mo_as_spi0_mo@0 {
			linux,phandle = <0x4f>;
			phandle = <0x4f>;

			pins_cmd_dat {
				pinmux = <0x6101>;
				slew-rate = <0x01>;
				bias-disable;
				output-low;
				input-schmitt-enable = <0x00>;
			};
		};

		finger_spi0_mo_as_gpio@0 {
			linux,phandle = <0x50>;
			phandle = <0x50>;

			pins_cmd_dat {
				pinmux = <0x6100>;
				slew-rate = <0x01>;
				output-low;
				input-schmitt-enable = <0x00>;
			};
		};

		finger_spi0_clk_as_spi0_clk@0 {
			linux,phandle = <0x51>;
			phandle = <0x51>;

			pins_cmd_dat {
				pinmux = <0x6201>;
				slew-rate = <0x01>;
				bias-disable;
				output-low;
				input-schmitt-enable = <0x00>;
			};
		};

		finger_spi0_clk_as_gpio@0 {
			linux,phandle = <0x52>;
			phandle = <0x52>;

			pins_cmd_dat {
				pinmux = <0x6200>;
				slew-rate = <0x01>;
				output-low;
				input-schmitt-enable = <0x00>;
			};
		};

		finger_spi0_cs_as_spi0_cs@0 {
			linux,phandle = <0x53>;
			phandle = <0x53>;

			pins_cmd_dat {
				pinmux = <0x6001>;
				slew-rate = <0x01>;
				bias-disable;
				output-low;
				input-schmitt-enable = <0x00>;
			};
		};

		finger_spi0_cs_as_gpio@0 {
			linux,phandle = <0x54>;
			phandle = <0x54>;

			pins_cmd_dat {
				pinmux = <0x6000>;
				slew-rate = <0x01>;
				output-low;
				input-schmitt-enable = <0x00>;
			};
		};

		finger_int_as_int@0 {
			linux,phandle = <0x55>;
			phandle = <0x55>;

			pins_cmd_dat {
				pinmux = <0x1500>;
				slew-rate = <0x00>;
				bias-pull-up = <0x00>;
			};
		};

		finger_eint_en0 {
			linux,phandle = <0x56>;
			phandle = <0x56>;

			pins_cmd_dat {
				pinmux = <0x1500>;
				slew-rate = <0x00>;
				bias-pull-down = <0x00>;
			};
		};

		finger_eint_en1 {
			linux,phandle = <0x57>;
			phandle = <0x57>;

			pins_cmd_dat {
				pinmux = <0x1500>;
				slew-rate = <0x00>;
				bias-pull-up = <0x00>;
			};
		};

		finger_eint_en2 {
			linux,phandle = <0x58>;
			phandle = <0x58>;

			pins_cmd_dat {
				pinmux = <0x1500>;
				slew-rate = <0x00>;
				bias-disable;
			};
		};

		finger_power_18v_en@0 {
			linux,phandle = <0x59>;
			phandle = <0x59>;
		};

		finger_power_18v_en@1 {
			linux,phandle = <0x5a>;
			phandle = <0x5a>;
		};
	};

	gpio {
		compatible = "mediatek,gpio_usage_mapping";
		GPIO_FDD_BAND_SUPPORT_DETECT_1ST_PIN = <0x3d>;
		GPIO_FDD_BAND_SUPPORT_DETECT_2ND_PIN = <0x4f>;
		linux,phandle = <0x70>;
		phandle = <0x70>;
	};

	sleep@10006000 {
		compatible = "mediatek,sleep";
		reg = <0x00 0x10006000 0x00 0x1000 0x00 0x11cf80 0x00 0x80>;
		interrupts = <0x00 0xa5 0x08 0x00 0xa6 0x08 0x00 0xa7 0x08 0x00 0xa8 0x08 0x00 0xa9 0x08 0x00 0xaa 0x08 0x00 0xab 0x08 0x00 0xac 0x08>;
	};

	toprgu@10007000 {
		compatible = "mediatek,mt6757-toprgu";
		reg = <0x00 0x10007000 0x00 0x1000>;
		interrupts = <0x00 0x82 0x02>;
	};

	apxgpt@10008000 {
		compatible = "mediatek,mt6757-timer\0mediatek,mt6577-timer";
		reg = <0x00 0x10008000 0x00 0x1000>;
		interrupts = <0x00 0x9a 0x08>;
		clocks = <0x2b 0x58 0x2c>;
	};

	hacc@1000a000 {
		compatible = "mediatek,hacc";
		reg = <0x00 0x1000a000 0x00 0x1000>;
		interrupts = <0x00 0xad 0x08>;
	};

	eintc@1000b000 {
		compatible = "mediatek,mt-eic";
		reg = <0x00 0x1000b000 0x00 0x1000>;
		interrupts = <0x00 0x9b 0x04>;
		mediatek,max_hw_deb_cnt = <0x10>;
		mediatek,max_deint_cnt = <0x04>;
		mediatek,deint_possible_irq = <0xbf 0xc0 0xc1 0xc2>;
		#interrupt-cells = <0x02>;
		interrupt-controller;
		mediatek,max_eint_num = <0xa0>;
		mediatek,mapping_table_entry = <0x00>;
		mediatek,debtime_setting_entry = <0x0a>;
		mediatek,debtime_setting_array = <0x00 0x80 0x01 0x100 0x02 0x200 0x03 0x400 0x04 0x4000 0x05 0x8000 0x06 0x10000 0x07 0x20000 0x08 0x40000 0x09 0x80000>;
		linux,phandle = <0x2a>;
		phandle = <0x2a>;
	};

	apmixed@1000c000 {
		compatible = "mediatek,apmixed";
		reg = <0x00 0x1000c000 0x00 0xf00 0x00 0x10006000 0x00 0x1000>;
		#clock-cells = <0x01>;
		linux,phandle = <0x36>;
		phandle = <0x36>;
	};

	fhctl@1000ce00 {
		compatible = "mediatek,fhctl";
		reg = <0x00 0x1000ce00 0x00 0x100>;
	};

	pwrap@1000d000 {
		compatible = "mediatek,pwrap";
		reg = <0x00 0x1000d000 0x00 0x1000>;
		interrupts = <0x00 0xa3 0x04>;
	};

	mt-pmic {
		compatible = "mediatek,mt-pmic";
		interrupt-controller;
		linux,phandle = <0x71>;
		phandle = <0x71>;

		mt635x-auxadc {
			compatible = "mediatek,mt635x-auxadc";
			#io-channel-cells = <0x01>;
			linux,phandle = <0x72>;
			phandle = <0x72>;

			batadc {
				channel = <0x00>;
				resistance-ratio = <0x03 0x01>;
				avg-num = <0x80>;
			};

			vcdt {
				channel = <0x02>;
			};

			bat_temp {
				channel = <0x03>;
				resistance-ratio = <0x02 0x01>;
			};

			batid {
				channel = <0x04>;
				resistance-ratio = <0x02 0x01>;
			};

			chip_temp {
				channel = <0x05>;
			};

			accdet {
				channel = <0x09>;
			};

			tsx_temp {
				channel = <0x0b>;
				avg-num = <0x80>;
			};

			hpofs_cal {
				channel = <0x0c>;
				avg-num = <0x100>;
			};

			dcxo_temp {
				channel = <0x0d>;
				avg-num = <0x10>;
			};

			vbif {
				channel = <0x0e>;
				resistance-ratio = <0x02 0x01>;
			};
		};

		buck_regulators {
			compatible = "mediatek,mt_pmic_buck_regulators";

			buck_vdram2 {
				regulator-name = "vdram2";
				regulator-min-microvolt = <0x61a80>;
				regulator-max-microvolt = <0x123716>;
				regulator-ramp-delay = <0x186a>;
				regulator-enable-ramp-delay = <0xdc>;
				linux,phandle = <0x73>;
				phandle = <0x73>;
			};

			buck_vs1 {
				regulator-name = "vs1";
				regulator-min-microvolt = <0x124f80>;
				regulator-max-microvolt = <0x2a88ac>;
				regulator-ramp-delay = <0x30d4>;
				regulator-enable-ramp-delay = <0xdc>;
				linux,phandle = <0x74>;
				phandle = <0x74>;
			};

			buck_vdram1 {
				regulator-name = "vdram1";
				regulator-min-microvolt = <0x7ea5e>;
				regulator-max-microvolt = <0x1406f4>;
				regulator-ramp-delay = <0x186a>;
				regulator-enable-ramp-delay = <0xdc>;
				linux,phandle = <0x75>;
				phandle = <0x75>;
			};

			buck_vmodem {
				regulator-name = "vmodem";
				regulator-min-microvolt = <0x61a80>;
				regulator-max-microvolt = <0x123716>;
				regulator-ramp-delay = <0x186a>;
				regulator-enable-ramp-delay = <0xdc>;
				linux,phandle = <0x76>;
				phandle = <0x76>;
			};

			buck_vcore {
				regulator-name = "vcore";
				regulator-min-microvolt = <0x632ea>;
				regulator-max-microvolt = <0x124f80>;
				regulator-ramp-delay = <0x186a>;
				regulator-enable-ramp-delay = <0xdc>;
				linux,phandle = <0x77>;
				phandle = <0x77>;
			};

			buck_vs2 {
				regulator-name = "vs2";
				regulator-min-microvolt = <0x124f80>;
				regulator-max-microvolt = <0x2a88ac>;
				regulator-ramp-delay = <0x30d4>;
				regulator-enable-ramp-delay = <0xdc>;
				linux,phandle = <0x78>;
				phandle = <0x78>;
			};

			buck_vpa {
				regulator-name = "vpa";
				regulator-min-microvolt = <0x7a120>;
				regulator-max-microvolt = <0x37b1d0>;
				regulator-ramp-delay = <0xc350>;
				regulator-enable-ramp-delay = <0xdc>;
				linux,phandle = <0x79>;
				phandle = <0x79>;
			};

			buck_vproc12 {
				regulator-name = "vproc12";
				regulator-min-microvolt = <0x632ea>;
				regulator-max-microvolt = <0x124f80>;
				regulator-ramp-delay = <0x186a>;
				regulator-enable-ramp-delay = <0xdc>;
				linux,phandle = <0x7a>;
				phandle = <0x7a>;
			};

			buck_vgpu {
				regulator-name = "vgpu";
				regulator-min-microvolt = <0x632ea>;
				regulator-max-microvolt = <0x124f80>;
				regulator-ramp-delay = <0x186a>;
				regulator-enable-ramp-delay = <0xdc>;
				linux,phandle = <0x7b>;
				phandle = <0x7b>;
			};

			buck_vproc11 {
				regulator-name = "vproc11";
				regulator-min-microvolt = <0x632ea>;
				regulator-max-microvolt = <0x124f80>;
				regulator-ramp-delay = <0x186a>;
				regulator-enable-ramp-delay = <0xdc>;
				linux,phandle = <0x7c>;
				phandle = <0x7c>;
			};
		};

		ldo_regulators {
			compatible = "mediatek,mt_pmic_ldo_regulators";

			ldo_vcamd1 {
				regulator-name = "vcamd1";
				regulator-min-microvolt = <0xdbba0>;
				regulator-max-microvolt = <0x124f80>;
				regulator-enable-ramp-delay = <0x108>;
				linux,phandle = <0x7d>;
				phandle = <0x7d>;
			};

			ldo_vsim1 {
				regulator-name = "vsim1";
				regulator-min-microvolt = <0x19f0a0>;
				regulator-max-microvolt = <0x2f4d60>;
				regulator-enable-ramp-delay = <0x108>;
				linux,phandle = <0x7e>;
				phandle = <0x7e>;
			};

			ldo_vgp {
				regulator-name = "vgp";
				regulator-min-microvolt = <0x16e360>;
				regulator-max-microvolt = <0x325aa0>;
				regulator-enable-ramp-delay = <0x108>;
				linux,phandle = <0x7f>;
				phandle = <0x7f>;
			};

			ldo_vusb33 {
				compatible = "regulator-fixed";
				regulator-name = "vusb33";
				regulator-min-microvolt = <0x2dc6c0>;
				regulator-max-microvolt = <0x2dc6c0>;
				regulator-enable-ramp-delay = <0x108>;
				linux,phandle = <0x80>;
				phandle = <0x80>;
			};

			ldo_vrf12 {
				compatible = "regulator-fixed";
				regulator-name = "vrf12";
				regulator-min-microvolt = <0x124f80>;
				regulator-max-microvolt = <0x124f80>;
				regulator-enable-ramp-delay = <0x6e>;
				linux,phandle = <0x81>;
				phandle = <0x81>;
			};

			ldo_vcamio {
				compatible = "regulator-fixed";
				regulator-name = "vcamio";
				regulator-min-microvolt = <0x1b7740>;
				regulator-max-microvolt = <0x1b7740>;
				regulator-enable-ramp-delay = <0x108>;
				linux,phandle = <0x3e>;
				phandle = <0x3e>;
			};

			ldo_vcn18 {
				compatible = "regulator-fixed";
				regulator-name = "vcn18";
				regulator-min-microvolt = <0x1b7740>;
				regulator-max-microvolt = <0x1b7740>;
				regulator-enable-ramp-delay = <0x108>;
				linux,phandle = <0x82>;
				phandle = <0x82>;
			};

			ldo_vfe28 {
				compatible = "regulator-fixed";
				regulator-name = "vfe28";
				regulator-min-microvolt = <0x2ab980>;
				regulator-max-microvolt = <0x2ab980>;
				regulator-enable-ramp-delay = <0x108>;
				linux,phandle = <0x83>;
				phandle = <0x83>;
			};

			ldo_vrf18_2 {
				compatible = "regulator-fixed";
				regulator-name = "vrf18_2";
				regulator-min-microvolt = <0x1b9e50>;
				regulator-max-microvolt = <0x1b9e50>;
				regulator-enable-ramp-delay = <0x6e>;
				linux,phandle = <0x84>;
				phandle = <0x84>;
			};

			ldo_va18 {
				compatible = "regulator-fixed";
				regulator-name = "va18";
				regulator-min-microvolt = <0x1b7740>;
				regulator-max-microvolt = <0x1b7740>;
				regulator-enable-ramp-delay = <0x108>;
				linux,phandle = <0x85>;
				phandle = <0x85>;
			};

			ldo_vcn28 {
				compatible = "regulator-fixed";
				regulator-name = "vcn28";
				regulator-min-microvolt = <0x2ab980>;
				regulator-max-microvolt = <0x2ab980>;
				regulator-enable-ramp-delay = <0x108>;
				linux,phandle = <0x86>;
				phandle = <0x86>;
			};

			ldo_vmipi {
				regulator-name = "vmipi";
				regulator-min-microvolt = <0x19f0a0>;
				regulator-max-microvolt = <0x200b20>;
				regulator-enable-ramp-delay = <0x108>;
				linux,phandle = <0x87>;
				phandle = <0x87>;
			};

			ldo_vsram_gpu {
				regulator-name = "vsram_gpu";
				regulator-min-microvolt = <0x7ea5e>;
				regulator-max-microvolt = <0x1406f4>;
				regulator-ramp-delay = <0x186a>;
				regulator-enable-ramp-delay = <0x6e>;
				linux,phandle = <0x88>;
				phandle = <0x88>;
			};

			ldo_vsram_core {
				regulator-name = "vsram_core";
				regulator-min-microvolt = <0x7ea5e>;
				regulator-max-microvolt = <0x1406f4>;
				regulator-ramp-delay = <0x186a>;
				regulator-enable-ramp-delay = <0x6e>;
				linux,phandle = <0x89>;
				phandle = <0x89>;
			};

			ldo_vsram_proc {
				regulator-name = "vsram_proc";
				regulator-min-microvolt = <0x7ea5e>;
				regulator-max-microvolt = <0x1406f4>;
				regulator-ramp-delay = <0x186a>;
				regulator-enable-ramp-delay = <0x6e>;
				linux,phandle = <0x8a>;
				phandle = <0x8a>;
			};

			ldo_vxo22 {
				regulator-name = "vxo22";
				regulator-min-microvolt = <0x2191c0>;
				regulator-max-microvolt = <0x231860>;
				regulator-enable-ramp-delay = <0x6e>;
				linux,phandle = <0x8b>;
				phandle = <0x8b>;
			};

			ldo_vrf18_1 {
				compatible = "regulator-fixed";
				regulator-name = "vrf18_1";
				regulator-min-microvolt = <0x1b9e50>;
				regulator-max-microvolt = <0x1b9e50>;
				regulator-enable-ramp-delay = <0x6e>;
				linux,phandle = <0x8c>;
				phandle = <0x8c>;
			};

			ldo_vcamd2 {
				regulator-name = "vcamd2";
				regulator-min-microvolt = <0xdbba0>;
				regulator-max-microvolt = <0x1b7740>;
				regulator-enable-ramp-delay = <0x108>;
				linux,phandle = <0x8d>;
				phandle = <0x8d>;
			};

			ldo_vmch {
				regulator-name = "vmch";
				regulator-min-microvolt = <0x2c4020>;
				regulator-max-microvolt = <0x325aa0>;
				regulator-enable-ramp-delay = <0x24>;
				linux,phandle = <0x0c>;
				phandle = <0x0c>;
			};

			ldo_vcama1 {
				regulator-name = "vcama1";
				regulator-min-microvolt = <0x1b7740>;
				regulator-max-microvolt = <0x2dc6c0>;
				regulator-enable-ramp-delay = <0x108>;
				linux,phandle = <0x8e>;
				phandle = <0x8e>;
			};

			ldo_vtcxo24 {
				compatible = "regulator-fixed";
				regulator-name = "vtcxo24";
				regulator-min-microvolt = <0x231860>;
				regulator-max-microvolt = <0x231860>;
				regulator-enable-ramp-delay = <0x6e>;
				linux,phandle = <0x8f>;
				phandle = <0x8f>;
			};

			ldo_vio28 {
				compatible = "regulator-fixed";
				regulator-name = "vio28";
				regulator-min-microvolt = <0x2ab980>;
				regulator-max-microvolt = <0x2ab980>;
				regulator-enable-ramp-delay = <0x108>;
				linux,phandle = <0x90>;
				phandle = <0x90>;
			};

			ldo_vemc {
				regulator-name = "vemc";
				regulator-min-microvolt = <0x2c4020>;
				regulator-max-microvolt = <0x325aa0>;
				regulator-enable-ramp-delay = <0x24>;
				linux,phandle = <0x05>;
				phandle = <0x05>;
			};

			ldo_va12 {
				compatible = "regulator-fixed";
				regulator-name = "va12";
				regulator-min-microvolt = <0x124f80>;
				regulator-max-microvolt = <0x124f80>;
				regulator-enable-ramp-delay = <0x108>;
				linux,phandle = <0x91>;
				phandle = <0x91>;
			};

			ldo_va10 {
				regulator-name = "va10";
				regulator-min-microvolt = <0x927c0>;
				regulator-max-microvolt = <0x200b20>;
				regulator-enable-ramp-delay = <0x108>;
				linux,phandle = <0x92>;
				phandle = <0x92>;
			};

			ldo_vgp2 {
				regulator-name = "vgp2";
				regulator-min-microvolt = <0x124f80>;
				regulator-max-microvolt = <0x325aa0>;
				regulator-enable-ramp-delay = <0x24>;
				linux,phandle = <0x93>;
				phandle = <0x93>;
			};

			ldo_vio18 {
				compatible = "regulator-fixed";
				regulator-name = "vio18";
				regulator-min-microvolt = <0x1b7740>;
				regulator-max-microvolt = <0x1b7740>;
				regulator-enable-ramp-delay = <0x108>;
				linux,phandle = <0x94>;
				phandle = <0x94>;
			};

			ldo_vcn33_bt {
				regulator-name = "vcn33_bt";
				regulator-min-microvolt = <0x325aa0>;
				regulator-max-microvolt = <0x3567e0>;
				regulator-enable-ramp-delay = <0x108>;
				linux,phandle = <0x95>;
				phandle = <0x95>;
			};

			ldo_vcn33_wifi {
				regulator-name = "vcn33_wifi";
				regulator-min-microvolt = <0x325aa0>;
				regulator-max-microvolt = <0x3567e0>;
				regulator-enable-ramp-delay = <0x108>;
				linux,phandle = <0x96>;
				phandle = <0x96>;
			};

			ldo_vsram_md {
				regulator-name = "vsram_md";
				regulator-min-microvolt = <0x7ea5e>;
				regulator-max-microvolt = <0x1406f4>;
				regulator-ramp-delay = <0x186a>;
				regulator-enable-ramp-delay = <0x6e>;
				linux,phandle = <0x97>;
				phandle = <0x97>;
			};

			ldo_vbif28 {
				compatible = "regulator-fixed";
				regulator-name = "vbif28";
				regulator-min-microvolt = <0x2ab980>;
				regulator-max-microvolt = <0x2ab980>;
				regulator-enable-ramp-delay = <0x108>;
				linux,phandle = <0x98>;
				phandle = <0x98>;
			};

			ldo_vufs18 {
				compatible = "regulator-fixed";
				regulator-name = "vufs18";
				regulator-min-microvolt = <0x1b7740>;
				regulator-max-microvolt = <0x1b7740>;
				regulator-enable-ramp-delay = <0x108>;
				linux,phandle = <0x99>;
				phandle = <0x99>;
			};

			ldo_vcama2 {
				regulator-name = "vcama2";
				regulator-min-microvolt = <0x1b7740>;
				regulator-max-microvolt = <0x2dc6c0>;
				regulator-enable-ramp-delay = <0x108>;
				linux,phandle = <0x9a>;
				phandle = <0x9a>;
			};

			ldo_vmc {
				regulator-name = "vmc";
				regulator-min-microvolt = <0x1b7740>;
				regulator-max-microvolt = <0x325aa0>;
				regulator-enable-ramp-delay = <0x24>;
				linux,phandle = <0x0d>;
				phandle = <0x0d>;
			};

			ldo_vldo28 {
				regulator-name = "vldo28";
				regulator-min-microvolt = <0x2ab980>;
				regulator-max-microvolt = <0x2dc6c0>;
				regulator-enable-ramp-delay = <0x108>;
				linux,phandle = <0x9b>;
				phandle = <0x9b>;
			};

			ldo_vldo28_tp {
				regulator-name = "vldo28_tp";
				regulator-min-microvolt = <0x2ab980>;
				regulator-max-microvolt = <0x2dc6c0>;
				regulator-enable-ramp-delay = <0x108>;
				linux,phandle = <0x9c>;
				phandle = <0x9c>;
			};

			ldo_vxo18 {
				compatible = "regulator-fixed";
				regulator-name = "vxo18";
				regulator-min-microvolt = <0x1b9e50>;
				regulator-max-microvolt = <0x1b9e50>;
				regulator-enable-ramp-delay = <0x6e>;
				linux,phandle = <0x9d>;
				phandle = <0x9d>;
			};

			ldo_vsim2 {
				regulator-name = "vsim2";
				regulator-min-microvolt = <0x19f0a0>;
				regulator-max-microvolt = <0x2f4d60>;
				regulator-enable-ramp-delay = <0x108>;
				linux,phandle = <0x9e>;
				phandle = <0x9e>;
			};
		};
	};

	devapc_ao@1000e000 {
		compatible = "mediatek,devapc_ao";
		reg = <0x00 0x1000e000 0x00 0x1000>;
	};

	mrdump_ext_rst {
		compatible = "mediatek, mrdump_ext_rst-eint";
		source = "EINT";
		mode = "IRQ";
		status = "okay";
		linux,phandle = <0x9f>;
		phandle = <0x9f>;
	};

	keypad@10010000 {
		compatible = "mediatek,kp";
		reg = <0x00 0x10010000 0x00 0x1000>;
		interrupts = <0x00 0xa4 0x02>;
		linux,phandle = <0xa0>;
		phandle = <0xa0>;
	};

	topmisc@10011000 {
		compatible = "mediatek,topmisc";
		reg = <0x00 0x10011000 0x00 0x1000>;
	};

	mdcldma@10014000 {
		compatible = "mediatek,mdcldma";
		reg = <0x00 0x10014000 0x00 0x1000 0x00 0x10015000 0x00 0x1000 0x00 0x1021b000 0x00 0x1000 0x00 0x1021c000 0x00 0x1000 0x00 0x10209000 0x00 0x1000 0x00 0x1020a000 0x00 0x1000>;
		interrupts = <0x00 0xfb 0x04 0x00 0x8b 0x08 0x00 0xfc 0x02>;
		mediatek,md_id = <0x00>;
		mediatek,cldma_capability = <0x06>;
		clocks = <0x2d 0x01 0x02 0x37 0x02 0x2f 0x02 0x32 0x02 0x29 0x02 0x2a 0x02 0x19 0x02 0x1a 0x02 0x1b 0x02 0x1d 0x02 0x20 0x02 0x24>;
		clock-names = "scp-sys-md1-main\0infra-cldma-ap\0infra-ccif-ap\0infra-ccif-md\0infra-ap-c2k-ccif-0\0infra-ap-c2k-ccif-1\0infra-md2md-ccif-0\0infra-md2md-ccif-1\0infra-md2md-ccif-2\0infra-md2md-ccif-3\0infra-md2md-ccif-4\0infra-md2md-ccif-5";
		linux,phandle = <0xa1>;
		phandle = <0xa1>;
	};

	aes_top0@10016000 {
		compatible = "mediatek,aes_top0";
		reg = <0x00 0x10016000 0x00 0x1000>;
	};

	aes_top1@10017000 {
		compatible = "mediatek,aes_top1";
		reg = <0x00 0x10017000 0x00 0x1000>;
	};

	modem_temp_share@10018000 {
		compatible = "mediatek,modem_temp_share";
		reg = <0x00 0x10018000 0x00 0x1000>;
	};

	dbgapb_base@1011a000 {
		compatible = "mediatek,dbgapb_base";
		reg = <0x00 0x1011a000 0x00 0x100>;
	};

	mcucfg@10200000 {
		compatible = "mediatek,mcucfg";
		reg = <0x00 0x10200000 0x00 0x4000>;
		interrupts = <0x00 0x00 0x08>;
	};

	sys_cirq@10204000 {
		compatible = "mediatek,sys_cirq";
		reg = <0x00 0x10204000 0x00 0x1000>;
		interrupts = <0x00 0x118 0x08>;
		mediatek,cirq_num = <0xd1>;
		mediatek,spi_start_offset = <0x48>;
		mediatek,edge_trig_irqs_for_spm-quantity = <0x05>;
		mediatek,edge_trig_irqs_for_spm = <0xa2 0xc4 0x119 0x11c 0x12c>;
	};

	m4u@10205000 {
		cell-index = <0x00>;
		compatible = "mediatek,m4u";
		reg = <0x00 0x10205000 0x00 0x1000>;
		interrupts = <0x00 0x93 0x08>;
		clocks = <0x2e 0x01 0x2e 0x02 0x2f 0x02 0x30 0x01 0x31 0x01 0x31 0x02 0x2e 0x03 0x32 0x07 0x2d 0x07 0x2d 0x06 0x2d 0x05 0x2d 0x03 0x2d 0x0a>;
		clock-names = "m4u_smi_common\0m4u_smi_larb0\0m4u_smi_larb1\0m4u_smi_larb2\0m4u_smi_larb3\0m4u_smi_larb3_2\0m4u_smi_larb4\0m4u_smi_larb5\0m4u_mtcmos_ven\0m4u_mtcmos_vde\0m4u_mtcmos_isp\0m4u_mtcmos_dis\0m4u_mtcmos_cam";
	};

	efusec@10206000 {
		compatible = "mediatek,efusec";
		reg = <0x00 0x10206000 0x00 0x1000>;
	};

	devapc@10207000 {
		compatible = "mediatek,devapc";
		reg = <0x00 0x10207000 0x00 0x1000>;
		interrupts = <0x00 0x85 0x08>;
		clocks = <0x02 0x2d>;
		clock-names = "devapc-main";
	};

	bus_dbg@10208000 {
		compatible = "mediatek,bus_dbg-v2";
		reg = <0x00 0x10208000 0x00 0x1000>;
		interrupts = <0x00 0x84 0x08>;
	};

	ap2c2k_ccif@1020b000 {
		compatible = "mediatek,ap2c2k_ccif";
		reg = <0x00 0x1020b000 0x00 0x1000 0x00 0x10211000 0x00 0x300 0x00 0x10213000 0x00 0x300>;
		interrupts = <0x00 0x8d 0x08 0x00 0xf9 0x02>;
		cell-index = <0x02>;
		ccif,major = <0xa9>;
		ccif,minor_base = <0x00>;
		ccif,capability = <0x02>;
		mediatek,md_smem_size = <0x400000>;
		clocks = <0x2d 0x0b>;
		clock-names = "scp-sys-c2k-main";
	};

	md_ccif1@1020c000 {
		compatible = "mediatek,md_ccif1";
		reg = <0x00 0x1020c000 0x00 0x1000>;
	};

	infra_mbist@1020d000 {
		compatible = "mediatek,infra_mbist";
		reg = <0x00 0x1020d000 0x00 0x1000>;
	};

	infracfg@1020e000 {
		compatible = "mediatek,infracfg";
		reg = <0x00 0x1020e000 0x00 0x1000>;
	};

	trng@1020f000 {
		compatible = "mediatek,trng";
		reg = <0x00 0x1020f000 0x00 0x1000>;
		interrupts = <0x00 0x8c 0x08>;
	};

	gcpu@10210000 {
		compatible = "mediatek,gcpu";
		reg = <0x00 0x10210000 0x00 0x1000>;
		interrupts = <0x00 0x96 0x08>;
	};

	md2md_md1_ccif0@10211000 {
		compatible = "mediatek,md2md_md1_ccif0";
		reg = <0x00 0x10211000 0x00 0x1000>;
	};

	gce@10212000 {
		compatible = "mediatek,gce";
		reg = <0x00 0x10212000 0x00 0x1000>;
		interrupts = <0x00 0x8f 0x08 0x00 0x90 0x08>;
		g3d_config_base = <0x13000000 0x00 0xffff0000>;
		mmsys_config_base = <0x14000000 0x01 0xffff0000>;
		disp_dither_base = <0x14010000 0x02 0xffff0000>;
		mm_na_base = <0x14020000 0x03 0xffff0000>;
		imgsys_base = <0x15000000 0x04 0xffff0000>;
		vdec_gcon_base = <0x16000000 0x05 0xffff0000>;
		venc_gcon_base = <0x17000000 0x06 0xffff0000>;
		conn_peri_base = <0x18000000 0x07 0xffff0000>;
		topckgen_base = <0x10000000 0x08 0xffff0000>;
		kp_base = <0x10010000 0x09 0xffff0000>;
		scp_sram_base = <0x10020000 0x0a 0xffff0000>;
		infra_na3_base = <0x10030000 0x0b 0xffff0000>;
		infra_na4_base = <0x10040000 0x0c 0xffff0000>;
		scp_base = <0x10050000 0x0d 0xffff0000>;
		mcucfg_base = <0x10200000 0x0e 0xffff0000>;
		gcpu_base = <0x10210000 0x0f 0xffff0000>;
		usb0_base = <0x11200000 0x10 0xffff0000>;
		usb_sif_base = <0x11210000 0x11 0xffff0000>;
		audio_base = <0x11220000 0x12 0xffff0000>;
		msdc0_base = <0x11230000 0x13 0xffff0000>;
		msdc1_base = <0x11240000 0x14 0xffff0000>;
		msdc2_base = <0x11250000 0x15 0xffff0000>;
		msdc3_base = <0x11260000 0x16 0xffff0000>;
		ap_dma_base = <0x11000000 0x17 0xffff0000>;
		smi_larb1_base = <0x16010000 0x18 0xffff0000>;
		vdec_base = <0x16020000 0x19 0xffff0000>;
		disp_rdma0_sof = <0x00>;
		disp_rdma1_sof = <0x01>;
		mdp_rdma0_sof = <0x03>;
		mdp_rdma1_sof = <0x04>;
		mdp_rsz1_sof = <0x06>;
		mdp_rsz2_sof = <0x07>;
		mdp_tdshp_sof = <0x08>;
		mdp_color_sof = <0x09>;
		mdp_wrot0_sof = <0x0b>;
		mdp_wrot1_sof = <0x0c>;
		disp_ovl0_sof = <0x0d>;
		disp_ovl1_sof = <0x0e>;
		disp_2l_ovl0_sof = <0x0f>;
		disp_2l_ovl1_sof = <0x10>;
		disp_wdma0_sof = <0x11>;
		disp_wdma1_sof = <0x12>;
		disp_color_sof = <0x13>;
		disp_ccorr_sof = <0x15>;
		disp_aal_sof = <0x17>;
		disp_gamma_sof = <0x19>;
		disp_dither_sof = <0x1c>;
		disp_ufoe_sof = <0x1e>;
		disp_pwm0_sof = <0x20>;
		disp_dsi0_sof = <0x21>;
		disp_dsi1_sof = <0x22>;
		disp_rdma0_frame_done = <0x23>;
		disp_rdma1_frame_done = <0x24>;
		mdp_rdma0_frame_done = <0x26>;
		mdp_rdma1_frame_done = <0x27>;
		mdp_rsz1_frame_done = <0x29>;
		mdp_rsz2_frame_done = <0x2a>;
		mdp_tdshp_frame_done = <0x2b>;
		mdp_color_frame_done = <0x2c>;
		mdp_wrot0_write_frame_done = <0x2e>;
		mdp_wrot0_read_frame_done = <0x2f>;
		mdp_wrot1_write_frame_done = <0x30>;
		mdp_wrot1_read_frame_done = <0x31>;
		disp_ovl0_frame_done = <0x32>;
		disp_ovl1_frame_done = <0x33>;
		disp_2l_ovl0_frame_done = <0x34>;
		disp_2l_ovl1_frame_done = <0x35>;
		disp_wdma0_frame_done = <0x36>;
		disp_wdma1_frame_done = <0x37>;
		disp_color_frame_done = <0x38>;
		disp_ccorr_frame_done = <0x3a>;
		disp_aal_frame_done = <0x3c>;
		disp_gamma_frame_done = <0x3e>;
		disp_dither_frame_done = <0x41>;
		disp_ufoe_frame_done = <0x43>;
		disp_dsi0_frame_done = <0x45>;
		disp_dsi1_frame_done = <0x46>;
		disp_dpi0_frame_done = <0x47>;
		stream_done_0 = <0x82>;
		stream_done_1 = <0x83>;
		stream_done_2 = <0x84>;
		stream_done_3 = <0x85>;
		stream_done_4 = <0x86>;
		stream_done_5 = <0x87>;
		stream_done_6 = <0x88>;
		stream_done_7 = <0x89>;
		stream_done_8 = <0x8a>;
		stream_done_9 = <0x8b>;
		stream_done_10 = <0x8c>;
		stream_done_11 = <0x8d>;
		stream_done_12 = <0x8e>;
		stream_done_13 = <0x8f>;
		stream_done_14 = <0x90>;
		stream_done_15 = <0x91>;
		buf_underrun_event_0 = <0x92>;
		buf_underrun_event_1 = <0x93>;
		dsi0_te_event = <0x97>;
		dsi0_to_gce_mmck0 = <0x98>;
		dsi0_to_gce_mmck1 = <0x99>;
		dsi0_to_gce_mmck2 = <0x9a>;
		dsi0_to_gce_mmck3 = <0x9b>;
		dsi0_to_gce_mmck4 = <0x9c>;
		dsi1_te_event = <0x9d>;
		dsi1_to_gce_mmck0 = <0x9e>;
		dsi1_to_gce_mmck1 = <0x9f>;
		dsi1_to_gce_mmck2 = <0xa0>;
		dsi1_to_gce_mmck3 = <0xa1>;
		dsi1_to_gce_mmck4 = <0xa2>;
		disp_wdma0_rst_done = <0xa3>;
		disp_wdma1_rst_done = <0xa4>;
		mdp_wrot1_rst_done = <0xa5>;
		mdp_wrot0_rst_done = <0xa6>;
		mdp_rdma1_rst_done = <0xa8>;
		mdp_rdma0_rst_done = <0xa9>;
		disp_mutex_all_module_upd0 = <0xab>;
		disp_mutex_all_module_upd1 = <0xac>;
		disp_mutex_all_module_upd2 = <0xad>;
		disp_mutex_all_module_upd3 = <0xae>;
		disp_mutex_all_module_upd4 = <0xaf>;
		disp_mutex_all_module_upd5 = <0xb0>;
		disp_mutex_all_module_upd6 = <0xb1>;
		disp_mutex_all_module_upd7 = <0xb2>;
		disp_mutex_all_module_upd8 = <0xb3>;
		disp_mutex_all_module_upd9 = <0xb4>;
		disp_mutex_all_module_upd10 = <0xb5>;
		disp_mutex_all_module_upd11 = <0xb6>;
		disp_mutex_all_module_upd12 = <0xb7>;
		disp_mutex_all_module_upd13 = <0xb8>;
		disp_mutex_all_module_upd14 = <0xb9>;
		disp_mutex_all_module_upd15 = <0xba>;
		disp_mutex_reg_upd_for_module0 = <0xbb>;
		disp_mutex_reg_upd_for_module1 = <0xbc>;
		disp_mutex_reg_upd_for_module2 = <0xbd>;
		disp_mutex_reg_upd_for_module3 = <0xbe>;
		disp_mutex_reg_upd_for_module4 = <0xbf>;
		disp_mutex_reg_upd_for_module5 = <0xc0>;
		disp_mutex_reg_upd_for_module6 = <0xc1>;
		disp_mutex_reg_upd_for_module7 = <0xc2>;
		disp_mutex_reg_upd_for_module8 = <0xc3>;
		disp_mutex_reg_upd_for_module9 = <0xc4>;
		disp_mutex_reg_upd_for_module10 = <0xc5>;
		disp_mutex_reg_upd_for_module11 = <0xc6>;
		disp_mutex_reg_upd_for_module12 = <0xc7>;
		disp_mutex_reg_upd_for_module13 = <0xc8>;
		disp_mutex_reg_upd_for_module14 = <0xc9>;
		disp_mutex_reg_upd_for_module15 = <0xca>;
		disp_mutex_reg_upd_for_module16 = <0xcb>;
		disp_mutex_reg_upd_for_module17 = <0xcc>;
		disp_mutex_reg_upd_for_module18 = <0xcd>;
		disp_mutex_reg_upd_for_module19 = <0xce>;
		disp_mutex_reg_upd_for_module20 = <0xcf>;
		disp_mutex_reg_upd_for_module21 = <0xd0>;
		disp_mutex_reg_upd_for_module22 = <0xd1>;
		disp_mutex_reg_upd_for_module23 = <0xd2>;
		disp_mutex_reg_upd_for_module24 = <0xd3>;
		disp_mutex_reg_upd_for_module25 = <0xd4>;
		disp_mutex_reg_upd_for_module26 = <0xd5>;
		disp_mutex_reg_upd_for_module27 = <0xd6>;
		disp_mutex_reg_upd_for_module28 = <0xd7>;
		disp_mutex_reg_upd_for_module29 = <0xd8>;
		disp_mutex_reg_upd_for_module30 = <0xd9>;
		disp_mutex_reg_upd_for_module31 = <0xda>;
		disp_mutex_reg_upd_for_module32 = <0xdb>;
		disp_mutex_reg_upd_for_module33 = <0xdc>;
		disp_mutex_reg_upd_for_module34 = <0xdd>;
		dip_cq_thread0_frame_done = <0x101>;
		dip_cq_thread1_frame_done = <0x102>;
		dip_cq_thread2_frame_done = <0x103>;
		dip_cq_thread3_frame_done = <0x104>;
		dip_cq_thread4_frame_done = <0x105>;
		dip_cq_thread5_frame_done = <0x106>;
		dip_cq_thread6_frame_done = <0x107>;
		dip_cq_thread7_frame_done = <0x108>;
		dip_cq_thread8_frame_done = <0x109>;
		dip_cq_thread9_frame_done = <0x10a>;
		dip_cq_thread10_frame_done = <0x10b>;
		dip_cq_thread11_frame_done = <0x10c>;
		dip_cq_thread12_frame_done = <0x10d>;
		dip_cq_thread13_frame_done = <0x10e>;
		dip_cq_thread14_frame_done = <0x10f>;
		dve_frame_done = <0x110>;
		wmf_frame_done = <0x111>;
		gepf_frame_done = <0x112>;
		gepf_temp_frame_done = <0x113>;
		gepf_bypass_frame_done = <0x114>;
		rsc_frame_done = <0x115>;
		venc_done = <0x121>;
		jpgdec_done = <0x122>;
		jpgenc_done = <0x123>;
		venc_mb_done = <0x124>;
		venc_128byte_cnt_done = <0x125>;
		isp_frame_done_a = <0x141>;
		isp_frame_done_b = <0x142>;
		camsv_0_pass1_done = <0x143>;
		camsv_1_pass1_done = <0x144>;
		camsv_2_pass1_done = <0x145>;
		tsf_done = <0x146>;
		seninf_0_fifo_full = <0x147>;
		seninf_1_fifo_full = <0x148>;
		seninf_2_fifo_full = <0x149>;
		seninf_3_fifo_full = <0x14a>;
		seninf_4_fifo_full = <0x14b>;
		seninf_5_fifo_full = <0x14c>;
		seninf_6_fifo_full = <0x14d>;
		seninf_7_fifo_full = <0x14e>;
		max_prefetch_cnt = <0x04>;
		prefetch_size = <0xa0 0x20 0x20 0x20>;
		sram_share_cnt = <0x02>;
		sram_share_engine = <0x0b 0x0c>;
		sram_share_event = <0x1cc 0x1cd>;
		clocks = <0x02 0x09>;
		clock-names = "GCE";
		mmsys_dummy_reg_offset = <0x8ac>;
	};

	cqdma@10212c00 {
		compatible = "mediatek,mt-cqdma-v1";
		reg = <0x00 0x10212c00 0x00 0x100 0x00 0x10212d00 0x00 0x100>;
		interrupts = <0x00 0x71 0x08 0x00 0x72 0x08>;
		nr_channel = <0x02>;
		clocks = <0x02 0x09>;
		clock-names = "cqdma";
	};

	md2md_md2_ccif0@10213000 {
		compatible = "mediatek,md2md_md2_ccif0";
		reg = <0x00 0x10213000 0x00 0x1000>;
	};

	sramrom@10214000 {
		compatible = "mediatek,sramrom";
		reg = <0x00 0x10214000 0x00 0x1000>;
	};

	mipi_tx0@10215000 {
		compatible = "mediatek,mipi_tx0";
		reg = <0x00 0x10215000 0x00 0x1000>;
	};

	mipi_tx1@10216000 {
		compatible = "mediatek,mipi_tx1";
		reg = <0x00 0x10216000 0x00 0x1000>;
	};

	mipi_rx_ana_csi0@10217000 {
		compatible = "mediatek,mipi_rx_ana_csi0";
		reg = <0x00 0x10217000 0x00 0x1000>;
	};

	mipi_rx_ana_csi1@10218000 {
		compatible = "mediatek,mipi_rx_ana_csi1";
		reg = <0x00 0x10218000 0x00 0x1000>;
	};

	emi@10219000 {
		compatible = "mediatek,emi";
		reg = <0x00 0x10219000 0x00 0x1000>;
		interrupts = <0x00 0x87 0x04>;
	};

	gcpu_rsa@1021a000 {
		compatible = "mediatek,gcpu_rsa";
		reg = <0x00 0x1021a000 0x00 0x1000>;
	};

	infra_md@1021d000 {
		compatible = "mediatek,infra_md";
		reg = <0x00 0x1021d000 0x00 0x1000>;
	};

	bpi_bsi_slv0@1021e000 {
		compatible = "mediatek,bpi_bsi_slv0";
		reg = <0x00 0x1021e000 0x00 0x1000>;
	};

	bpi_bsi_slv1@1021f000 {
		compatible = "mediatek,bpi_bsi_slv1";
		reg = <0x00 0x1021f000 0x00 0x6000>;
	};

	bpi_bsi_slv2@10225000 {
		compatible = "mediatek,bpi_bsi_slv2";
		reg = <0x00 0x10225000 0x00 0x1000>;
	};

	emi_mpu@10226000 {
		compatible = "mediatek,emi_mpu";
		reg = <0x00 0x10226000 0x00 0x1000>;
		interrupts = <0x00 0x75 0x04>;
	};

	dvfsp@10227000 {
		compatible = "mediatek,mt6757-dvfsp";
		reg = <0x00 0x10227000 0x00 0x1000 0x00 0x11c000 0x00 0xf80>;
		interrupts = <0x00 0x98 0x08>;
		clocks = <0x02 0x0e>;
		clock-names = "i2c";
	};

	dramc_ch0_top0@10228000 {
		compatible = "mediatek,dramc_ch0_top0";
		reg = <0x00 0x10228000 0x00 0x2000>;
	};

	dramc_ch0_top1@1022a000 {
		compatible = "mediatek,dramc_ch0_top1";
		reg = <0x00 0x1022a000 0x00 0x2000>;
	};

	dramc_ch0_top2@1022c000 {
		compatible = "mediatek,dramc_ch0_top2";
		reg = <0x00 0x1022c000 0x00 0x1000>;
	};

	dramc_ch0_top3@1022d000 {
		compatible = "mediatek,dramc_ch0_top3";
		reg = <0x00 0x1022d000 0x00 0x1000>;
	};

	dramc_ch0_rsv@1022e000 {
		compatible = "mediatek,dramc_ch0_rsv";
		reg = <0x00 0x1022e000 0x00 0x2000>;
	};

	dramc_ch1_top0@10230000 {
		compatible = "mediatek,dramc_ch1_top0";
		reg = <0x00 0x10230000 0x00 0x2000>;
	};

	dramc_ch1_top1@10232000 {
		compatible = "mediatek,dramc_ch1_top1";
		reg = <0x00 0x10232000 0x00 0x2000>;
	};

	dramc_ch1_top2@10234000 {
		compatible = "mediatek,dramc_ch1_top2";
		reg = <0x00 0x10234000 0x00 0x1000>;
	};

	dramc_ch1_top3@10235000 {
		compatible = "mediatek,dramc_ch1_top3";
		reg = <0x00 0x10235000 0x00 0x1000>;
	};

	dramc_ch1_rsv@10236000 {
		compatible = "mediatek,dramc_ch1_rsv";
		reg = <0x00 0x10236000 0x00 0x2000>;
	};

	fmem_smi_dvfsp@10238000 {
		compatible = "mediatek,fmem_smi_dvfsp";
		reg = <0x00 0x10238000 0x00 0x1000>;
	};

	cci400@10390000 {
		compatible = "mediatek,cci400";
		reg = <0x00 0x10390000 0x00 0x10000>;
	};

	ap_dma@11000000 {
		compatible = "mediatek,ap_dma";
		reg = <0x00 0x11000000 0x00 0x1000>;
		interrupts = <0x00 0x52 0x08>;
	};

	btif_tx@11000980 {
		compatible = "mediatek,btif_tx";
		#address-cells = <0x02>;
		#size-cells = <0x02>;
		reg = <0x00 0x11000980 0x00 0x80>;
		interrupts = <0x00 0x60 0x08>;
		linux,phandle = <0xa2>;
		phandle = <0xa2>;
	};

	btif_rx@11000a00 {
		compatible = "mediatek,btif_rx";
		#address-cells = <0x02>;
		#size-cells = <0x02>;
		reg = <0x00 0x11000a00 0x00 0x80>;
		interrupts = <0x00 0x7c 0x08>;
		linux,phandle = <0xa3>;
		phandle = <0xa3>;
	};

	auxadc@11001000 {
		compatible = "mediatek,mt6757-auxadc";
		reg = <0x00 0x11001000 0x00 0x1000>;
		interrupts = <0x00 0x4a 0x02>;
		clocks = <0x02 0x27>;
		clock-names = "auxadc-main";
		linux,phandle = <0xa4>;
		phandle = <0xa4>;
	};

	apuart0@11002000 {
		cell-index = <0x00>;
		compatible = "mediatek,mt6755-uart";
		reg = <0x00 0x11002000 0x00 0x1000 0x00 0x11000580 0x00 0x1000 0x00 0x11000600 0x00 0x80>;
		interrupts = <0x00 0x5b 0x08 0x00 0x6b 0x08 0x00 0x6c 0x08>;
		clock-frequency = <0x18cba80>;
		clock-div = <0x01>;
		clocks = <0x02 0x15 0x02 0x2b>;
		clock-names = "uart0-main\0uart-apdma";
		linux,phandle = <0xa5>;
		phandle = <0xa5>;
	};

	apuart1@11003000 {
		cell-index = <0x01>;
		compatible = "mediatek,mt6755-uart";
		reg = <0x00 0x11003000 0x00 0x1000 0x00 0x11000680 0x00 0x80 0x00 0x11000700 0x00 0x80>;
		interrupts = <0x00 0x5c 0x08 0x00 0x6d 0x08 0x00 0x6e 0x08>;
		clock-frequency = <0x18cba80>;
		clock-div = <0x01>;
		clocks = <0x02 0x16>;
		clock-names = "uart1-main";
		linux,phandle = <0xa6>;
		phandle = <0xa6>;
	};

	pwm@11006000 {
		compatible = "mediatek,pwm";
		reg = <0x00 0x11006000 0x00 0x1000>;
		interrupts = <0x00 0x4d 0x08>;
		clocks = <0x02 0x10 0x02 0x11 0x02 0x12 0x02 0x13 0x02 0x0f 0x02 0x14>;
		clock-names = "PWM1-main\0PWM2-main\0PWM3-main\0PWM4-main\0PWM-HCLK-main\0PWM-main";
	};

	i2c_common {
		compatible = "mediatek,i2c_common";
		dma_support = [02];
		idvfs = [01];
		set_dt_div = [01];
		check_max_freq = [01];
		set_ltiming = [01];
		set_aed = [01];
		ext_time_config = [18 01];
		linux,phandle = <0xa7>;
		phandle = <0xa7>;
	};

	i2c@11007000 {
		compatible = "mediatek,i2c";
		id = <0x00>;
		reg = <0x00 0x11007000 0x00 0x1000 0x00 0x11000100 0x00 0x80>;
		interrupts = <0x00 0x54 0x08>;
		clocks = <0x02 0x0b 0x02 0x2b>;
		clock-names = "main\0dma";
		clock-div = <0x05>;
		linux,phandle = <0xa8>;
		phandle = <0xa8>;
	};

	i2c@11008000 {
		compatible = "mediatek,i2c";
		id = <0x06>;
		reg = <0x00 0x11008000 0x00 0x1000 0x00 0x11000180 0x00 0x80>;
		interrupts = <0x00 0x55 0x08>;
		clocks = <0x02 0x0c 0x02 0x2b 0x02 0x41>;
		clock-names = "main\0dma\0arb";
		clock-div = <0x05>;
		linux,phandle = <0xa9>;
		phandle = <0xa9>;
	};

	i2c@11009000 {
		compatible = "mediatek,i2c";
		id = <0x07>;
		reg = <0x00 0x11009000 0x00 0x1000 0x00 0x11000200 0x00 0x80>;
		interrupts = <0x00 0x56 0x08>;
		clocks = <0x02 0x0d 0x02 0x2b 0x02 0x43>;
		clock-names = "main\0dma\0arb";
		clock-div = <0x05>;
		linux,phandle = <0xaa>;
		phandle = <0xaa>;
	};

	spi@1100a000 {
		compatible = "mediatek,mt6757-spi";
		cell-index = <0x00>;
		spi-padmacro = <0x00>;
		reg = <0x00 0x1100a000 0x00 0x1000>;
		interrupts = <0x00 0x76 0x08>;
		clocks = <0x02 0x1e>;
		clock-names = "main";
		clock-frequency = <0x67f3540>;
		clock-div = <0x01>;
		#address-cells = <0x01>;
		#size-cells = <0x00>;
		cs-gpios = <0x0b 0x1f 0x00>;
		linux,phandle = <0xab>;
		phandle = <0xab>;

		fingerprint@1 {
			compatible = "mediatek,madev_finger";
			cs-gpios = <0x0b 0x56 0x00>;
			reg = <0x00>;
			spi-max-frequency = <0x7a1200>;
			status = "okay";
		};
	};

	therm_ctrl@1100b000 {
		compatible = "mediatek,mt6757-therm_ctrl";
		reg = <0x00 0x1100b000 0x00 0x1000>;
		interrupts = <0x00 0x4e 0x08>;
		clocks = <0x02 0x0a 0x02 0x27>;
		clock-names = "therm-main\0therm-auxadc";
	};

	eem_fsm@1100b000 {
		compatible = "mediatek,mt6757-eem_fsm";
		reg = <0x00 0x1100b000 0x00 0x1000>;
		interrupts = <0x00 0x7d 0x08>;
		clocks = <0x33 0x01 0x2d 0x04 0x02 0x0a>;
		clock-names = "mfg-main\0mtcmos-mfg\0therm-eem";
	};

	btif@1100c000 {
		compatible = "mediatek,btif";
		#address-cells = <0x02>;
		#size-cells = <0x02>;
		reg = <0x00 0x1100c000 0x00 0x1000 0x00 0x11000980 0x00 0x80 0x00 0x11000a00 0x00 0x80>;
		interrupts = <0x00 0x70 0x08 0x00 0x60 0x08 0x00 0x7c 0x08>;
		clocks = <0x02 0x1c 0x02 0x2b>;
		clock-names = "btifc\0apdmac";
	};

	irtx@1100d000 {
		compatible = "mediatek,irtx";
		reg = <0x00 0x1100d000 0x00 0x1000>;
		interrupts = <0x00 0x7f 0x08>;
	};

	disp_pwm@1100e000 {
		compatible = "mediatek,disp_pwm";
		reg = <0x00 0x1100e000 0x00 0x1000>;
	};

	i2c@1100f000 {
		compatible = "mediatek,i2c";
		id = <0x03>;
		reg = <0x00 0x11011000 0x00 0x1000 0x00 0x11000300 0x00 0x80>;
		interrupts = <0x00 0x58 0x08>;
		clocks = <0x02 0x3a 0x02 0x2b>;
		clock-names = "main\0dma";
		clock-div = <0x05>;
		linux,phandle = <0xac>;
		phandle = <0xac>;
	};

	spi@11010000 {
		compatible = "mediatek,mt6757-spi";
		cell-index = <0x01>;
		spi-padmacro = <0x00>;
		reg = <0x00 0x11010000 0x00 0x1000>;
		interrupts = <0x00 0x7a 0x08>;
		clocks = <0x02 0x39>;
		clock-names = "main";
		clock-frequency = <0x67f3540>;
		clock-div = <0x01>;
		linux,phandle = <0xad>;
		phandle = <0xad>;
	};

	i2c@11011000 {
		compatible = "mediatek,i2c";
		#address-cells = <0x01>;
		#size-cells = <0x00>;
		id = <0x05>;
		reg = <0x00 0x1100f000 0x00 0x1000 0x00 0x11000280 0x00 0x80>;
		interrupts = <0x00 0x57 0x08>;
		clocks = <0x02 0x0e 0x02 0x2b>;
		clock-names = "main\0dma";
		clock-div = <0x05>;
		linux,phandle = <0xae>;
		phandle = <0xae>;

		lcd@ktd2151 {
			compatible = "mediatek,I2C_LCD_BIAS";
			reg = <0x3e>;
			status = "okay";
		};

		aw87359@59 {
			compatible = "awinic,aw87359_pa";
			reg = <0x59>;
			status = "okay";
		};

		rt-swchg@53 {
			compatible = "richtek,swchg";
			reg = <0x53>;
			status = "okay";
			rt,intr_gpio_num = <0x74>;
			rt,intr_gpio = <0x0b 0x74 0x00>;

			rt9471 {
				charger_name = "primary_chg";
				chg_alias_name = "rt9471_chg";
				rm-slave-addr = [53];
				rm-name = "rt9471";
				interrupt-names = "wdt\0vbus_gd\0bc12_done\0detach\0vac_ov\0otg_fault\0chg_rdy\0chg_done\0pumpx_done\0aicc_done";
				vac_ovp = <0xa65220>;
				ichg = <0xf4240>;
				aicr = <0x7a120>;
				mivr = <0x432380>;
				cv = <0x426030>;
				ieoc = <0x30d40>;
				safe-tmr = <0x0a>;
				wdt = <0x28>;
				mivr-track = <0x00>;
				en-te;
				en-qon-rst;
			};
		};
	};

	spi@11012000 {
		compatible = "mediatek,mt6757-spi";
		cell-index = <0x02>;
		spi-padmacro = <0x00>;
		reg = <0x00 0x11012000 0x00 0x1000>;
		interrupts = <0x00 0x80 0x08>;
		clocks = <0x02 0x3c>;
		clock-names = "main";
		clock-frequency = <0x67f3540>;
		clock-div = <0x01>;
		linux,phandle = <0xaf>;
		phandle = <0xaf>;
	};

	spi@11013000 {
		compatible = "mediatek,mt6757-spi";
		cell-index = <0x03>;
		spi-padmacro = <0x00>;
		reg = <0x00 0x11013000 0x00 0x1000>;
		interrupts = <0x00 0x81 0x08>;
		clocks = <0x02 0x3d>;
		clock-names = "main";
		clock-frequency = <0x67f3540>;
		clock-div = <0x01>;
		linux,phandle = <0xb0>;
		phandle = <0xb0>;
	};

	i2c@11014000 {
		compatible = "mediatek,i2c";
		id = <0x01>;
		reg = <0x00 0x11014000 0x00 0x1000 0x00 0x11000380 0x00 0x80>;
		interrupts = <0x00 0x10e 0x08>;
		clocks = <0x02 0x42 0x02 0x2b 0x02 0x41>;
		clock-names = "main\0dma\0arb";
		clock-div = <0x05>;
		linux,phandle = <0xb1>;
		phandle = <0xb1>;

		alsps@0x23 {
			compatible = "mediatek,ltr562";
			reg = <0x23>;
			i2c_num = <0x01>;
			i2c_addr = <0x23 0x00 0x00 0x00>;
			polling_mode_ps = <0x00>;
			polling_mode_als = <0x01>;
			power_id = <0xffff>;
			power_vol = <0x00>;
			als_level = <0x05 0x09 0x24 0x3b 0x52 0x84 0xcd 0x111 0x1f4 0x34d 0x470 0x609 0x93c 0x122f 0x1b46>;
			als_value = <0x0a 0x0a 0x50 0x55 0x5a 0x91 0xe1 0x12c 0x226 0x3a2 0x4e2 0x6a4 0xa28 0x1400 0x1e00 0x2800>;
			ps_threshold_high = <0x6a4>;
			ps_threshold_low = <0x5dc>;
			is_batch_supported_ps = <0x00>;
			is_batch_supported_als = <0x00>;
			status = "okay";
		};

		alsps@0x47 {
			compatible = "mediatek,stk3x3x";
			reg = <0x47>;
			i2c_num = <0x01>;
			i2c_addr = <0x47 0x00 0x00 0x00>;
			polling_mode_ps = <0x00>;
			polling_mode_als = <0x01>;
			power_id = <0xffff>;
			power_vol = <0x00>;
			als_level = <0x05 0x09 0x24 0x3b 0x52 0x84 0xcd 0x111 0x1f4 0x34d 0x470 0x609 0x93c 0x122f 0x1b46>;
			als_value = <0x0a 0x0a 0x50 0x55 0x5a 0x91 0xe1 0x12c 0x226 0x3a2 0x4e2 0x6a4 0xa28 0x1400 0x1e00 0x2800>;
			ps_threshold_high = <0x82>;
			ps_threshold_low = <0x50>;
			is_batch_supported_ps = <0x00>;
			is_batch_supported_als = <0x00>;
			status = "okay";
		};

		gsensor@0x18 {
			compatible = "mediatek,stk8baxx";
			reg = <0x18>;
			i2c_num = <0x01>;
			i2c_addr = <0x18 0x00 0x00 0x00>;
			direction = <0x03>;
			power_id = <0xffff>;
			power_vol = <0x00>;
			firlen = <0x00>;
			is_batch_supported = <0x00>;
			status = "okay";
		};

		gsensor@0x19 {
			compatible = "mediatek,sc7a20";
			reg = <0x19>;
			i2c_num = <0x02>;
			i2c_addr = <0x19 0x00 0x00 0x00>;
			direction = <0x02>;
			power_id = <0xffff>;
			power_vol = <0x00>;
			firlen = <0x00>;
			is_batch_supported = <0x00>;
			status = "okay";
		};

		msensor@0x2c {
			compatible = "mediatek,msensor";
			reg = <0x2c>;
			i2c_num = <0x01>;
			i2c_addr = <0x2c 0x00 0x00 0x00>;
			direction = <0x01>;
			power_id = <0xffff>;
			power_vol = <0x00>;
			is_batch_supported = <0x00>;
			status = "okay";
		};

		msensor@0x30 {
			compatible = "mediatek,mmc5603";
			reg = <0x30>;
			i2c_num = <0x01>;
			i2c_addr = <0x30 0x00 0x00 0x00>;
			direction = <0x03>;
			power_id = <0xffff>;
			power_vol = <0x00>;
			is_batch_supported = <0x00>;
			status = "okay";
		};

		usb_type_c_sgm7220@0x67 {
			compatible = "mediatek,usb_type_c_sgm7220";
			reg = <0x67>;
			status = "okay";
		};
	};

	i2c@11015000 {
		compatible = "mediatek,i2c";
		id = <0x02>;
		reg = <0x00 0x11015000 0x00 0x1000 0x00 0x11000400 0x00 0x80>;
		interrupts = <0x00 0x10f 0x08>;
		clocks = <0x02 0x44 0x02 0x2b 0x02 0x43>;
		clock-names = "main\0dma\0arb";
		clock-div = <0x05>;
		linux,phandle = <0xb2>;
		phandle = <0xb2>;
	};

	i2c@11016000 {
		compatible = "mediatek,i2c";
		id = <0x08>;
		reg = <0x00 0x11016000 0x00 0x1000 0x00 0x11000480 0x00 0x80>;
		interrupts = <0x00 0x10d 0x08>;
		clocks = <0x02 0x3e 0x02 0x2b 0x02 0x3f>;
		clock-names = "main\0dma\0arb";
		clock-div = <0x05>;
		linux,phandle = <0xb3>;
		phandle = <0xb3>;
	};

	i2c@11017000 {
		compatible = "mediatek,i2c";
		id = <0x04>;
		reg = <0x00 0x11017000 0x00 0x1000 0x00 0x11000500 0x00 0x80>;
		interrupts = <0x00 0x110 0x08>;
		clocks = <0x02 0x40 0x02 0x2b 0x02 0x3f>;
		clock-names = "main\0dma\0arb";
		clock-div = <0x05>;
		linux,phandle = <0xb4>;
		phandle = <0xb4>;
	};

	spi@11018000 {
		compatible = "mediatek,mt6757-spi";
		cell-index = <0x04>;
		spi-padmacro = <0x00>;
		reg = <0x00 0x11018000 0x00 0x1000>;
		interrupts = <0x00 0x111 0x08>;
		clocks = <0x02 0x45>;
		clock-names = "main";
		clock-frequency = <0x67f3540>;
		clock-div = <0x01>;
		#address-cells = <0x01>;
		#size-cells = <0x00>;
		linux,phandle = <0xb5>;
		phandle = <0xb5>;

		cap_touch@0 {
			compatible = "mediatek,cap_touch_ilitek_spi";
			spi-max-frequency = <0x989680>;
			reg = <0x00>;
			status = "okay";
			linux,phandle = <0xb6>;
			phandle = <0xb6>;
		};
	};

	spi@11019000 {
		compatible = "mediatek,mt6757-spi";
		cell-index = <0x05>;
		spi-padmacro = <0x00>;
		reg = <0x00 0x11019000 0x00 0x1000>;
		interrupts = <0x00 0x112 0x08>;
		clocks = <0x02 0x46>;
		clock-names = "main";
		clock-frequency = <0x67f3540>;
		clock-div = <0x01>;
		linux,phandle = <0xb7>;
		phandle = <0xb7>;
	};

	usb0@11200000 {
		compatible = "mediatek,usb0";
		cell-index = <0x00>;
		reg = <0x00 0x11200000 0x00 0x10000 0x00 0x11210000 0x00 0x10000>;
		interrupts = <0x00 0x49 0x08>;
		mode = <0x02>;
		multipoint = <0x01>;
		dyn_fifo = <0x01>;
		soft_con = <0x01>;
		dma = <0x01>;
		num_eps = <0x10>;
		dma_channels = <0x08>;
		drvvbus_gpio = <0x53 0x02>;
	};

	usb1@11210000 {
		compatible = "mediatek,usb1";
		reg = <0x00 0x11210000 0x00 0x10000>;
		interrupts = <0x00 0x49 0x08>;
	};

	audio@11220000 {
		compatible = "mediatek,audio\0syscon";
		reg = <0x00 0x11220000 0x00 0x1000>;
		interrupts = <0x00 0x8e 0x08>;
		#clock-cells = <0x01>;
		mediatek,btcvsd_snd = <0x34>;
		linux,phandle = <0x35>;
		phandle = <0x35>;
	};

	mt_soc_dl1_pcm@11220000 {
		compatible = "mediatek,mt_soc_pcm_dl1";
		reg = <0x00 0x11220000 0x00 0x1000>;
		interrupts = <0x00 0x8e 0x08>;
		clocks = <0x35 0x0a 0x35 0x09 0x35 0x03 0x35 0x02 0x35 0x04 0x35 0x08 0x35 0x07 0x35 0x05 0x35 0x06 0x35 0x01 0x2d 0x09 0x02 0x31 0x02 0x38 0x2b 0x15 0x2b 0x16 0x2b 0x45 0x2b 0x46 0x2b 0x10 0x2b 0x26 0x36 0x0a 0x36 0x0b 0x37>;
		clock-names = "aud_afe_clk\0aud_i2s_clk\0aud_dac_clk\0aud_dac_predis_clk\0aud_adc_clk\0aud_apll22m_clk\0aud_apll24m_clk\0aud_apll1_tuner_clk\0aud_apll2_tuner_clk\0aud_tml_clk\0scp_sys_aud\0aud_infra_clk\0aud_peri_26m_clk\0aud_mux1_clk\0aud_mux2_clk\0top_ad_apll1_clk\0top_ad_apll2_clk\0top_mux_audio_int\0top_sys_pll1_d4\0apmixed_apll1_clk\0apmixed_apll2_clk\0top_clk26m_clk";
		linux,phandle = <0xb8>;
		phandle = <0xb8>;
	};

	audio_sram@11221000 {
		compatible = "mediatek,audio_sram";
		reg = <0x00 0x11221000 0x00 0xb400>;
	};

	mtk-btcvsd-snd@18000000 {
		compatible = "mediatek,mtk-btcvsd-snd";
		reg = <0x00 0x18000000 0x00 0x10000 0x00 0x18080000 0x00 0x8000>;
		interrupts = <0x00 0x109 0x08>;
		mediatek,infracfg = <0x02>;
		mediatek,offset = <0xf00 0x800 0xfd0 0xfd4 0xfd8>;
		linux,phandle = <0x34>;
		phandle = <0x34>;
	};

	usb3@11270000 {
		compatible = "mediatek,usb3";
		reg = <0x00 0x11270000 0x00 0x10000 0x00 0x11280700 0x00 0x100 0x00 0x11290000 0x00 0x10000>;
		reg-names = "ssusb_base\0ssusb_ippc\0ssusb_sif2";
		interrupts = <0x00 0x48 0x08 0x00 0x49 0x08>;
		interrupt-names = "musb-hdrc\0xhci";
		linux,phandle = <0xb9>;
		phandle = <0xb9>;
	};

	usb3_xhci@11270000 {
		compatible = "mediatek,mt67xx-xhci";
		reg = <0x00 0x11270000 0x00 0x1000 0x00 0x11280700 0x00 0x100>;
		reg-names = "mac\0ippc";
		interrupts = <0x00 0x7b 0x08>;
		interrupt-names = "xhci";
		clocks = <0x37>;
		clock-names = "sys_ck";
		linux,phandle = <0xba>;
		phandle = <0xba>;
	};

	g3d_config@13000000 {
		compatible = "mediatek,g3d_config";
		reg = <0x00 0x13000000 0x00 0x1000>;
		#clock-cells = <0x01>;
		linux,phandle = <0x33>;
		phandle = <0x33>;
	};

	vad_gpu@13001000 {
		compatible = "mediatek,vad_gpu";
		reg = <0x00 0x13001000 0x00 0x1000>;
	};

	vad_sc0@13002000 {
		compatible = "mediatek,vad_sc0";
		reg = <0x00 0x13002000 0x00 0x1000>;
	};

	vad_sc1@13003000 {
		compatible = "mediatek,vad_sc1";
		reg = <0x00 0x13003000 0x00 0x1000>;
	};

	dfp@13020000 {
		compatible = "mediatek,dfp";
		reg = <0x00 0x13020000 0x00 0x1000>;
	};

	met_mali@13040000 {
		compatible = "arm,malit860\0arm,mali-t86x\0arm,malit8xx\0arm,mali-midgard";
		reg = <0x00 0x13040000 0x00 0x4000>;
		interrupts = <0x00 0xf7 0x08 0x00 0xf6 0x08 0x00 0xf5 0x08>;
		interrupt-names = "JOB\0MMU\0GPU";
		clock-frequency = <0x29b92700>;
		clocks = <0x33 0x01 0x2b 0x1f 0x2d 0x08 0x2d 0x04 0x2d 0x0e 0x2d 0x0d>;
		clock-names = "mfg-main\0mfg-f52m-sel\0mtcmos-mfg-async\0mtcmos-mfg\0mtcmos-mfg-core0\0mtcmos-mfg-core1";
		linux,phandle = <0xbb>;
		phandle = <0xbb>;
	};

	mali@13040000 {
		compatible = "arm,malit860\0arm,mali-t86x\0arm,malit8xx\0arm,mali-midgard";
		reg = <0x00 0x13040000 0x00 0x4000>;
		interrupts = <0x00 0xf7 0x08 0x00 0xf6 0x08 0x00 0xf5 0x08>;
		interrupt-names = "JOB\0MMU\0GPU";
		clock-frequency = <0x29b92700>;
		clocks = <0x33 0x01 0x2b 0x1f 0x2d 0x08 0x2d 0x04 0x2d 0x0e 0x2d 0x0d>;
		clock-names = "mfg-main\0mfg-f52m-sel\0mtcmos-mfg-async\0mtcmos-mfg\0mtcmos-mfg-core0\0mtcmos-mfg-core1";
	};

	mmsys_config@14000000 {
		compatible = "mediatek,mmsys_config";
		reg = <0x00 0x14000000 0x00 0x1000>;
		interrupts = <0x00 0xd5 0x08>;
		#clock-cells = <0x01>;
		clocks = <0x2e 0x04>;
		clock-names = "CAM_MDP";
		linux,phandle = <0x2e>;
		phandle = <0x2e>;
	};

	dispsys@14000000 {
		compatible = "mediatek,dispsys";
		reg = <0x00 0x14000000 0x00 0x1000 0x00 0x1400b000 0x00 0x1000 0x00 0x1400c000 0x00 0x1000 0x00 0x1400d000 0x00 0x1000 0x00 0x1400e000 0x00 0x1000 0x00 0x1400f000 0x00 0x1000 0x00 0x14010000 0x00 0x1000 0x00 0x14011000 0x00 0x1000 0x00 0x14012000 0x00 0x1000 0x00 0x14013000 0x00 0x1000 0x00 0x14014000 0x00 0x1000 0x00 0x14015000 0x00 0x1000 0x00 0x14016000 0x00 0x1000 0x00 0x14017000 0x00 0x1000 0x00 0x14018000 0x00 0x1000 0x00 0x14019000 0x00 0x1000 0x00 0x1401a000 0x00 0x1000 0x00 0x1401b000 0x00 0x1000 0x00 0x1401c000 0x00 0x1000 0x00 0x1401d000 0x00 0x1000 0x00 0x1401e000 0x00 0x1000 0x00 0x1401f000 0x00 0x1000 0x00 0x14020000 0x00 0x1000 0x00 0x14021000 0x00 0x1000 0x00 0x14022000 0x00 0x1000 0x00 0x14023000 0x00 0x1000 0x00 0x14024000 0x00 0x1000 0x00 0x1100e000 0x00 0x1000 0x00 0x14025000 0x00 0x1000 0x00 0x14026000 0x00 0x1000 0x00 0x14027000 0x00 0x1000 0x00 0x14028000 0x00 0x1000 0x00 0x10215000 0x00 0x10000 0x00 0x10216000 0x00 0x10000 0x00 0x1100e000 0x00 0x10000>;
		interrupts = <0x00 0x00 0x08 0x00 0xbc 0x08 0x00 0xbd 0x08 0x00 0xbe 0x08 0x00 0xbf 0x08 0x00 0xc0 0x08 0x00 0xc1 0x08 0x00 0xc2 0x08 0x00 0xc3 0x08 0x00 0xc4 0x08 0x00 0xc5 0x08 0x00 0xc6 0x08 0x00 0xc7 0x08 0x00 0xc8 0x08 0x00 0xc9 0x08 0x00 0xca 0x08 0x00 0xcb 0x08 0x00 0xcc 0x08 0x00 0xcd 0x08 0x00 0xce 0x08 0x00 0xcf 0x08 0x00 0x00 0x08 0x00 0x00 0x08 0x00 0x00 0x08 0x00 0xd2 0x08 0x00 0xd3 0x08 0x00 0xd4 0x08 0x00 0x00 0x08 0x00 0xb1 0x08 0x00 0xd6 0x08 0x00 0xd1 0x08 0x00 0x00 0x08 0x00 0x00 0x08 0x00 0x00 0x08>;
		clocks = <0x2e 0x01 0x2e 0x02 0x2e 0x03 0x2e 0x0f 0x2e 0x10 0x2e 0x11 0x2e 0x12 0x2e 0x13 0x2e 0x14 0x2e 0x15 0x2e 0x16 0x2e 0x17 0x2e 0x18 0x2e 0x19 0x2e 0x1a 0x2e 0x1b 0x2e 0x1c 0x2e 0x1d 0x2e 0x1e 0x2e 0x1f 0x2e 0x20 0x2e 0x21 0x2e 0x22 0x2e 0x23 0x2e 0x24 0x2e 0x25 0x2e 0x26 0x2e 0x27 0x2e 0x28 0x2e 0x29 0x2e 0x2a 0x2e 0x2b 0x2e 0x2c 0x02 0x36 0x2d 0x03 0x2b 0x13 0x2b 0x48 0x2b 0x49 0x2b 0x4a 0x2b 0x4b 0x2b 0x47 0x2b 0x17 0x37 0x2b 0x3b 0x2b 0x53 0x2b 0x54 0x2b 0x02 0x2b 0x55 0x2b 0x2a>;
		clock-names = "DISP0_SMI_COMMON\0DISP0_SMI_LARB0\0DISP0_SMI_LARB4\0DISP0_DISP_OVL0\0DISP0_DISP_OVL1\0DISP0_DISP_OVL0_2L\0DISP0_DISP_OVL1_2L\0DISP0_DISP_RDMA0\0DISP0_DISP_RDMA1\0DISP0_DISP_RDMA2\0DISP0_DISP_WDMA0\0DISP0_DISP_WDMA1\0DISP0_DISP_COLOR\0DISP0_DISP_COLOR1\0DISP0_DISP_CCORR\0DISP0_DISP_CCORR1\0DISP0_DISP_AAL\0DISP0_DISP_AAL1\0DISP0_DISP_GAMMA\0DISP0_DISP_GAMMA1\0DISP0_DISP_OD\0DISP0_DISP_DITHER\0DISP0_DISP_DITHER1\0DISP0_DISP_UFOE\0DISP0_DISP_DSC\0DISP0_DISP_SPLIT\0DISP1_DSI0_MM_CLOCK\0DISP1_DSI0_INTERFACE_CLOCK\0DISP1_DSI1_MM_CLOCK\0DISP1_DSI1_INTERFACE_CLOCK\0DISP1_DPI_MM_CLOCK\0DISP1_DPI_INTERFACE_CLOCK\0DISP1_DISP_OVL0_MOUT\0DISP_PWM\0DISP_MTCMOS_CLK\0MUX_DPI0\0TVDPLL_D2\0TVDPLL_D4\0TVDPLL_D8\0TVDPLL_D16\0DPI_CK\0MUX_PWM\0CLK26M\0UNIVPLL2_D4\0ULPOSC_D4\0ULPOSC_D8\0MUX_MM\0MM_VENCPLL\0SYSPLL2_D2";
		linux,phandle = <0xbc>;
		phandle = <0xbc>;
	};

	mhl@0 {
		compatible = "mediatek,extd_dev";
		linux,phandle = <0xbd>;
		phandle = <0xbd>;
	};

	mdp_rdma0@14001000 {
		compatible = "mediatek,mdp_rdma0";
		reg = <0x00 0x14001000 0x00 0x1000>;
		interrupts = <0x00 0xb2 0x08>;
		clocks = <0x2e 0x05>;
		clock-names = "MDP_RDMA0";
	};

	mdp_rdma1@14002000 {
		compatible = "mediatek,mdp_rdma1";
		reg = <0x00 0x14002000 0x00 0x1000>;
		interrupts = <0x00 0xb3 0x08>;
		clocks = <0x2e 0x06>;
		clock-names = "MDP_RDMA1";
	};

	mdp_rsz0@14003000 {
		compatible = "mediatek,mdp_rsz0";
		reg = <0x00 0x14003000 0x00 0x1000>;
		interrupts = <0x00 0xb4 0x08>;
		clocks = <0x2e 0x07>;
		clock-names = "MDP_RSZ0";
	};

	mdp_rsz1@14004000 {
		compatible = "mediatek,mdp_rsz1";
		reg = <0x00 0x14004000 0x00 0x1000>;
		interrupts = <0x00 0xb5 0x08>;
		clocks = <0x2e 0x08>;
		clock-names = "MDP_RSZ1";
	};

	mdp_rsz2@14005000 {
		compatible = "mediatek,mdp_rsz2";
		reg = <0x00 0x14005000 0x00 0x1000>;
		interrupts = <0x00 0xb6 0x08>;
		clocks = <0x2e 0x09>;
		clock-names = "MDP_RSZ2";
	};

	mdp_wdma@14006000 {
		compatible = "mediatek,mdp_wdma";
		reg = <0x00 0x14006000 0x00 0x1000>;
		interrupts = <0x00 0xb9 0x08>;
		clocks = <0x2e 0x0c>;
		clock-names = "MDP_WDMA";
	};

	mdp_wrot0@14007000 {
		compatible = "mediatek,mdp_wrot0";
		reg = <0x00 0x14007000 0x00 0x1000>;
		interrupts = <0x00 0xba 0x08>;
		clocks = <0x2e 0x0d>;
		clock-names = "MDP_WROT0";
	};

	mdp_wrot1@14008000 {
		compatible = "mediatek,mdp_wrot1";
		reg = <0x00 0x14008000 0x00 0x1000>;
		interrupts = <0x00 0xbb 0x08>;
		clocks = <0x2e 0x0e>;
		clock-names = "MDP_WROT1";
	};

	mdp_tdshp@14009000 {
		compatible = "mediatek,mdp_tdshp";
		reg = <0x00 0x14009000 0x00 0x1000>;
		interrupts = <0x00 0xb7 0x08>;
		clocks = <0x2e 0x0a>;
		clock-names = "MDP_TDSHP";
	};

	mdp_color@1400a000 {
		compatible = "mediatek,mdp_color";
		reg = <0x00 0x1400a000 0x00 0x1000>;
		interrupts = <0x00 0xb8 0x08>;
		clocks = <0x2e 0x0b>;
		clock-names = "MDP_COLOR";
	};

	disp_ovl0@1400b000 {
		compatible = "mediatek,disp_ovl0";
		reg = <0x00 0x1400b000 0x00 0x1000>;
		interrupts = <0x00 0xbc 0x08>;
	};

	disp_ovl1@1400c000 {
		compatible = "mediatek,disp_ovl1";
		reg = <0x00 0x1400c000 0x00 0x1000>;
		interrupts = <0x00 0xbd 0x08>;
	};

	disp_ovl0_2l@1400d000 {
		compatible = "mediatek,disp_ovl0_2l";
		reg = <0x00 0x1400d000 0x00 0x1000>;
		interrupts = <0x00 0xbe 0x08>;
	};

	disp_ovl1_2l@1400e000 {
		compatible = "mediatek,disp_ovl1_2l";
		reg = <0x00 0x1400e000 0x00 0x1000>;
		interrupts = <0x00 0xbf 0x08>;
	};

	disp_rdma0@1400f000 {
		compatible = "mediatek,disp_rdma0";
		reg = <0x00 0x1400f000 0x00 0x1000>;
		interrupts = <0x00 0xc0 0x08>;
	};

	disp_rdma1@14010000 {
		compatible = "mediatek,disp_rdma1";
		reg = <0x00 0x14010000 0x00 0x1000>;
		interrupts = <0x00 0xc1 0x08>;
	};

	disp_rdma2@14011000 {
		compatible = "mediatek,disp_rdma2";
		reg = <0x00 0x14011000 0x00 0x1000>;
		interrupts = <0x00 0xc2 0x08>;
	};

	disp_wdma0@14012000 {
		compatible = "mediatek,disp_wdma0";
		reg = <0x00 0x14012000 0x00 0x1000>;
		interrupts = <0x00 0xc3 0x08>;
	};

	disp_wdma1@14013000 {
		compatible = "mediatek,disp_wdma1";
		reg = <0x00 0x14013000 0x00 0x1000>;
		interrupts = <0x00 0xc4 0x08>;
	};

	disp_color0@14014000 {
		compatible = "mediatek,disp_color0";
		reg = <0x00 0x14014000 0x00 0x1000>;
		interrupts = <0x00 0xc5 0x08>;
	};

	disp_color1@14015000 {
		compatible = "mediatek,disp_color1";
		reg = <0x00 0x14015000 0x00 0x1000>;
		interrupts = <0x00 0xc6 0x08>;
	};

	disp_ccorr0@14016000 {
		compatible = "mediatek,disp_ccorr0";
		reg = <0x00 0x14016000 0x00 0x1000>;
		interrupts = <0x00 0xc7 0x08>;
	};

	disp_ccorr1@14017000 {
		compatible = "mediatek,disp_ccorr1";
		reg = <0x00 0x14017000 0x00 0x1000>;
		interrupts = <0x00 0xc8 0x08>;
	};

	disp_aal0@14018000 {
		compatible = "mediatek,disp_aal0";
		reg = <0x00 0x14018000 0x00 0x1000>;
		interrupts = <0x00 0xc9 0x08>;
		aal_support = <0x01>;
		linux,phandle = <0xbe>;
		phandle = <0xbe>;
	};

	disp_aal1@14019000 {
		compatible = "mediatek,disp_aal1";
		reg = <0x00 0x14019000 0x00 0x1000>;
		interrupts = <0x00 0xca 0x08>;
	};

	disp_gamma0@1401a000 {
		compatible = "mediatek,disp_gamma0";
		reg = <0x00 0x1401a000 0x00 0x1000>;
		interrupts = <0x00 0xcb 0x08>;
	};

	disp_gamma1@1401b000 {
		compatible = "mediatek,disp_gamma1";
		reg = <0x00 0x1401b000 0x00 0x1000>;
		interrupts = <0x00 0xcc 0x08>;
	};

	disp_od@1401c000 {
		compatible = "mediatek,disp_od";
		reg = <0x00 0x1401c000 0x00 0x400>;
		interrupts = <0x00 0xcd 0x08>;
	};

	disp_dither0@1401d000 {
		compatible = "mediatek,disp_dither0";
		reg = <0x00 0x1401d000 0x00 0x1000>;
		interrupts = <0x00 0xce 0x08>;
	};

	disp_dither1@1401e000 {
		compatible = "mediatek,disp_dither1";
		reg = <0x00 0x1401e000 0x00 0x1000>;
		interrupts = <0x00 0xcf 0x08>;
	};

	dsi_ufoe@1401f000 {
		compatible = "mediatek,dsi_ufoe";
		reg = <0x00 0x1401f000 0x00 0x1000>;
	};

	disp_dsc@14020000 {
		compatible = "mediatek,disp_dsc";
		reg = <0x00 0x14020000 0x00 0x1000>;
	};

	dsi_split@14021000 {
		compatible = "mediatek,dsi_split";
		reg = <0x00 0x14021000 0x00 0x1000>;
	};

	dsi0@14022000 {
		compatible = "mediatek,dsi0";
		reg = <0x00 0x14022000 0x00 0x1000>;
		interrupts = <0x00 0xd2 0x08>;
	};

	dsi1@14023000 {
		compatible = "mediatek,dsi1";
		reg = <0x00 0x14023000 0x00 0x1000>;
		interrupts = <0x00 0xd3 0x08>;
	};

	dpi0@14024000 {
		compatible = "mediatek,dpi0";
		reg = <0x00 0x14024000 0x00 0x1000>;
		interrupts = <0x00 0xd4 0x08>;
	};

	mm_mutex@14025000 {
		compatible = "mediatek,mm_mutex";
		reg = <0x00 0x14025000 0x00 0x1000>;
	};

	smi_larb0@14026000 {
		compatible = "mediatek,smi_larb0\0mediatek,smi_larb";
		reg = <0x00 0x14026000 0x00 0x1000>;
		interrupts = <0x00 0xd6 0x08>;
		clocks = <0x2d 0x03 0x2e 0x02>;
		clock-names = "mtcmos-dis\0smi-larb0";
		cell-index = <0x00>;
		linux,phandle = <0x38>;
		phandle = <0x38>;
	};

	smi_larb4@14027000 {
		compatible = "mediatek,smi_larb4\0mediatek,smi_larb";
		reg = <0x00 0x14027000 0x00 0x1000>;
		interrupts = <0x00 0xd1 0x08>;
		clocks = <0x2d 0x03 0x2e 0x03>;
		clock-names = "mtcmos-dis\0smi-larb4";
		cell-index = <0x04>;
		linux,phandle = <0x3c>;
		phandle = <0x3c>;
	};

	smi_common@14028000 {
		compatible = "mediatek,smi_common";
		reg = <0x00 0x14028000 0x00 0x1000>;
		nr_larbs = <0x06>;
		larbs = <0x38 0x39 0x3a 0x3b 0x3c 0x3d>;
		mmsys_config = <0x2e>;
		clocks = <0x2d 0x03 0x2e 0x01 0x2e 0x02>;
		clock-names = "mtcmos-dis\0smi-common\0smi_larb0";
	};

	met_smi@14028000 {
		compatible = "mediatek,met_smi";
		reg = <0x00 0x14028000 0x00 0x1000 0x00 0x14026000 0x00 0x1000 0x00 0x16010000 0x00 0x1000 0x00 0x1a001000 0x00 0x1000 0x00 0x17001000 0x00 0x1000 0x00 0x14027000 0x00 0x1000 0x00 0x15021000 0x00 0x1000>;
		clocks = <0x2e 0x01 0x2e 0x02 0x2f 0x02 0x30 0x01 0x31 0x01 0x31 0x02 0x2e 0x03 0x32 0x07 0x2d 0x07 0x2d 0x06 0x2d 0x05 0x2d 0x03 0x2d 0x0a>;
		clock-names = "smi-common\0smi-larb0\0smi-larb1\0smi-larb2\0smi-larb3\0smi-larb3-2\0smi-larb4\0smi-larb5\0mtcmos-ven\0mtcmos-vde\0mtcmos-isp\0mtcmos-dis\0mtcmos-cam";
		linux,phandle = <0xbf>;
		phandle = <0xbf>;
	};

	mmsys_vad@14029000 {
		compatible = "mediatek,mmsys_vad";
		reg = <0x00 0x14029000 0x00 0x1000>;
	};

	mmsys_dfp@1402a000 {
		compatible = "mediatek,mmsys_dfp";
		reg = <0x00 0x1402a000 0x00 0x1000>;
	};

	imgsys_config@15020000 {
		compatible = "mediatek,imgsys_config";
		reg = <0x00 0x15020000 0x00 0x1000>;
		#clock-cells = <0x01>;
		clocks = <0x2d 0x03 0x2e 0x01 0x2d 0x05 0x2d 0x0a 0x32 0x07 0x32 0x05 0x32 0x01 0x30 0x01 0x30 0x02 0x30 0x03 0x30 0x04 0x30 0x05 0x30 0x06 0x30 0x07 0x30 0x08>;
		clock-names = "ISP_SCP_SYS_DIS\0ISP_MMSYS_SMI_COMMON\0ISP_SCP_SYS_ISP\0ISP_SCP_SYS_CAM\0ISP_IMG_LARB5\0ISP_IMG_DIP\0ISP_IMG_RSC\0ISP_CAMSYS_LARB2_CGPDN\0ISP_CAMSYS_CAMSYS_CGPDN\0ISP_CAMSYS_CAMTG_CGPDN\0ISP_CAMSYS_SENINF_CGPDN\0ISP_CAMSYS_CAMSV0_CGPDN\0ISP_CAMSYS_CAMSV1_CGPDN\0ISP_CAMSYS_CAMSV2_CGPDN\0ISP_CAMSYS_TSF_CGPDN";
		linux,phandle = <0x32>;
		phandle = <0x32>;
	};

	smi_larb5@15021000 {
		compatible = "mediatek,smi_larb5\0mediatek,smi_larb";
		reg = <0x00 0x15021000 0x00 0x1000>;
		interrupts = <0x00 0xed 0x08>;
		clocks = <0x2d 0x05 0x32 0x07>;
		clock-names = "mtcmos-isp\0smi-larb5";
		cell-index = <0x05>;
		linux,phandle = <0x3d>;
		phandle = <0x3d>;
	};

	dip_a@15022000 {
		compatible = "mediatek,dip_a";
		reg = <0x00 0x15022000 0x00 0x2800>;
		interrupts = <0x00 0xee 0x08>;
	};

	dip_a0@15022000 {
		compatible = "mediatek,dip_a0";
		reg = <0x00 0x15022000 0x00 0x1000>;
		interrupts = <0x00 0xee 0x08>;
	};

	dip_a1@15023000 {
		compatible = "mediatek,dip_a1";
		reg = <0x00 0x15023000 0x00 0x1000>;
	};

	dip_a2@15024000 {
		compatible = "mediatek,dip_a2";
		reg = <0x00 0x15024000 0x00 0x1000>;
	};

	img_vad@15027000 {
		compatible = "mediatek,img_vad";
		reg = <0x00 0x15027000 0x00 0x1000>;
	};

	dpe@15028000 {
		compatible = "mediatek,dpe";
		reg = <0x00 0x15028000 0x00 0x1000>;
		interrupts = <0x00 0xf0 0x08>;
	};

	rsc@15029000 {
		compatible = "mediatek,rsc";
		reg = <0x00 0x15029000 0x00 0x1000>;
		interrupts = <0x00 0xf2 0x08>;
	};

	fd@1502b000 {
		compatible = "mediatek,fd";
		reg = <0x00 0x1502b000 0x00 0x1000>;
		interrupts = <0x00 0xef 0x08>;
		clocks = <0x2d 0x03 0x2e 0x01 0x2d 0x05 0x32 0x07 0x32 0x03>;
		clock-names = "FD_CG_SCP_SYS_DIS\0FD_CG_MM_SMI_COMMON\0FD_CG_SCP_SYS_ISP\0FD_CG_IMG_LARB5\0FD_CG_IMG_FD";
	};

	gepf@1502c000 {
		compatible = "mediatek,gepf";
		reg = <0x00 0x1502c000 0x00 0x1000>;
		interrupts = <0x00 0xf1 0x08>;
	};

	img_dfp@1502e000 {
		compatible = "mediatek,img_dfp";
		reg = <0x00 0x1502e000 0x00 0x1000>;
	};

	vdec_gcon@16000000 {
		compatible = "mediatek,vdec_gcon";
		reg = <0x00 0x16000000 0x00 0x10000>;
		clocks = <0x2e 0x01 0x2f 0x01 0x2f 0x02 0x31 0x02 0x31 0x01 0x2b 0x03 0x2b 0x25 0x2b 0x26 0x2d 0x06 0x2d 0x07 0x2d 0x03>;
		clock-names = "MT_CG_DISP0_SMI_COMMON\0MT_CG_VDEC0_VDEC\0MT_CG_VDEC1_LARB\0MT_CG_VENC_VENC\0MT_CG_VENC_LARB\0MT_CG_TOP_MUX_VDEC\0MT_CG_TOP_SYSPLL1_D2\0MT_CG_TOP_SYSPLL1_D4\0MT_SCP_SYS_VDE\0MT_SCP_SYS_VEN\0MT_SCP_SYS_DIS";
		#clock-cells = <0x01>;
		linux,phandle = <0x2f>;
		phandle = <0x2f>;
	};

	smi_larb1@16010000 {
		compatible = "mediatek,smi_larb1\0mediatek,smi_larb";
		reg = <0x00 0x16010000 0x00 0x10000>;
		interrupts = <0x00 0xdc 0x08>;
		clocks = <0x2d 0x06 0x2f 0x02>;
		clock-names = "mtcmos-vde\0smi-larb1";
		cell-index = <0x01>;
		linux,phandle = <0x39>;
		phandle = <0x39>;
	};

	vdec@16020000 {
		compatible = "mediatek,vdec";
		reg = <0x00 0x16020000 0x00 0x10000>;
		interrupts = <0x00 0xdb 0x08>;
		linux,phandle = <0xc0>;
		phandle = <0xc0>;
	};

	venc_gcon@17000000 {
		compatible = "mediatek,venc_gcon";
		reg = <0x00 0x17000000 0x00 0x1000>;
		#clock-cells = <0x01>;
		linux,phandle = <0x31>;
		phandle = <0x31>;
	};

	smi_larb3@17001000 {
		compatible = "mediatek,smi_larb3\0mediatek,smi_larb";
		reg = <0x00 0x17001000 0x00 0x1000>;
		interrupts = <0x00 0xd8 0x08>;
		clocks = <0x2d 0x07 0x31 0x01 0x31 0x02>;
		clock-names = "mtcmos-ven\0smi-larb3\0smi-larb3-2";
		cell-index = <0x03>;
		linux,phandle = <0x3b>;
		phandle = <0x3b>;
	};

	venc@17002000 {
		compatible = "mediatek,venc";
		reg = <0x00 0x17002000 0x00 0x1000>;
		interrupts = <0x00 0xd7 0x08>;
	};

	venc_jpg@17003000 {
		compatible = "mediatek,venc_jpg";
		reg = <0x00 0x17003000 0x00 0x1000 0x00 0x17004000 0x00 0x1000>;
		interrupts = <0x00 0xd9 0x08 0x00 0xda 0x08>;
		clocks = <0x2e 0x01 0x2d 0x03 0x2d 0x07 0x31 0x01 0x31 0x03 0x31 0x04>;
		clock-names = "MT_CG_SMI_COMMON\0MT_CG_SCP_SYS_MM0\0MT_CG_SCP_SYS_VEN\0MT_CG_VENC_LARB\0MT_CG_VENC_JPGENC\0MT_CG_VENC_JPGDEC";
	};

	consys@18070000 {
		compatible = "mediatek,mt6757-consys";
		#address-cells = <0x02>;
		#size-cells = <0x02>;
		reg = <0x00 0x18070000 0x00 0x200 0x00 0x10007000 0x00 0x100 0x00 0x10000000 0x00 0x2000 0x00 0x10006000 0x00 0x1000>;
		interrupts = <0x00 0x10a 0x08 0x00 0x10c 0x08>;
		clocks = <0x2d 0x02>;
		clock-names = "conn";
		linux,phandle = <0xc1>;
		phandle = <0xc1>;
	};

	wifi@180f0000 {
		compatible = "mediatek,wifi";
		reg = <0x00 0x180f0000 0x00 0x5c>;
		interrupts = <0x00 0x10b 0x08>;
		clocks = <0x02 0x2b>;
		clock-names = "wifi-dma";
	};

	camsys_config@1a000000 {
		compatible = "mediatek,camsys_config";
		reg = <0x00 0x1a000000 0x00 0x1000>;
		#clock-cells = <0x01>;
		linux,phandle = <0x30>;
		phandle = <0x30>;
	};

	smi_larb2@1a001000 {
		compatible = "mediatek,smi_larb2\0mediatek,smi_larb";
		reg = <0x00 0x1a001000 0x00 0x1000>;
		interrupts = <0x00 0xe9 0x08>;
		clocks = <0x2d 0x0a 0x30 0x01>;
		clock-names = "mtcmos-cam\0smi-larb2";
		cell-index = <0x02>;
		linux,phandle = <0x3a>;
		phandle = <0x3a>;
	};

	cam@1a003000 {
		compatible = "mediatek,cam";
		reg = <0x00 0x1a003000 0x00 0x1000>;
		interrupts = <0x00 0xde 0x08>;
	};

	cama@1a004000 {
		compatible = "mediatek,cama";
		reg = <0x00 0x1a004000 0x00 0x1000>;
		interrupts = <0x00 0xdf 0x08>;
	};

	camb@1a005000 {
		compatible = "mediatek,camb";
		reg = <0x00 0x1a005000 0x00 0x1000>;
		interrupts = <0x00 0xe0 0x08>;
	};

	cam_set@1a00b000 {
		compatible = "mediatek,cam_set";
		reg = <0x00 0x1a00b000 0x00 0x1000>;
	};

	cama_set@1a00c000 {
		compatible = "mediatek,cama_set";
		reg = <0x00 0x1a00c000 0x00 0x1000>;
	};

	camb_set@1a00d000 {
		compatible = "mediatek,camb_set";
		reg = <0x00 0x1a00d000 0x00 0x1000>;
	};

	cam_inner@1a013000 {
		compatible = "mediatek,cam_inner";
		reg = <0x00 0x1a013000 0x00 0x1000>;
	};

	cama_inner@1a014000 {
		compatible = "mediatek,cama_inner";
		reg = <0x00 0x1a014000 0x00 0x1000>;
	};

	camb_inner@1a015000 {
		compatible = "mediatek,camb_inner";
		reg = <0x00 0x1a015000 0x00 0x1000>;
	};

	cam_clear@1a01b000 {
		compatible = "mediatek,cam_clear";
		reg = <0x00 0x1a01b000 0x00 0x1000>;
	};

	cama_clear@1a01c000 {
		compatible = "mediatek,cama_clear";
		reg = <0x00 0x1a01c000 0x00 0x1000>;
	};

	camb_clear@1a01d000 {
		compatible = "mediatek,camb_clear";
		reg = <0x00 0x1a01d000 0x00 0x1000>;
	};

	kd_camera_hw1@1a040000 {
		compatible = "mediatek,camera_hw";
		reg = <0x00 0x1a040000 0x00 0x1000>;
		clocks = <0x2b 0x06 0x2b 0x14 0x2b 0x44 0x2b 0x3a>;
		clock-names = "TOP_CAMTG_SEL\0TOP_MUX_SCAM\0TOP_UNIVPLL_192M_D4\0TOP_UNIVPLL2_D2";
		vcamio-supply = <0x3e>;
		linux,phandle = <0xc2>;
		phandle = <0xc2>;
	};

	kd_camera_hw2@1a040000 {
		compatible = "mediatek,camera_hw2";
		reg = <0x00 0x1a040000 0x00 0x1000>;
		linux,phandle = <0xc3>;
		phandle = <0xc3>;
	};

	seiinfa@1a040000 {
		compatible = "mediatek,seiinfa";
		reg = <0x00 0x1a040000 0x00 0x1000>;
	};

	seiinfb@1a041000 {
		compatible = "mediatek,seiinfb";
		reg = <0x00 0x1a041000 0x00 0x1000>;
	};

	camsva@1a050000 {
		compatible = "mediatek,camsva";
		reg = <0x00 0x1a050000 0x00 0x1000>;
		interrupts = <0x00 0xe4 0x08>;
	};

	camsvb@1a051000 {
		compatible = "mediatek,camsvb";
		reg = <0x00 0x1a051000 0x00 0x1000>;
		interrupts = <0x00 0xe3 0x08>;
	};

	camsvc@1a052000 {
		compatible = "mediatek,camsvc";
		reg = <0x00 0x1a052000 0x00 0x1000>;
		interrupts = <0x00 0xe6 0x08>;
	};

	camsvd@1a053000 {
		compatible = "mediatek,camsvd";
		reg = <0x00 0x1a053000 0x00 0x1000>;
		interrupts = <0x00 0xe5 0x08>;
	};

	camsve@1a054000 {
		compatible = "mediatek,camsve";
		reg = <0x00 0x1a054000 0x00 0x1000>;
		interrupts = <0x00 0xe8 0x08>;
	};

	camsvf@1a055000 {
		compatible = "mediatek,camsvf";
		reg = <0x00 0x1a055000 0x00 0x1000>;
		interrupts = <0x00 0xe7 0x08>;
	};

	tsf@1a057000 {
		compatible = "mediatek,tsf";
		reg = <0x00 0x1a057000 0x00 0x1000>;
		interrupts = <0x00 0xea 0x08>;
		clocks = <0x2d 0x03 0x2e 0x01 0x2d 0x0a 0x30 0x01 0x30 0x08>;
		clock-names = "TSF_SCP_SYS_DIS\0TSF_MMSYS_SMI_COMMON\0TSF_SCP_SYS_CAM\0TSF_CAMSYS_LARB2_CGPDN\0TSF_CAMSYS_TSF_CGPDN";
	};

	ccu@1a057400 {
		compatible = "mediatek,ccu";
		reg = <0x00 0x1a057400 0x00 0x1000>;
		interrupts = <0x00 0xeb 0x08>;
		ccu_hw_offset = <0x400>;
		ccu_pmem_base = <0x1a0a0000>;
		ccu_pmem_size = <0x5000>;
		ccu_dmem_base = <0x1a080000>;
		ccu_dmem_size = <0x3000>;
		ccu_dmem_offset = <0x1680>;
		ccu_log_base = <0x500>;
		ccu_log_size = <0x200>;
		ccu_hw_dump_size = <0x3c0>;
		ccu_camsys_base = <0x1a000000>;
		ccu_camsys_size = <0x1000>;
		ccu_n3d_a_base = <0x1a03ffc0>;
		ccu_n3d_a_size = <0x1000>;
		ccu_sensor_pm_size = <0x800>;
		ccu_sensor_dm_size = <0x600>;
		clocks = <0x30 0x08>;
		clock-names = "CCU_CLK_CAM_CCU";
	};

	gpufreq {
		compatible = "mediatek,mt6757-gpufreq";
		clocks = <0x2b 0x05 0x2b 0x57 0x2b 0x29>;
		clock-names = "clk_mux\0clk_main_parent\0clk_sub_parent";
	};

	usb_c_pinctrl@0 {
		compatible = "mediatek,usb_c_pinctrl";
		interrupt-parent = <0x0b>;
		interrupts = <0x64 0x08 0x64 0x00>;
		debounce = <0x00>;
		typec_usbid_gpio = <0x0b 0x2a 0x00>;
		pinctrl-names = "default\0typec_as_int\0typec_usb_id";
		pinctrl-0 = <0x3f>;
		pinctrl-1 = <0x40>;
		pinctrl-2 = <0x41>;
		status = "okay";
		linux,phandle = <0xc4>;
		phandle = <0xc4>;
	};

	usb3_phy {
		compatible = "mediatek,usb3_phy";
		clocks = <0x02 0x35>;
		clock-names = "sssub_clk";
	};

	mt_soc_deep_buffer_dl_pcm {
		compatible = "mediatek,mt_soc_pcm_deep_buffer_dl";
	};

	mt_soc_ul1_pcm {
		compatible = "mediatek,mt_soc_pcm_capture";
	};

	mt_soc_voice_md1 {
		compatible = "mediatek,mt_soc_pcm_voice_md1";
	};

	mt_soc_hdmi_pcm {
		compatible = "mediatek,mt_soc_pcm_hdmi";
	};

	mt_soc_uldlloopback_pcm {
		compatible = "mediatek,mt_soc_pcm_uldlloopback";
	};

	mt_soc_i2s0_pcm {
		compatible = "mediatek,mt_soc_pcm_dl1_i2s0";
	};

	mt_soc_mrgrx_pcm {
		compatible = "mediatek,mt_soc_pcm_mrgrx";
	};

	mt_soc_mrgrx_awb_pcm {
		compatible = "mediatek,mt_soc_pcm_mrgrx_awb";
	};

	mt_soc_fm_i2s_pcm {
		compatible = "mediatek,mt_soc_pcm_fm_i2s";
	};

	mt_soc_fm_i2s_awb_pcm {
		compatible = "mediatek,mt_soc_pcm_fm_i2s_awb";
	};

	mt_soc_i2s0dl1_pcm {
		compatible = "mediatek,mt_soc_pcm_dl1_i2s0dl1";
	};

	mt_soc_dl1_awb_pcm {
		compatible = "mediatek,mt_soc_pcm_dl1_awb";
	};

	mt_soc_voice_md1_bt {
		compatible = "mediatek,mt_soc_pcm_voice_md1_bt";
	};

	mt_soc_voip_bt_out {
		compatible = "mediatek,mt_soc_pcm_dl1_bt";
	};

	mt_soc_voip_bt_in {
		compatible = "mediatek,mt_soc_pcm_bt_dai";
	};

	mt_soc_tdmrx_pcm {
		compatible = "mediatek,mt_soc_tdm_capture";
	};

	mt_soc_fm_mrgtx_pcm {
		compatible = "mediatek,mt_soc_pcm_fmtx";
	};

	mt_soc_ul2_pcm {
		compatible = "mediatek,mt_soc_pcm_capture2";
	};

	mt_soc_i2s0_awb_pcm {
		compatible = "mediatek,mt_soc_pcm_i2s0_awb";
	};

	mt_soc_voice_md2 {
		compatible = "mediatek,mt_soc_pcm_voice_md2";
	};

	mt_soc_routing_pcm {
		compatible = "mediatek,mt_soc_pcm_routing";
	};

	mt_soc_voice_md2_bt {
		compatible = "mediatek,mt_soc_pcm_voice_md2_bt";
	};

	mt_soc_hp_impedance_pcm {
		compatible = "mediatek,mt_soc_pcm_hp_impedance";
	};

	mt_soc_codec_name {
		compatible = "mediatek,mt_soc_codec_63xx";
		use_hp_depop_flow = <0x00>;
		use_ul_260k = <0x00>;
	};

	mt_soc_dummy_pcm {
		compatible = "mediatek,mt_soc_pcm_dummy";
	};

	mt_soc_codec_dummy_name {
		compatible = "mediatek,mt_soc_codec_dummy";
	};

	mt_soc_routing_dai_name {
		compatible = "mediatek,mt_soc_dai_routing";
	};

	mt_soc_dai_name {
		compatible = "mediatek,mt_soc_dai_stub";
	};

	mt_soc_dl2_pcm {
		compatible = "mediatek,mt_soc_pcm_dl2";
	};

	mt_soc_anc_pcm {
		compatible = "mediatek,mt_soc_pcm_anc";
	};

	mt_soc_pcm_voice_ultra {
		compatible = "mediatek,mt_soc_pcm_voice_ultra";
	};

	mt_soc_pcm_voice_usb {
		compatible = "mediatek,mt_soc_pcm_voice_usb";
	};

	mt_soc_pcm_voice_usb_echoref {
		compatible = "mediatek,mt_soc_pcm_voice_usb_echoref";
	};

	nfc@0 {
		compatible = "mediatek,nfc-gpio-v2";
		linux,phandle = <0xc5>;
		phandle = <0xc5>;
	};

	gps {
		compatible = "mediatek,gps";
	};

	flashlight_core {
		compatible = "mediatek,flashlight_core";
		linux,phandle = <0xc6>;
		phandle = <0xc6>;
	};

	flashlights_lm3643 {
		compatible = "mediatek,flashlights_lm3643";
		linux,phandle = <0xc7>;
		phandle = <0xc7>;
	};

	flashlights_rt5081 {
		compatible = "mediatek,flashlights_rt5081";
		linux,phandle = <0xc8>;
		phandle = <0xc8>;
	};

	flashlights_sgm3785 {
		compatible = "mediatek,flashlights_sgm3785";
		pinctrl-names = "default\0sgm3785_en_high\0sgm3785_en_low\0sgm3785_mode_high\0sgm3785_mode_low\0sgm3785_gpio_as_pwm";
		pinctrl-0 = <0x42>;
		pinctrl-1 = <0x43>;
		pinctrl-2 = <0x44>;
		pinctrl-3 = <0x45>;
		pinctrl-4 = <0x46>;
		pinctrl-5 = <0x47>;
		sgm3785_mode_gpio = <0x0b 0x09 0x00>;
		status = "okay";
		linux,phandle = <0xc9>;
		phandle = <0xc9>;
	};

	usb_c_id@0 {
		compatible = "mediatek,usb_c_id";
		interrupt-parent = <0x0b>;
		interrupts = <0x2a 0x08 0x2a 0x00>;
		debounce = <0x00>;
		status = "okay";
		linux,phandle = <0xca>;
		phandle = <0xca>;
	};

	gsensor@0 {
		compatible = "mediatek,gsensor";
	};

	als_ps@0 {
		compatible = "mediatek,als_ps";
		linux,phandle = <0xcb>;
		phandle = <0xcb>;
	};

	gyroscope@0 {
		compatible = "mediatek,gyroscope";
		linux,phandle = <0xcc>;
		phandle = <0xcc>;
	};

	barometer@0 {
		compatible = "mediatek,barometer";
	};

	m_baro_pl@0 {
		compatible = "mediatek,m_baro_pl";
	};

	msensor@0 {
		compatible = "mediatek,msensor";
	};

	irq_nfc@ {
		compatible = "mediatek,irq_nfc-eint";
		linux,phandle = <0xcd>;
		phandle = <0xcd>;
	};

	dsi_te {
		compatible = "mediatek, dsi_te-eint";
		status = "disabled";
		linux,phandle = <0xce>;
		phandle = <0xce>;
	};

	rf_clock_buffer {
		compatible = "mediatek,rf_clock_buffer";
		mediatek,clkbuf-quantity = <0x04>;
		mediatek,clkbuf-config = <0x02 0x00 0x01 0x01>;
		mediatek,clkbuf-driving-current = <0x02 0x02 0x02 0x02>;
		linux,phandle = <0xcf>;
		phandle = <0xcf>;
	};

	irtx_pwm {
		compatible = "mediatek,irtx-pwm";
		pwm_ch = <0x02>;
		pwm_data_invert = <0x00>;
		linux,phandle = <0xd0>;
		phandle = <0xd0>;
	};

	otg_iddig {
		compatible = "mediatek,usb_iddig_bi_eint";
		linux,phandle = <0xd1>;
		phandle = <0xd1>;
	};

	fan53528_buck_info {
		regulator-name = "ext_buck_lp4";
		regulator-min-microvolt = <0x55730>;
		regulator-max-microvolt = <0x1173c6>;
		regulator-ramp-delay = <0x7d00>;
		regulator-always-on;
	};

	ext_buck_oc {
		compatible = "mediatek, ext_buck_oc-eint";
		status = "disabled";
		linux,phandle = <0xd2>;
		phandle = <0xd2>;
	};

	hct_finger {
		compatible = "mediatek,hct_finger";
		pinctrl-names = "default\0finger_power_en0\0finger_power_en1\0finger_reset_en0\0finger_reset_en1\0finger_spi0_mi_as_spi0_mi\0finger_spi0_mi_as_gpio\0finger_spi0_mo_as_spi0_mo\0finger_spi0_mo_as_gpio\0finger_spi0_clk_as_spi0_clk\0finger_spi0_clk_as_gpio\0finger_spi0_cs_as_spi0_cs\0finger_spi0_cs_as_gpio\0finger_int_as_int\0finger_eint_en0\0finger_eint_en1\0finger_eint_en2\0finger_power_18v_en0\0finger_power_18v_en1";
		pinctrl-0 = <0x48>;
		pinctrl-1 = <0x49>;
		pinctrl-2 = <0x4a>;
		pinctrl-3 = <0x4b>;
		pinctrl-4 = <0x4c>;
		pinctrl-5 = <0x4d>;
		pinctrl-6 = <0x4e>;
		pinctrl-7 = <0x4f>;
		pinctrl-8 = <0x50>;
		pinctrl-9 = <0x51>;
		pinctrl-10 = <0x52>;
		pinctrl-11 = <0x53>;
		pinctrl-12 = <0x54>;
		pinctrl-13 = <0x55>;
		pinctrl-14 = <0x56>;
		pinctrl-15 = <0x57>;
		pinctrl-16 = <0x58>;
		pinctrl-17 = <0x59>;
		pinctrl-18 = <0x5a>;
		reset-gpio = <0x0b 0x1b 0x00>;
		int-gpio = <0x0b 0x15 0x00>;
		interrupt-parent = <0x0b>;
		interrupts = <0x15 0x01 0x15 0x00>;
		debounce = <0x15 0x00>;
		status = "okay";
		linux,phandle = <0xd3>;
		phandle = <0xd3>;
	};

	kpd_slide@0 {
		compatible = "mediatek,hct-hall";
		interrupt-parent = <0x0b>;
		interrupts = <0x05 0x08 0x05 0x00>;
		debounce = <0x05 0x00>;
		hall_gpio = <0x0b 0x05 0x00>;
		status = "okay";
		pinctrl-names = "default\0kpd_slide_as_int";
		pinctrl-0 = <0x5b>;
		pinctrl-1 = <0x5c>;
		linux,phandle = <0xd4>;
		phandle = <0xd4>;
	};

	gyro {
		compatible = "mediatek, gyro-eint";
		status = "disabled";
		linux,phandle = <0xd5>;
		phandle = <0xd5>;
	};

	mse {
		compatible = "mediatek, mse-eint";
		status = "disabled";
		linux,phandle = <0xd6>;
		phandle = <0xd6>;
	};

	eint_fusb300_det_in {
		compatible = "mediatek,fusb300-eint";
		status = "disabled";
		linux,phandle = <0xd7>;
		phandle = <0xd7>;
	};

	smart_pa {
		compatible = "mediatek, smart_pa-eint";
		status = "disabled";
		linux,phandle = <0xd8>;
		phandle = <0xd8>;
	};

	chr_stat {
		compatible = "mediatek, chr_stat-eint";
		linux,phandle = <0xd9>;
		phandle = <0xd9>;
	};

	rt-pd-manager {
		compatible = "mediatek,rt-pd-manager";
		rt,pd_vconn_gpio = <0x0b 0x2a 0x00>;
		rt,pd_vconn_gpio_x = <0x2a>;
	};

	cam_cal_drv {
		compatible = "mediatek,cam_cal_drv";
		main_bus = <0x02>;
		sub_bus = <0x04>;
	};

	charger {
		compatible = "mediatek,charger";
		algorithm_name = "SwitchCharging";
		enable_pe_plus;
		enable_pe_2;
		enable_pe_3;
		enable_type_c;
		power_path_support;
		disable_pd_dual;
		battery_cv = <0x432380>;
		max_charger_voltage = <0x632ea0>;
		min_charger_voltage = <0x4630c0>;
		min_charger_voltage_1 = <0x432380>;
		min_charger_voltage_2 = <0x401640>;
		max_dmivr_charger_current = <0x155cc0>;
		usb_charger_current_suspend = <0x00>;
		usb_charger_current_unconfigured = <0x11170>;
		usb_charger_current_configured = <0x7a120>;
		usb_charger_current = <0x7a120>;
		ac_charger_current = <0x1e8480>;
		ac_charger_input_current = <0x2191c0>;
		non_std_ac_charger_current = <0x10c8e0>;
		charging_host_charger_current = <0x16e360>;
		ta_ac_charger_current = <0x2dc6c0>;
		jeita_temp_above_t4_cv = <0x40b280>;
		jeita_temp_t3_to_t4_cv = <0x40b280>;
		jeita_temp_t2_to_t3_cv = <0x423920>;
		jeita_temp_t1_to_t2_cv = <0x40b280>;
		jeita_temp_t0_to_t1_cv = <0x3da540>;
		jeita_temp_below_t0_cv = <0x3da540>;
		temp_t4_thres = <0x32>;
		temp_t4_thres_minus_x_degree = <0x2f>;
		temp_t3_thres = <0x2d>;
		temp_t3_thres_minus_x_degree = <0x27>;
		temp_t2_thres = <0x0a>;
		temp_t2_thres_plus_x_degree = <0x10>;
		temp_t1_thres = <0x00>;
		temp_t1_thres_plus_x_degree = <0x06>;
		temp_t0_thres = <0x00>;
		temp_t0_thres_plus_x_degree = <0x00>;
		temp_neg_10_thres = <0x00>;
		enable_min_charge_temp;
		min_charge_temp = <0xfffffff7>;
		min_charge_temp_plus_x_degree = <0xfffffff7>;
		max_charge_temp = <0x37>;
		max_charge_temp_minus_x_degree = <0x32>;
		ta_9v_support;
		pe_ichg_level_threshold = <0xf4240>;
		ta_ac_12v_input_current = <0x30d400>;
		ta_ac_9v_input_current = <0x197b70>;
		ta_ac_7v_input_current = <0x197b70>;
		pe20_ichg_level_threshold = <0xf4240>;
		ta_start_battery_soc = <0x00>;
		ta_stop_battery_soc = <0x55>;
		chg1_ta_ac_charger_current = <0x16e360>;
		chg2_ta_ac_charger_current = <0x16e360>;
		slave_mivr_diff = <0x186a0>;
		dual_polling_ieoc = <0x6ddd0>;
		cable_imp_threshold = <0x2bb>;
		vbat_cable_imp_threshold = <0x3b8260>;
		bif_threshold1 = <0x40d990>;
		bif_threshold2 = <0x419ce0>;
		bif_cv_under_threshold2 = <0x43e6d0>;
		pd_vbus_low_bound = <0x4c4b40>;
		pd_vbus_upper_bound = <0x4c4b40>;
		pd_ichg_level_threshold = <0xf4240>;
		pd_stop_battery_soc = <0x50>;
		ibus_err = <0x0e>;
		vsys_watt = <0x4c4b40>;
		linux,phandle = <0xda>;
		phandle = <0xda>;
	};

	pd_adapter {
		compatible = "mediatek,pd_adapter";
		adapter_name = "pd_adapter";
		linux,phandle = <0xdb>;
		phandle = <0xdb>;
	};

	rt5081_pmu_eint {
		linux,phandle = <0xdc>;
		phandle = <0xdc>;
	};

	rt5081_pd_eint {
		linux,phandle = <0xdd>;
		phandle = <0xdd>;
	};

	rt1711h_pd_eint {
		linux,phandle = <0xde>;
		phandle = <0xde>;
	};

	hct_device {
		compatible = "mediatek,hct_devices";
		linux,phandle = <0xdf>;
		phandle = <0xdf>;
	};

	odm {
		compatible = "simple-bus";
		linux,phandle = <0xe0>;
		phandle = <0xe0>;
	};

	__symbols__ {
		chosen = "/chosen";
		mmc0 = "/msdc0@11230000";
		mmc1 = "/msdc1@11240000";
		mmc2 = "/msdc2@11250000";
		msdc1_ins = "/msdc1_ins@0";
		cpu0 = "/cpus/cpu@000";
		cpu1 = "/cpus/cpu@001";
		cpu2 = "/cpus/cpu@002";
		cpu3 = "/cpus/cpu@003";
		cpu4 = "/cpus/cpu@100";
		cpu5 = "/cpus/cpu@101";
		cpu6 = "/cpus/cpu@102";
		cpu7 = "/cpus/cpu@103";
		LEGACY_MCDI = "/cpus/idle-states/legacy-mcdi";
		LEGACY_SODI = "/cpus/idle-states/legacy-sodi";
		LEGACY_SODI3 = "/cpus/idle-states/legacy-sodi3";
		LEGACY_DPIDLE = "/cpus/idle-states/legacy-dpidle";
		LEGACY_SUSPEND = "/cpus/idle-states/legacy-suspend";
		MCDI_CPU = "/cpus/idle-states/mcdi-cpu";
		MCDI_CLUSTER = "/cpus/idle-states/mcdi-cluster";
		SODI = "/cpus/idle-states/sodi";
		SODI3 = "/cpus/idle-states/sodi3";
		DPIDLE = "/cpus/idle-states/dpidle";
		SUSPEND = "/cpus/idle-states/suspend";
		memory = "/memory";
		reserved_memory = "/reserved-memory";
		gic = "/interrupt-controller@0c000000";
		clk_null = "/clocks/clk_null";
		clk26m = "/clocks/clk26m";
		clk32k = "/clocks/clk32k";
		timer = "/timer";
		mtkfb = "/mtkfb@0";
		touch = "/touch";
		accdet = "/accdet@";
		bat_gm30 = "/battery";
		mt_charger = "/mt_charger";
		swtp = "/swtp";
		pmic_clock_buffer_ctrl = "/pmic_clock_buffer";
		usbphy0 = "/usbphy@0";
		cpu_dbgapb = "/cpu_dbgapb";
		topckgen = "/topckgen@10000000";
		usb2jtag = "/usb2jtag@10001000";
		infrasys = "/infracfg_ao@10001000";
		scpsys = "/scpsys@10001000";
		iocfg_0 = "/iocfg_0@10002000";
		iocfg_1 = "/iocfg_1@10002200";
		iocfg_2 = "/iocfg_2@10002400";
		iocfg_3 = "/iocfg_3@10002600";
		iocfg_4 = "/iocfg_4@10002800";
		iocfg_5 = "/iocfg_5@10002a00";
		gpio = "/gpio@10005000";
		pio = "/pinctrl@1000b000";
		mmc0_pins_default = "/pinctrl@1000b000/mmc0@default";
		mmc0_register_setting_default = "/pinctrl@1000b000/mmc0@register_default";
		mmc1_pins_default = "/pinctrl@1000b000/mmc1@default";
		mmc1_pins_sdr104 = "/pinctrl@1000b000/mmc1@sdr104";
		mmc1_pins_sdr50 = "/pinctrl@1000b000/mmc1@sdr50";
		mmc1_pins_ddr50 = "/pinctrl@1000b000/mmc1@ddr50";
		mmc1_register_setting_default = "/pinctrl@1000b000/mmc1@register_default";
		mmc2_pins_default = "/pinctrl@1000b000/mmc2@default";
		mmc2_register_setting_default = "/pinctrl@1000b000/mmc2@register_default";
		flashlights_sgm3785_pin_default = "/pinctrl@1000b000/sgm3785_pin_default";
		flashlights_sgm3785_en_high = "/pinctrl@1000b000/sgm3785_en@1";
		flashlights_sgm3785_en_low = "/pinctrl@1000b000/sgm3785_en@0";
		flashlights_sgm3785_mode_high = "/pinctrl@1000b000/sgm3785_mode@1";
		flashlights_sgm3785_mode_low = "/pinctrl@1000b000/sgm3785_mode@0";
		flashlights_sgm3785_gpio_as_pwm = "/pinctrl@1000b000/flashlight_sgm3785_as_pwm";
		typec_pin_default = "/pinctrl@1000b000/typec_default";
		typec_pin_eint_as_int = "/pinctrl@1000b000/typec_pin_eint_as_int_def";
		typec_pin_usb_id = "/pinctrl@1000b000/typec_pin_usb_id_def";
		kpd_slide_pin_default = "/pinctrl@1000b000/kpd_slide_default";
		kpd_slide_pin_eint_as_int = "/pinctrl@1000b000/kpd_slide_pin_def";
		finger_pins_default = "/pinctrl@1000b000/finger_pins_default";
		finger_power_en0 = "/pinctrl@1000b000/finger_power_en@0";
		finger_power_en1 = "/pinctrl@1000b000/finger_power_en@1";
		finger_reset_en0 = "/pinctrl@1000b000/finger_reset_en@0";
		finger_reset_en1 = "/pinctrl@1000b000/finger_reset_en@1";
		finger_spi0_mi_as_spi0_mi = "/pinctrl@1000b000/finger_spi0_mi_as_spi0_mi@0";
		finger_spi0_mi_as_gpio = "/pinctrl@1000b000/finger_spi0_mi_as_gpio@0";
		finger_spi0_mo_as_spi0_mo = "/pinctrl@1000b000/finger_spi0_mo_as_spi0_mo@0";
		finger_spi0_mo_as_gpio = "/pinctrl@1000b000/finger_spi0_mo_as_gpio@0";
		finger_spi0_clk_as_spi0_clk = "/pinctrl@1000b000/finger_spi0_clk_as_spi0_clk@0";
		finger_spi0_clk_as_gpio = "/pinctrl@1000b000/finger_spi0_clk_as_gpio@0";
		finger_spi0_cs_as_spi0_cs = "/pinctrl@1000b000/finger_spi0_cs_as_spi0_cs@0";
		finger_spi0_cs_as_gpio = "/pinctrl@1000b000/finger_spi0_cs_as_gpio@0";
		finger_int_as_int = "/pinctrl@1000b000/finger_int_as_int@0";
		finger_eint_en0 = "/pinctrl@1000b000/finger_eint_en0";
		finger_eint_en1 = "/pinctrl@1000b000/finger_eint_en1";
		finger_eint_en2 = "/pinctrl@1000b000/finger_eint_en2";
		finger_power_18v_en0 = "/pinctrl@1000b000/finger_power_18v_en@0";
		finger_power_18v_en1 = "/pinctrl@1000b000/finger_power_18v_en@1";
		gpio_usage_mapping = "/gpio";
		eintc = "/eintc@1000b000";
		apmixedsys = "/apmixed@1000c000";
		mt6355_pmic = "/mt-pmic";
		pmic_auxadc = "/mt-pmic/mt635x-auxadc";
		mt_pmic_vdram2_buck_reg = "/mt-pmic/buck_regulators/buck_vdram2";
		mt_pmic_vs1_buck_reg = "/mt-pmic/buck_regulators/buck_vs1";
		mt_pmic_vdram1_buck_reg = "/mt-pmic/buck_regulators/buck_vdram1";
		mt_pmic_vmodem_buck_reg = "/mt-pmic/buck_regulators/buck_vmodem";
		mt_pmic_vcore_buck_reg = "/mt-pmic/buck_regulators/buck_vcore";
		mt_pmic_vs2_buck_reg = "/mt-pmic/buck_regulators/buck_vs2";
		mt_pmic_vpa_buck_reg = "/mt-pmic/buck_regulators/buck_vpa";
		mt_pmic_vproc12_buck_reg = "/mt-pmic/buck_regulators/buck_vproc12";
		mt_pmic_vgpu_buck_reg = "/mt-pmic/buck_regulators/buck_vgpu";
		mt_pmic_vproc11_buck_reg = "/mt-pmic/buck_regulators/buck_vproc11";
		mt_pmic_vcamd1_ldo_reg = "/mt-pmic/ldo_regulators/ldo_vcamd1";
		mt_pmic_vsim1_ldo_reg = "/mt-pmic/ldo_regulators/ldo_vsim1";
		mt_pmic_vgp_ldo_reg = "/mt-pmic/ldo_regulators/ldo_vgp";
		mt_pmic_vusb33_ldo_reg = "/mt-pmic/ldo_regulators/ldo_vusb33";
		mt_pmic_vrf12_ldo_reg = "/mt-pmic/ldo_regulators/ldo_vrf12";
		mt_pmic_vcamio_ldo_reg = "/mt-pmic/ldo_regulators/ldo_vcamio";
		mt_pmic_vcn18_ldo_reg = "/mt-pmic/ldo_regulators/ldo_vcn18";
		mt_pmic_vfe28_ldo_reg = "/mt-pmic/ldo_regulators/ldo_vfe28";
		mt_pmic_vrf18_2_ldo_reg = "/mt-pmic/ldo_regulators/ldo_vrf18_2";
		mt_pmic_va18_ldo_reg = "/mt-pmic/ldo_regulators/ldo_va18";
		mt_pmic_vcn28_ldo_reg = "/mt-pmic/ldo_regulators/ldo_vcn28";
		mt_pmic_vmipi_ldo_reg = "/mt-pmic/ldo_regulators/ldo_vmipi";
		mt_pmic_vsram_gpu_ldo_reg = "/mt-pmic/ldo_regulators/ldo_vsram_gpu";
		mt_pmic_vsram_core_ldo_reg = "/mt-pmic/ldo_regulators/ldo_vsram_core";
		mt_pmic_vsram_proc_ldo_reg = "/mt-pmic/ldo_regulators/ldo_vsram_proc";
		mt_pmic_vxo22_ldo_reg = "/mt-pmic/ldo_regulators/ldo_vxo22";
		mt_pmic_vrf18_1_ldo_reg = "/mt-pmic/ldo_regulators/ldo_vrf18_1";
		mt_pmic_vcamd2_ldo_reg = "/mt-pmic/ldo_regulators/ldo_vcamd2";
		mt_pmic_vmch_ldo_reg = "/mt-pmic/ldo_regulators/ldo_vmch";
		mt_pmic_vcama1_ldo_reg = "/mt-pmic/ldo_regulators/ldo_vcama1";
		mt_pmic_vtcxo24_ldo_reg = "/mt-pmic/ldo_regulators/ldo_vtcxo24";
		mt_pmic_vio28_ldo_reg = "/mt-pmic/ldo_regulators/ldo_vio28";
		mt_pmic_vemc_ldo_reg = "/mt-pmic/ldo_regulators/ldo_vemc";
		mt_pmic_va12_ldo_reg = "/mt-pmic/ldo_regulators/ldo_va12";
		mt_pmic_va10_ldo_reg = "/mt-pmic/ldo_regulators/ldo_va10";
		mt_pmic_vgp2_ldo_reg = "/mt-pmic/ldo_regulators/ldo_vgp2";
		mt_pmic_vio18_ldo_reg = "/mt-pmic/ldo_regulators/ldo_vio18";
		mt_pmic_vcn33_bt_ldo_reg = "/mt-pmic/ldo_regulators/ldo_vcn33_bt";
		mt_pmic_vcn33_wifi_ldo_reg = "/mt-pmic/ldo_regulators/ldo_vcn33_wifi";
		mt_pmic_vsram_md_ldo_reg = "/mt-pmic/ldo_regulators/ldo_vsram_md";
		mt_pmic_vbif28_ldo_reg = "/mt-pmic/ldo_regulators/ldo_vbif28";
		mt_pmic_vufs18_ldo_reg = "/mt-pmic/ldo_regulators/ldo_vufs18";
		mt_pmic_vcama2_ldo_reg = "/mt-pmic/ldo_regulators/ldo_vcama2";
		mt_pmic_vmc_ldo_reg = "/mt-pmic/ldo_regulators/ldo_vmc";
		mt_pmic_vldo28_ldo_reg = "/mt-pmic/ldo_regulators/ldo_vldo28";
		mt_pmic_vldo28_tp_ldo_reg = "/mt-pmic/ldo_regulators/ldo_vldo28_tp";
		mt_pmic_vxo18_ldo_reg = "/mt-pmic/ldo_regulators/ldo_vxo18";
		mt_pmic_vsim2_ldo_reg = "/mt-pmic/ldo_regulators/ldo_vsim2";
		mrdump_ext_rst = "/mrdump_ext_rst";
		keypad = "/keypad@10010000";
		mdcldma = "/mdcldma@10014000";
		btif_tx = "/btif_tx@11000980";
		btif_rx = "/btif_rx@11000a00";
		auxadc = "/auxadc@11001000";
		apuart0 = "/apuart0@11002000";
		apuart1 = "/apuart1@11003000";
		i2c_common = "/i2c_common";
		i2c0 = "/i2c@11007000";
		i2c6 = "/i2c@11008000";
		i2c7 = "/i2c@11009000";
		spi0 = "/spi@1100a000";
		i2c3 = "/i2c@1100f000";
		spi1 = "/spi@11010000";
		i2c5 = "/i2c@11011000";
		spi2 = "/spi@11012000";
		spi3 = "/spi@11013000";
		i2c1 = "/i2c@11014000";
		i2c2 = "/i2c@11015000";
		i2c8 = "/i2c@11016000";
		i2c4 = "/i2c@11017000";
		spi4 = "/spi@11018000";
		cap_touch_mtk = "/spi@11018000/cap_touch@0";
		spi5 = "/spi@11019000";
		audiosys = "/audio@11220000";
		audgpio = "/mt_soc_dl1_pcm@11220000";
		btcvsd_snd = "/mtk-btcvsd-snd@18000000";
		usb0 = "/usb3@11270000";
		xhci0 = "/usb3_xhci@11270000";
		mfgsys = "/g3d_config@13000000";
		met_mali = "/met_mali@13040000";
		mmsys = "/mmsys_config@14000000";
		dispsys = "/dispsys@14000000";
		mhl = "/mhl@0";
		disp_aal0 = "/disp_aal0@14018000";
		smi_larb0 = "/smi_larb0@14026000";
		smi_larb4 = "/smi_larb4@14027000";
		met_smi = "/met_smi@14028000";
		imgsys = "/imgsys_config@15020000";
		smi_larb5 = "/smi_larb5@15021000";
		vdecsys = "/vdec_gcon@16000000";
		smi_larb1 = "/smi_larb1@16010000";
		vdec_full_top = "/vdec@16020000";
		vencsys = "/venc_gcon@17000000";
		smi_larb3 = "/smi_larb3@17001000";
		consys = "/consys@18070000";
		camsys = "/camsys_config@1a000000";
		smi_larb2 = "/smi_larb2@1a001000";
		kd_camera_hw1 = "/kd_camera_hw1@1a040000";
		kd_camera_hw2 = "/kd_camera_hw2@1a040000";
		usb_c_pinctrl = "/usb_c_pinctrl@0";
		nfc = "/nfc@0";
		flashlight_core = "/flashlight_core";
		flashlights_lm3643 = "/flashlights_lm3643";
		flashlights_rt5081 = "/flashlights_rt5081";
		flashlights_sgm3785 = "/flashlights_sgm3785";
		usb_c_id = "/usb_c_id@0";
		alsps = "/als_ps@0";
		gyroscope = "/gyroscope@0";
		irq_nfc = "/irq_nfc@";
		dsi_te = "/dsi_te";
		rf_clock_buffer_ctrl = "/rf_clock_buffer";
		irtx_pwm = "/irtx_pwm";
		otg_iddig = "/otg_iddig";
		ext_buck_oc = "/ext_buck_oc";
		hct_finger = "/hct_finger";
		kpd_slide = "/kpd_slide@0";
		gyro = "/gyro";
		mse = "/mse";
		eint_fusb300_det_in = "/eint_fusb300_det_in";
		smart_pa = "/smart_pa";
		chr_stat = "/chr_stat";
		charger = "/charger";
		pd_adapter = "/pd_adapter";
		rt5081_pmu_eint = "/rt5081_pmu_eint";
		rt5081_pd = "/rt5081_pd_eint";
		rt1711h_pd = "/rt1711h_pd_eint";
		hct_device = "/hct_device";
		odm = "/odm";
	};
};
