## drivers/input/touchscreen/mediatek/ilitek_tddi_touch/Kconfig
```kconfig
#
# ILITEK Touchscreen driver configuration
#

config TOUCHSCREEN_MTK_ILITEK_SPI
    bool "ILITEK Touchscreen"
    depends on SPI
    default n
    help
      Say Y here if you have ILITEK touch panel.
      If unsure, say N.
      
```

## drivers/misc/mediatek/sensors-1.0/accelerometer/sc7a20/Kconfig
```kconfig
config MTK_SC7A20
        bool "SC7A20 for MediaTek package"
        default n
        help
        If this option is set, it will support SC7A20 Accelerometer.
```

## drivers/misc/mediatek/sensors-1.0/accelerometer/stk8baxx/Kconfig
```kconfig
config MTK_STK8BA50
	bool "MTK_STK8BA50 for MediaTek package"
	default n
	help
	  The MTK_STK8BA50 is a highly integrated,
	  low power internal measurement unit
	  that provides precise acceleration
	  measurement.
	  this config will turn on accelerometer feature.
```
